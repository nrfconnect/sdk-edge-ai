## CMakeLists.txt
```
#
# Copyright (c) 2026 Nordic Semiconductor ASA
#
# SPDX-License-Identifier: LicenseRef-Nordic-5-Clause
#

cmake_minimum_required(VERSION 3.20.0)

find_package(Zephyr REQUIRED HINTS $ENV{ZEPHYR_BASE})

project(test_nrf_edgeai_obsv_memfault)

zephyr_include_directories(config)

# Memfault SDK headers are required for MemfaultMetricId. Implementations used
# by the heartbeat adapter are stubbed in src/memfault_mock.c.
zephyr_include_directories(${ZEPHYR_MEMFAULT_FIRMWARE_SDK_MODULE_DIR}/components/include)

target_sources(app PRIVATE
  src/heartbeat.c
  src/memfault_mock.c
)
```

## prj.conf
```kconfig
#
# Copyright (c) 2026 Nordic Semiconductor ASA
#
# SPDX-License-Identifier: LicenseRef-Nordic-5-Clause
#

CONFIG_ZTEST=y

CONFIG_NRF_EDGEAI_OBSV=y
CONFIG_NRF_EDGEAI_OBSV_METRIC_MODEL_CERTAINTY_DESC=y
CONFIG_NRF_EDGEAI_OBSV_MODEL_CERTAINTY_DESC_BIN_NUM=4

CONFIG_NRF_EDGEAI_OBSV_MEMFAULT=y
CONFIG_NRF_EDGEAI_OBSV_MEMFAULT_MAX_CONTEXTS=2
```

## src/main.c
```c
/*
 * Copyright (c) 2026 Nordic Semiconductor ASA
 *
 * SPDX-License-Identifier: LicenseRef-Nordic-5-Clause
 */

#include <errno.h>
#include <string.h>

#include <zephyr/kernel.h>
#include <zephyr/ztest.h>
#include <memfault/core/custom_data_recording.h>

#include <nrf_edgeai_obsv/nrf_edgeai_obsv.h>
#include <nrf_edgeai_obsv/nrf_edgeai_obsv_memfault.h>
#include "nrf_edgeai_obsv_memfault_priv.h"
#include "obsv_mock.h"

#define TEST_NUM_CLASSES 4

extern nrf_edgeai_obsv_mflt_staging_t nrf_edgeai_obsv_mflt_staging;
extern struct k_mutex obsv_mflt_lock;
extern const sMemfaultCdrSourceImpl obsv_cdr_source;

static void reset_obsv_mflt_staging(nrf_edgeai_obsv_mflt_staging_t *s)
{
	k_mutex_lock(&obsv_mflt_lock, K_FOREVER);
	memset(s->ctxs, 0, sizeof(s->ctxs));
	s->num_ctxs = 0U;
	s->len = 0U;
	s->ready = false;
	s->collecting = false;
	s->collect_pending = false;
	s->staged_duration_ms = 0U;
	s->last_collect_ms = 0U;
	k_mutex_unlock(&obsv_mflt_lock);
}

static uint32_t get_last_collect_ms(void)
{
	k_mutex_lock(&obsv_mflt_lock, K_FOREVER);
	uint32_t last_collect_ms = nrf_edgeai_obsv_mflt_staging.last_collect_ms;

	k_mutex_unlock(&obsv_mflt_lock);

	return last_collect_ms;
}

static nrf_edgeai_obsv_ctx_t obsv;

static const nrf_edgeai_obsv_model_info_t test_model = {
	.model_id = 1,
	.num_classes = TEST_NUM_CLASSES,
	.version = 1,
};

static void setup_ctx(void)
{
	zassert_equal(nrf_edgeai_obsv_init(&obsv, &test_model), 0);
}

static void before_each(void *data)
{
	ARG_UNUSED(data);

	reset_obsv_mflt_staging(&nrf_edgeai_obsv_mflt_staging);
	memset(&obsv, 0, sizeof(obsv));
	obsv_mock_reset();
}

ZTEST_SUITE(obsv_memfault, NULL, NULL, before_each, NULL, NULL);

/* ---------- Unhappy paths ---------- */

ZTEST(obsv_memfault, test_init_null_returns_einval)
{
	zassert_equal(nrf_edgeai_obsv_memfault_init(NULL), -EINVAL);
}

ZTEST(obsv_memfault, test_collect_before_init_returns_einval)
{
	zassert_equal(nrf_edgeai_obsv_memfault_collect(), -EINVAL);
}

ZTEST(obsv_memfault, test_obsv_update_null_returns_einval)
{
	const float probs[TEST_NUM_CLASSES] = {0.25f, 0.25f, 0.25f, 0.25f};

	zassert_equal(nrf_edgeai_obsv_update_probs(NULL, probs), -EINVAL);

	setup_ctx();
	zassert_equal(nrf_edgeai_obsv_update_probs(&obsv, NULL), -EINVAL);
}

ZTEST(obsv_memfault, test_has_cdr_before_collect_returns_false)
{
	sMemfaultCdrMetadata md;

	zassert_false(obsv_cdr_source.has_cdr_cb(&md));
}

ZTEST(obsv_memfault, test_read_before_collect_returns_false)
{
	uint8_t buf[4];

	zassert_false(obsv_cdr_source.read_data_cb(0, buf, sizeof(buf)));
}

ZTEST(obsv_memfault, test_read_out_of_bounds_returns_false)
{
	setup_ctx();
	zassert_equal(nrf_edgeai_obsv_memfault_init(&obsv), 0);
	zassert_equal(nrf_edgeai_obsv_memfault_collect(), 0);

	sMemfaultCdrMetadata md;

	zassert_true(obsv_cdr_source.has_cdr_cb(&md));

	uint8_t buf[1];

	zassert_false(obsv_cdr_source.read_data_cb(md.data_size_bytes, buf, 1));
	zassert_false(obsv_cdr_source.read_data_cb(0, buf, md.data_size_bytes + 1));
}

ZTEST(obsv_memfault, test_has_cdr_after_mark_read_returns_false)
{
	setup_ctx();
	zassert_equal(nrf_edgeai_obsv_memfault_init(&obsv), 0);
	zassert_equal(nrf_edgeai_obsv_memfault_collect(), 0);

	sMemfaultCdrMetadata md;

	obsv_cdr_source.mark_cdr_read_cb();
	zassert_false(obsv_cdr_source.has_cdr_cb(&md));
}

/* ---------- Happy path ---------- */

ZTEST(obsv_memfault, test_init_and_collect_exposes_payload)
{
	setup_ctx();

	zassert_equal(nrf_edgeai_obsv_memfault_init(&obsv), 0, "init failed");
	zassert_equal(nrf_edgeai_obsv_memfault_collect(), 0, "collect failed");

	sMemfaultCdrMetadata md = {0};

	zassert_true(obsv_cdr_source.has_cdr_cb(&md));
	zassert_true(md.data_size_bytes > 0);
	zassert_equal(md.num_mimetypes, 1);
	zassert_not_null(md.collection_reason);
	zassert_equal(md.start_time.type, kMemfaultCurrentTimeType_Unknown);

	/* Verify read_data covers the full staged range and partial reads work. */
	uint8_t read_buf[16];

	zassert_true(md.data_size_bytes <= sizeof(read_buf));
	zassert_true(obsv_cdr_source.read_data_cb(0, read_buf, md.data_size_bytes));

	obsv_cdr_source.mark_cdr_read_cb();
	zassert_false(obsv_cdr_source.has_cdr_cb(&md));
}

/* ---------- Two-context (multi-model) test ---------- */

static nrf_edgeai_obsv_ctx_t obsv_b;

static const nrf_edgeai_obsv_model_info_t model_b_info = {
	.model_id = 2,
	.num_classes = TEST_NUM_CLASSES,
	.version = 1,
};

ZTEST(obsv_memfault, test_two_contexts_produce_combined_payload)
{
	/* Set up context A. */
	setup_ctx();
	zassert_equal(nrf_edgeai_obsv_memfault_init(&obsv), 0, "init ctx A");

	/* Set up context B. */
	memset(&obsv_b, 0, sizeof(obsv_b));
	zassert_equal(nrf_edgeai_obsv_init(&obsv_b, &model_b_info), 0);
	zassert_equal(nrf_edgeai_obsv_memfault_init(&obsv_b), 0, "init ctx B");

	zassert_equal(nrf_edgeai_obsv_memfault_collect(), 0, "collect failed");

	sMemfaultCdrMetadata md = {0};

	zassert_true(obsv_cdr_source.has_cdr_cb(&md));

	/* Mock returns OBSV_MOCK_BYTES_PER_CTX bytes per context. */
	zassert_equal(md.data_size_bytes, 2U * OBSV_MOCK_BYTES_PER_CTX);

	uint8_t read_buf[2 * OBSV_MOCK_BYTES_PER_CTX];

	zassert_true(obsv_cdr_source.read_data_cb(0, read_buf, md.data_size_bytes));
}

/* ---------- No-overwrite behavior ---------- */

/*
 * Metrics are incremental: every collect resets the contexts, so a staged CDR
 * cannot be rebuilt once overwritten. collect() must refuse with -EBUSY until
 * the CDR is drained, without encoding or resetting, and the staged bytes must
 * stay stable for the packetizer's chunked reads.
 */
ZTEST(obsv_memfault, test_collect_busy_until_drained)
{
	setup_ctx();
	zassert_equal(nrf_edgeai_obsv_memfault_init(&obsv), 0);

	zassert_equal(nrf_edgeai_obsv_memfault_collect(), 0, "first collect failed");

	sMemfaultCdrMetadata md = {0};

	zassert_true(obsv_cdr_source.has_cdr_cb(&md));
	zassert_true(md.data_size_bytes > 0, "no payload after first collect");

	uint8_t buf_first[16];

	zassert_true(md.data_size_bytes <= sizeof(buf_first));
	zassert_true(obsv_cdr_source.read_data_cb(0, buf_first, md.data_size_bytes));

	const float probs[TEST_NUM_CLASSES] = {0.7f, 0.1f, 0.1f, 0.1f};

	zassert_equal(nrf_edgeai_obsv_update_probs(&obsv, probs), 0);
	zassert_equal(nrf_edgeai_obsv_update_probs(&obsv, probs), 0);

	/* Second collect before drain: refused, nothing encoded (no reset either). */
	zassert_equal(nrf_edgeai_obsv_memfault_collect(), -EBUSY,
		      "collect before drain must be refused");
	zassert_equal(obsv_mock_call_count(), 1U, "refused collect must not encode/reset");
	zassert_equal(obsv.state.num_inferences, 2U, "refused collect touched the live context");

	sMemfaultCdrMetadata md_busy = {0};
	uint8_t buf_busy[16];

	zassert_true(obsv_cdr_source.has_cdr_cb(&md_busy));
	zassert_equal(md_busy.data_size_bytes, md.data_size_bytes);
	zassert_true(obsv_cdr_source.read_data_cb(0, buf_busy, md_busy.data_size_bytes));
	zassert_mem_equal(buf_first, buf_busy, md.data_size_bytes,
			  "refused collect changed the staged CDR");

	/* After drain, collect succeeds and stages a new payload. */
	obsv_cdr_source.mark_cdr_read_cb();
	zassert_equal(nrf_edgeai_obsv_memfault_collect(), 0, "collect after drain failed");

	sMemfaultCdrMetadata md2 = {0};
	uint8_t buf_second[16];

	zassert_true(obsv_cdr_source.has_cdr_cb(&md2));
	zassert_true(md2.data_size_bytes <= sizeof(buf_second));
	zassert_true(obsv_cdr_source.read_data_cb(0, buf_second, md2.data_size_bytes));
	zassert_true(memcmp(buf_first, buf_second, MIN(md.data_size_bytes, md2.data_size_bytes)) !=
			     0,
		     "collect after drain did not stage a new payload");
}

/* A failed encode stages nothing and must not leave collect() stuck at -EBUSY. */
ZTEST(obsv_memfault, test_failed_encode_allows_next_collect)
{
	setup_ctx();
	zassert_equal(nrf_edgeai_obsv_memfault_init(&obsv), 0);

	obsv_mock_fail_next();
	zassert_equal(nrf_edgeai_obsv_memfault_collect(), -ENODATA);

	sMemfaultCdrMetadata md = {0};

	zassert_false(obsv_cdr_source.has_cdr_cb(&md), "failed encode staged a CDR");

	zassert_equal(nrf_edgeai_obsv_memfault_collect(), 0, "collect after failed encode");
	zassert_true(obsv_cdr_source.has_cdr_cb(&md));
}

/* A refused collect must preserve the start of the current collection interval. */
ZTEST(obsv_memfault, test_refused_collect_preserves_interval_start)
{
	setup_ctx();
	zassert_equal(nrf_edgeai_obsv_memfault_init(&obsv), 0);

	k_sleep(K_MSEC(10));
	zassert_equal(nrf_edgeai_obsv_memfault_collect(), 0);

	uint32_t interval_start_ms = get_last_collect_ms();

	zassert_not_equal(interval_start_ms, 0U);

	k_sleep(K_MSEC(10));
	zassert_equal(nrf_edgeai_obsv_memfault_collect(), -EBUSY);

	zassert_equal(get_last_collect_ms(), interval_start_ms,
		      "refused collect changed the interval start");
}

#if defined(CONFIG_NRF_EDGEAI_OBSV_MEMFAULT_AUTO_COLLECT)
extern void auto_collect_work_handler(struct k_work *work);

ZTEST(obsv_memfault, test_auto_collect_work_handler_stages_payload)
{
	setup_ctx();
	zassert_equal(nrf_edgeai_obsv_memfault_init(&obsv), 0);

	/* Invoke the work handler directly — no need to wait for the timer. */
	auto_collect_work_handler(NULL);

	sMemfaultCdrMetadata md = {0};

	zassert_true(obsv_cdr_source.has_cdr_cb(&md), "work handler did not stage a payload");
	zassert_true(md.data_size_bytes > 0);
}

/* A drain after a refused collect stages the backlog without waiting an interval. */
ZTEST(obsv_memfault, test_drain_after_refused_collect_schedules_collect)
{
	setup_ctx();
	zassert_equal(nrf_edgeai_obsv_memfault_init(&obsv), 0);

	zassert_equal(nrf_edgeai_obsv_memfault_collect(), 0);
	zassert_equal(nrf_edgeai_obsv_memfault_collect(), -EBUSY);

	obsv_cdr_source.mark_cdr_read_cb();

	/* Let the system workqueue run the deferred collect. */
	k_sleep(K_MSEC(50));

	sMemfaultCdrMetadata md = {0};

	zassert_true(obsv_cdr_source.has_cdr_cb(&md), "drain did not trigger the deferred collect");
	zassert_equal(obsv_mock_call_count(), 2U);
}

/* A normal drain (no refused collect) must not trigger a short-window collect. */
ZTEST(obsv_memfault, test_drain_without_refusal_does_not_collect)
{
	setup_ctx();
	zassert_equal(nrf_edgeai_obsv_memfault_init(&obsv), 0);

	zassert_equal(nrf_edgeai_obsv_memfault_collect(), 0);
	obsv_cdr_source.mark_cdr_read_cb();

	k_sleep(K_MSEC(50));

	sMemfaultCdrMetadata md = {0};

	zassert_false(obsv_cdr_source.has_cdr_cb(&md), "drain staged an unrequested CDR");
	zassert_equal(obsv_mock_call_count(), 1U);
}
#endif
```

## src/heartbeat.c
```c
/*
 * Copyright (c) 2026 Nordic Semiconductor ASA
 *
 * SPDX-License-Identifier: LicenseRef-Nordic-5-Clause
 */

#include <errno.h>
#include <string.h>

#include <zephyr/ztest.h>

#include <nrf_edgeai_obsv/nrf_edgeai_obsv.h>
#include <nrf_edgeai_obsv/nrf_edgeai_obsv_memfault.h>

#define TEST_ROWS 3U
#define TEST_COLS 4U

void memfault_mock_reset(void);
void memfault_mock_set_storage_full(bool full);
uint32_t memfault_mock_value(int key);
uint32_t memfault_mock_write_count(void);

static uint32_t counts[TEST_ROWS * TEST_COLS];

static void metric_init(const void *cfg, void *priv)
{
	ARG_UNUSED(cfg);
	memset(priv, 0, sizeof(counts));
}

static void metric_update(const float *data, uint16_t n, void *priv)
{
	ARG_UNUSED(data);
	ARG_UNUSED(n);

	uint32_t *values = priv;

	values[0]++;
	values[TEST_COLS + 2U] += 7U;
}

static void metric_clear(void *priv)
{
	memset(priv, 0, sizeof(counts));
}

static void metric_snapshot(nrf_edgeai_obsv_metric_snapshot_t *snapshot, void *priv)
{
	*snapshot = (nrf_edgeai_obsv_metric_snapshot_t){
		.metric_id = NRF_EDGEAI_OBSV_METRIC_ID_MODEL_CERTAINTY_DESC,
		.version = 1,
		.num_rows = TEST_ROWS,
		.num_cols = TEST_COLS,
		.counts = priv,
	};
}

static nrf_edgeai_obsv_metric_t metric = {
	.init = metric_init,
	.update = metric_update,
	.clear = metric_clear,
	.snapshot = metric_snapshot,
	.source = NRF_EDGEAI_OBSV_SOURCE_PROBS,
	.priv = counts,
};

#define TEST_MODEL_ID      3U
#define TEST_MODEL_VERSION 7U

enum {
	KEY_MODEL_ID = 13,
	KEY_MODEL_VERSION,
	KEY_NUM_INFERENCES,
	KEY_NUM_FEATURE_UPDATES,
	KEY_MCD_VERSION,
};

static const struct nrf_edgeai_obsv_memfault_keys mflt_keys = {
	.model = {
		.model_id = {._impl = KEY_MODEL_ID},
		.model_version = {._impl = KEY_MODEL_VERSION},
		.num_inferences = {._impl = KEY_NUM_INFERENCES},
		.num_feature_updates = {._impl = KEY_NUM_FEATURE_UPDATES},
	},
	.mcd = {
		.version = {._impl = KEY_MCD_VERSION},
		.entropy = {{._impl = 1}, {._impl = 2}, {._impl = 3}, {._impl = 4}},
		.top2_margin = {{._impl = 5}, {._impl = 6}, {._impl = 7}, {._impl = 8}},
		.switches = {._impl = 9},
		.comparisons = {._impl = 10},
		.majority_frames = {._impl = 11},
		.confident_switches = {._impl = 12},
	},
};

static nrf_edgeai_obsv_ctx_t ctx;
static const float probs[] = {0.75f, 0.25f};

static void *suite_setup(void)
{
	const nrf_edgeai_obsv_model_info_t model = {
		.model_id = TEST_MODEL_ID,
		.num_classes = 2,
		.version = TEST_MODEL_VERSION,
	};

	zassert_ok(nrf_edgeai_obsv_init(&ctx, &model));
	zassert_ok(nrf_edgeai_obsv_register(&ctx, &metric, NULL));
	zassert_ok(nrf_edgeai_obsv_memfault_init(&ctx, &mflt_keys));

	return NULL;
}

static void before_each(void *fixture)
{
	ARG_UNUSED(fixture);

	memfault_mock_reset();
	zassert_ok(nrf_edgeai_obsv_reset(&ctx));
}

ZTEST(obsv_memfault, test_heartbeat_exports_bound_cells_and_resets_context)
{
	zassert_ok(nrf_edgeai_obsv_update_probs(&ctx, probs));
	zassert_ok(nrf_edgeai_obsv_update_probs(&ctx, probs));
	zassert_ok(nrf_edgeai_obsv_memfault_collect());

	zassert_equal(memfault_mock_value(1), 2U);
	zassert_equal(memfault_mock_value(7), 14U);
	zassert_equal(memfault_mock_write_count(), 17U);
	zassert_equal(ctx.state.num_inferences, 0U);

	zassert_ok(nrf_edgeai_obsv_memfault_collect());
	zassert_equal(memfault_mock_write_count(), 17U,
		      "empty interval unexpectedly wrote heartbeat metrics");
}

ZTEST(obsv_memfault, test_heartbeat_exports_model_identity_and_counters)
{
	const float feats[] = {0.0f};

	zassert_ok(nrf_edgeai_obsv_update_features(&ctx, feats, ARRAY_SIZE(feats)));
	zassert_ok(nrf_edgeai_obsv_update_probs(&ctx, probs));
	zassert_ok(nrf_edgeai_obsv_update_probs(&ctx, probs));
	zassert_ok(nrf_edgeai_obsv_memfault_collect());

	zassert_equal(memfault_mock_value(KEY_MODEL_ID), TEST_MODEL_ID);
	zassert_equal(memfault_mock_value(KEY_MODEL_VERSION), TEST_MODEL_VERSION);
	zassert_equal(memfault_mock_value(KEY_NUM_INFERENCES), 2U);
	zassert_equal(memfault_mock_value(KEY_NUM_FEATURE_UPDATES), 1U);
	zassert_equal(memfault_mock_value(KEY_MCD_VERSION), 1U);
}

ZTEST(obsv_memfault, test_heartbeat_holds_counters_when_storage_full)
{
	zassert_ok(nrf_edgeai_obsv_update_probs(&ctx, probs));

	memfault_mock_set_storage_full(true);
	zassert_equal(nrf_edgeai_obsv_memfault_collect(), -ENOSPC);
	zassert_equal(memfault_mock_write_count(), 0U, "full storage wrote heartbeat metrics");
	zassert_equal(ctx.state.num_inferences, 1U, "full storage reset the context");

	zassert_ok(nrf_edgeai_obsv_update_probs(&ctx, probs));

	memfault_mock_set_storage_full(false);
	zassert_ok(nrf_edgeai_obsv_memfault_collect());
	zassert_equal(memfault_mock_value(1), 2U, "held-back interval was not carried over");
	zassert_equal(memfault_mock_value(7), 14U);
	zassert_equal(memfault_mock_value(KEY_NUM_INFERENCES), 2U);
	zassert_equal(ctx.state.num_inferences, 0U);
}

ZTEST_SUITE(obsv_memfault, NULL, suite_setup, before_each, NULL, NULL);
```

## src/memfault_mock.c
```c
/*
 * Copyright (c) 2026 Nordic Semiconductor ASA
 *
 * SPDX-License-Identifier: LicenseRef-Nordic-5-Clause
 */

#include <stdbool.h>
#include <string.h>

#include <zephyr/sys/util.h>

#include <memfault/core/event_storage.h>
#include <memfault/metrics/metrics.h>
#include <memfault/metrics/serializer.h>

#define MOCK_HEARTBEAT_WORST_CASE_SIZE 100U

static uint32_t values[18];
static uint32_t write_count;
static size_t storage_free;

void memfault_ncs_metrics_collect_data(void)
{
}

void memfault_mock_reset(void)
{
	memset(values, 0, sizeof(values));
	write_count = 0U;
	storage_free = MOCK_HEARTBEAT_WORST_CASE_SIZE;
}

void memfault_mock_set_storage_full(bool full)
{
	storage_free = full ? MOCK_HEARTBEAT_WORST_CASE_SIZE - 1U : MOCK_HEARTBEAT_WORST_CASE_SIZE;
}

size_t memfault_event_storage_bytes_free(void)
{
	return storage_free;
}

size_t memfault_metrics_heartbeat_compute_worst_case_storage_size(void)
{
	return MOCK_HEARTBEAT_WORST_CASE_SIZE;
}

uint32_t memfault_mock_value(int key)
{
	return values[key];
}

uint32_t memfault_mock_write_count(void)
{
	return write_count;
}

int memfault_metrics_heartbeat_set_unsigned(MemfaultMetricId key, uint32_t value)
{
	if ((key._impl < 0) || (key._impl >= ARRAY_SIZE(values))) {
		return -1;
	}

	values[key._impl] = value;
	write_count++;
	return 0;
}
```

## src/obsv_mock.c
```c
/*
 * Copyright (c) 2026 Nordic Semiconductor ASA
 *
 * SPDX-License-Identifier: LicenseRef-Nordic-5-Clause
 */

#include <string.h>

#include <nrf_edgeai_obsv/nrf_edgeai_obsv.h>

#include "obsv_mock.h"

/*
 * Stateful mock for nrf_edgeai_obsv_encode_list_and_reset().
 *
 * Returns n bytes (one per context), each set to the current call count.
 * The incrementing fill lets tests verify:
 *   - data_size_bytes == n  (correct context count passed through)
 *   - successive collects produce different bytes
 * The call count lets tests verify that a refused collect does not encode.
 * obsv_mock_fail_next() makes one call fail, as an encode error would.
 *
 * Encoding and reset correctness are validated separately in
 * tests/obsv/suite_encoder.c.
 */

static uint8_t s_call_count;
static bool s_fail_next;

void obsv_mock_reset(void)
{
	s_call_count = 0;
	s_fail_next = false;
}

uint8_t obsv_mock_call_count(void)
{
	return s_call_count;
}

void obsv_mock_fail_next(void)
{
	s_fail_next = true;
}

size_t nrf_edgeai_obsv_encode_list_and_reset(nrf_edgeai_obsv_ctx_t *const *ctxs, uint8_t n,
					     uint8_t *buf, size_t buflen)
{
	ARG_UNUSED(ctxs);

	size_t len = (size_t)n * OBSV_MOCK_BYTES_PER_CTX;

	if (s_fail_next) {
		s_fail_next = false;
		return 0;
	}

	if (buflen < len) {
		return 0;
	}

	memset(buf, ++s_call_count, len);
	return len;
}
```

## src/obsv_mock.h
```c
/*
 * Copyright (c) 2026 Nordic Semiconductor ASA
 *
 * SPDX-License-Identifier: LicenseRef-Nordic-5-Clause
 */

#ifndef TEST_OBSV_MEMFAULT_OBSV_MOCK_H
#define TEST_OBSV_MEMFAULT_OBSV_MOCK_H

/** Bytes the mock writes per registered context. */
#define OBSV_MOCK_BYTES_PER_CTX 16U

#include <stdint.h>

/** Reset the call counter. Call from before_each. */
void obsv_mock_reset(void);

/** Number of encode calls since the last obsv_mock_reset(). */
uint8_t obsv_mock_call_count(void);

/** Make the next encode call fail (return 0) without writing to the buffer. */
void obsv_mock_fail_next(void);

#endif /* TEST_OBSV_MEMFAULT_OBSV_MOCK_H */
```
