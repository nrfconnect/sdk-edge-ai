## CMakeLists.txt
```
#
# Copyright (c) 2026 Nordic Semiconductor ASA
#
# SPDX-License-Identifier: LicenseRef-Nordic-5-Clause
#

cmake_minimum_required(VERSION 3.20.0)

find_package(Zephyr REQUIRED HINTS $ENV{ZEPHYR_BASE})

project(test_nrf_edgeai_obsv)

target_sources(app PRIVATE
  src/capture.c
  src/suite_core.c
  src/suite_custom_metric.c
  src/suite_iteration.c
  src/suite_payload.c
  src/suite_user_storage.c
  src/suite_model_certainty_desc.c
  src/suite_class_pred_dist.c
  src/suite_mel_energy_desc.c
  src/suite_mel_spectral_desc.c
)

# Encoder CDDL conformance suite — only built when the encoder is enabled.
if(CONFIG_NRF_EDGEAI_OBSV_ENCODE)
  set(OBSV_LIB ${CMAKE_CURRENT_SOURCE_DIR}/../../lib/nrf_edgeai_obsv)

  # Generate a strict CBOR decoder for obsv-cdr from the authoritative schema
  # so the test can validate nrf_edgeai_obsv_encode_multi_cbor() output without
  # any transport dependency. Regenerated on every configure; CDDL drift fails
  # the build.
  set(OBSV_CDDL ${OBSV_LIB}/obsv.cddl)
  set(CDDL_GEN_DIR ${CMAKE_CURRENT_BINARY_DIR}/cddl_gen)
  set(CDDL_GEN_C ${CDDL_GEN_DIR}/cddl_decode.c)
  set(CDDL_GEN_H ${CDDL_GEN_DIR}/cddl_decode.h)
  set(CDDL_GEN_TYPES_H ${CDDL_GEN_DIR}/cddl_decode_types.h)

  # Capacity of every unbounded CDDL list in the generated decoder.
  set(OBSV_CDDL_MAX_QTY 16)

  find_program(ZCBOR_EXECUTABLE zcbor REQUIRED)

  add_custom_command(
    OUTPUT ${CDDL_GEN_C} ${CDDL_GEN_H} ${CDDL_GEN_TYPES_H}
    COMMAND ${CMAKE_COMMAND} -E make_directory ${CDDL_GEN_DIR}
    COMMAND ${ZCBOR_EXECUTABLE} code
            -c ${OBSV_CDDL}
            -d
            -t obsv-list
            --output-c ${CDDL_GEN_C}
            --output-h ${CDDL_GEN_H}
            --output-h-types ${CDDL_GEN_TYPES_H}
            --default-max-qty ${OBSV_CDDL_MAX_QTY}
    DEPENDS ${OBSV_CDDL}
    COMMENT "Generating CBOR decoder from ${OBSV_CDDL}"
    VERBATIM
  )

  add_custom_target(cddl_gen DEPENDS ${CDDL_GEN_C} ${CDDL_GEN_H} ${CDDL_GEN_TYPES_H})
  add_dependencies(app cddl_gen)

  target_include_directories(app PRIVATE ${CDDL_GEN_DIR})
  target_compile_definitions(app PRIVATE OBSV_CDDL_MAX_QTY=${OBSV_CDDL_MAX_QTY})

  target_sources(app PRIVATE
    src/suite_encoder.c
    ${CDDL_GEN_C}
  )
endif()
```

## prj.conf
```kconfig
CONFIG_ZTEST=y
CONFIG_NRF_EDGEAI_OBSV=y
CONFIG_NRF_EDGEAI_OBSV_MAX_CLASSES=4
CONFIG_NRF_EDGEAI_OBSV_METRIC_CLASS_PRED_DIST=y
CONFIG_NRF_EDGEAI_OBSV_CLASS_PRED_DIST_BIN_NUM=4
CONFIG_NRF_EDGEAI_OBSV_CLASS_PRED_DIST_STREAK_TOP_BIN=5
CONFIG_NRF_EDGEAI_OBSV_CLASS_PRED_DIST_STREAK_TOL=1
CONFIG_NRF_EDGEAI_OBSV_METRIC_TRANSITION_MATRIX=y
CONFIG_NRF_EDGEAI_OBSV_METRIC_MODEL_CERTAINTY_DESC=y
CONFIG_NRF_EDGEAI_OBSV_MODEL_CERTAINTY_DESC_BIN_NUM=4
CONFIG_NRF_EDGEAI_OBSV_METRIC_MEL_ENERGY_DESC=y
CONFIG_NRF_EDGEAI_OBSV_MEL_ENERGY_DESC_BIN_NUM=4
CONFIG_NRF_EDGEAI_OBSV_MEL_ENERGY_DESC_SCALE_P01_MILLI=0
CONFIG_NRF_EDGEAI_OBSV_MEL_ENERGY_DESC_SCALE_P99_MILLI=1000
CONFIG_NRF_EDGEAI_OBSV_METRIC_MEL_SPECTRAL_DESC=y
CONFIG_NRF_EDGEAI_OBSV_MEL_SPECTRAL_DESC_BIN_NUM=4
CONFIG_ZCBOR=y
CONFIG_NRF_EDGEAI_OBSV_ENCODE=y
```

## src/capture.c
```c
/*
 * Copyright (c) 2026 Nordic Semiconductor ASA
 *
 * SPDX-License-Identifier: LicenseRef-Nordic-5-Clause
 */

#include <string.h>

#include <nrf_edgeai_obsv/nrf_edgeai_obsv_metrics.h>

#include "common.h"

/* Copy @n_rows rows starting at row @row_off of @snap into @dst. */
static void copy_rows(struct test_metric_capture *dst,
		      const nrf_edgeai_obsv_metric_snapshot_t *snap,
		      uint16_t row_off, uint16_t n_rows)
{
	dst->present = true;
	dst->metric_id = snap->metric_id;
	dst->version = snap->version;
	dst->num_rows = n_rows;
	dst->num_cols = snap->num_cols;
	dst->config_rows = (snap->config != NULL) ? snap->config_rows : 0;
	dst->config_cols = (snap->config != NULL) ? snap->config_cols : 0;
	if (snap->config != NULL) {
		const size_t cfg_elems = (size_t)snap->config_rows * snap->config_cols;

		zassert_true(cfg_elems <= ARRAY_SIZE(dst->config),
			     "config too large for capture buffer: %zu", cfg_elems);
		memcpy(dst->config, snap->config, cfg_elems * sizeof(dst->config[0]));
	}

	const size_t elems = (size_t)n_rows * snap->num_cols;

	/* ARRAY_SIZE(dst->counts) sized to fit the worst-case
	 * (CONFIG_NRF_EDGEAI_OBSV_MAX_CLASSES * CONFIG_NRF_EDGEAI_OBSV_MAX_CLASSES) matrix.
	 * Anything else would signal a metric growing beyond what the test
	 * capture struct was sized for.
	 */
	zassert_true(elems <= ARRAY_SIZE(dst->counts), "snapshot too large for capture buffer: %zu",
		     elems);

	memcpy(dst->counts, snap->counts + (size_t)row_off * snap->num_cols,
	       elems * sizeof(dst->counts[0]));
}

static void copy_snapshot(struct test_metric_capture *dst,
			  const nrf_edgeai_obsv_metric_snapshot_t *snap)
{
	copy_rows(dst, snap, 0, snap->num_rows);
}

bool test_capture_cb(const nrf_edgeai_obsv_metric_snapshot_t *snap, void *user)
{
	struct test_snapshots *snaps = user;

	snaps->visited++;

	switch (snap->metric_id) {
	case NRF_EDGEAI_OBSV_METRIC_ID_CLASS_PRED_DIST: {
		/* 2*num_classes x bin_num: rows [0, N) probability distribution,
		 * rows [N, 2N) streak distribution. Split into two per-class views.
		 */
		uint16_t n = snap->num_rows / 2U;

		copy_rows(&snaps->probs_distribution, snap, 0, n);
		copy_rows(&snaps->class_streak, snap, n, n);
		break;
	}
	case NRF_EDGEAI_OBSV_METRIC_ID_TRANSITION_MATRIX:
		copy_snapshot(&snaps->transition_matrix, snap);
		break;
	default:
		/* Ignore unknown metric ids so the tests can focus on the
		 * metrics they actually exercise.
		 */
		break;
	}

	return true;
}
```

## src/common.h
```c
/*
 * Copyright (c) 2026 Nordic Semiconductor ASA
 *
 * SPDX-License-Identifier: LicenseRef-Nordic-5-Clause
 */

#ifndef TEST_OBSV_COMMON_H
#define TEST_OBSV_COMMON_H

#include <stdbool.h>
#include <stdint.h>
#include <string.h>

#include <zephyr/ztest.h>

#include <nrf_edgeai_obsv/nrf_edgeai_obsv_core.h>

#define TEST_MODEL_ID	   7
#define TEST_MODEL_VERSION 1
#define TEST_NUM_CLASSES   CONFIG_NRF_EDGEAI_OBSV_MAX_CLASSES
#define TEST_NUM_BINS	   CONFIG_NRF_EDGEAI_OBSV_CLASS_PRED_DIST_BIN_NUM

/* counts[] in test_metric_capture is sized for the largest possible captured
 * view: TM = MAX_CLASSES x MAX_CLASSES, and each half of the class predictions
 * distribution = MAX_CLASSES x BIN_NUM (the capture callback splits the merged
 * 2*MAX_CLASSES x BIN_NUM matrix into its two per-class views). If BIN_NUM ever
 * exceeds MAX_CLASSES the array would be too small.
 */
BUILD_ASSERT(TEST_NUM_BINS <= TEST_NUM_CLASSES,
	     "CLASS_PRED_DIST_BIN_NUM > MAX_CLASSES: enlarge counts[] in test_metric_capture");

/**
 * @brief Per-metric snapshot slot captured by tests.
 *
 * The library hands back a pointer into internal state via
 * nrf_edgeai_obsv_metric_snapshot_t. Tests copy the counters into a local
 * buffer so later updates do not invalidate the data under verification.
 */
struct test_metric_capture {
	bool present;
	uint32_t metric_id;
	uint32_t version;
	uint16_t num_rows;
	uint16_t num_cols;
	uint16_t config_rows;
	uint16_t config_cols;
	int32_t config[8];
	uint32_t counts[TEST_NUM_CLASSES * TEST_NUM_CLASSES];
};

/**
 * @brief Captured snapshots plus a count of visited entries.
 *
 * The class predictions distribution (id 2) is a 2*num_classes x bin_num matrix;
 * test_capture_cb() splits it into its two per-class views, @c probs_distribution
 * (the first num_classes rows) and @c class_streak (the last num_classes rows),
 * so each keeps the num_classes x bin_num shape the tests expect.
 */
struct test_snapshots {
	uint32_t visited;
	struct test_metric_capture probs_distribution;
	struct test_metric_capture class_streak;
	struct test_metric_capture transition_matrix;
};

/**
 * @brief for_each_metric callback that copies snapshots into
 *        @p user (a @c struct test_snapshots pointer) keyed by metric_id.
 */
bool test_capture_cb(const nrf_edgeai_obsv_metric_snapshot_t *snap, void *user);

#endif /* TEST_OBSV_COMMON_H */
```

## src/suite_class_pred_dist.c
```c
/*
 * Copyright (c) 2026 Nordic Semiconductor ASA
 *
 * SPDX-License-Identifier: LicenseRef-Nordic-5-Clause
 */

#include "common.h"

#include <nrf_edgeai_obsv/nrf_edgeai_obsv_metrics.h>

#define CPD_BINS CONFIG_NRF_EDGEAI_OBSV_CLASS_PRED_DIST_BIN_NUM
#define CPD_TOP	 CONFIG_NRF_EDGEAI_OBSV_CLASS_PRED_DIST_STREAK_TOP_BIN
#define CPD_TOL	 CONFIG_NRF_EDGEAI_OBSV_CLASS_PRED_DIST_STREAK_TOL

/*
 * The class predictions distribution is a 2*num_classes x bin_num matrix: rows
 * [0, N) the probability distribution, rows [N, 2N) the streak distribution. This
 * suite exercises the streak half (the probability half is covered by
 * suite_payload.c); capture() returns the class_streak view of test_capture_cb()
 * so cell(row, col) addresses a class's streak-length histogram.
 *
 * The bin/length arithmetic is pinned to a specific configuration so the expected
 * bins are exact. Streak length L is normalised to (L-1)/(TOP-1) and binned
 * uniformly over [0, 1]; with TOP=5 and 4 bins that is:
 *   L=1 -> bin 0, L=2 -> bin 1, L=3 -> bin 2, L=4 -> bin 3, L>=5 -> top bin (3).
 * The testcase variants exercise both the default strict mode (TOLERANCE=0) and
 * flicker bridging (TOLERANCE=1).
 */
BUILD_ASSERT(CPD_BINS == 4, "cpd suite assumes 4 bins");
BUILD_ASSERT(CPD_TOP == 5, "cpd suite assumes TOP=5 (L->bin: 1->0,2->1,3->2,4->3,>=5->top)");
BUILD_ASSERT(CPD_TOL <= 1, "cpd suite covers TOLERANCE=0 and TOLERANCE=1");

/* Build a probability vector of TEST_NUM_CLASSES entries whose argmax is @p cls. */
static void make_probs(float *probs, uint16_t cls)
{
	for (uint16_t i = 0; i < TEST_NUM_CLASSES; i++) {
		probs[i] = 0.1f;
	}
	probs[cls] = 0.9f;
}

static nrf_edgeai_obsv_core_t ctx;
static uint32_t cpd_buf[NRF_EDGEAI_OBSV_CPD_STORAGE_BYTES(TEST_NUM_CLASSES) / sizeof(uint32_t)];
static nrf_edgeai_obsv_metric_t cpd_metric;

static void cpd_setup(void *fixture)
{
	ARG_UNUSED(fixture);

	const nrf_edgeai_obsv_model_info_t model = {
		.model_id = TEST_MODEL_ID,
		.num_classes = TEST_NUM_CLASSES,
		.version = TEST_MODEL_VERSION,
	};

	zassert_ok(nrf_edgeai_obsv_core_init(&ctx, &model));

	nrf_edgeai_obsv_metric_cpd_create(&cpd_metric, cpd_buf, TEST_NUM_CLASSES);
	zassert_ok(nrf_edgeai_obsv_core_register(&ctx, &cpd_metric, NULL));
}

/* Feed a sequence of argmax classes, one inference per entry. */
static void feed(const uint16_t *classes, size_t n)
{
	float probs[TEST_NUM_CLASSES];

	for (size_t i = 0; i < n; i++) {
		make_probs(probs, classes[i]);
		zassert_ok(nrf_edgeai_obsv_core_update_probs(&ctx, probs));
	}
}

/* End the current streak by exhausting the configured mismatch tolerance. */
static void break_streak(uint16_t cls)
{
	for (uint16_t i = 0; i <= CPD_TOL; i++) {
		feed(&cls, 1);
	}
}

static struct test_metric_capture capture(void)
{
	struct test_snapshots snaps = {0};

	zassert_ok(nrf_edgeai_obsv_core_for_each_metric(&ctx, test_capture_cb, &snaps));
	zassert_true(snaps.class_streak.present,
		     "class predictions distribution snapshot not visited");

	return snaps.class_streak;
}

/* A cell of the streak sub-block: row = class index, col = streak-length bin. */
static uint32_t cell(const struct test_metric_capture *cap, uint16_t row, uint16_t col)
{
	return cap->counts[(size_t)row * cap->num_cols + col];
}

static uint32_t total(const struct test_metric_capture *cap)
{
	uint32_t sum = 0;

	for (size_t i = 0; i < (size_t)cap->num_rows * cap->num_cols; i++) {
		sum += cap->counts[i];
	}
	return sum;
}

ZTEST_SUITE(obsv_cpd, NULL, NULL, cpd_setup, NULL, NULL);

/* Snapshot shape and identity: 2*num_classes x bin_num, id 2, version 1. */
ZTEST(obsv_cpd, test_snapshot_shape)
{
	struct test_metric_capture cap = capture();

	zassert_equal(cap.metric_id, NRF_EDGEAI_OBSV_METRIC_ID_CLASS_PRED_DIST);
	zassert_equal(cap.version, 1);
	zassert_equal(cap.num_rows, TEST_NUM_CLASSES, "streak half must be num_classes rows");
	zassert_equal(cap.num_cols, CPD_BINS);
	zassert_equal(total(&cap), 0, "no streak has completed yet");
}

/* create() stores the configured dimensions/config in the storage header. */
ZTEST(obsv_cpd, test_header_config)
{
	const _nrf_obsv_cpd_hdr_t *h = (const _nrf_obsv_cpd_hdr_t *)cpd_buf;

	zassert_equal(h->num_classes, TEST_NUM_CLASSES);
	zassert_equal(h->bin_num, CPD_BINS);
	zassert_equal(h->cfg[NRF_EDGEAI_OBSV_CPD_CFG_STREAK_TOP], CPD_TOP);
	zassert_equal(h->cfg[NRF_EDGEAI_OBSV_CPD_CFG_STREAK_TOL], CPD_TOL);
}

/* The snapshot reports the streak top and tolerance the counters were gathered with. */
ZTEST(obsv_cpd, test_snapshot_reports_config)
{
	struct test_metric_capture cap = capture();

	zassert_equal(cap.config_rows, 1);
	zassert_equal(cap.config_cols, NRF_EDGEAI_OBSV_CPD_CFG_COUNT);
	zassert_equal(cap.config[NRF_EDGEAI_OBSV_CPD_CFG_STREAK_TOP], CPD_TOP);
	zassert_equal(cap.config[NRF_EDGEAI_OBSV_CPD_CFG_STREAK_TOL], CPD_TOL);
}

/* The probability sub-block accumulates one sample per class per inference. */
ZTEST(obsv_cpd, test_probability_rows_sum_to_n)
{
	const uint16_t seq[] = {0, 1, 2};

	feed(seq, ARRAY_SIZE(seq));

	/* Read the probability sub-block directly (rows [0, N)). */
	struct test_snapshots snaps = {0};

	zassert_ok(nrf_edgeai_obsv_core_for_each_metric(&ctx, test_capture_cb, &snaps));
	zassert_true(snaps.probs_distribution.present);
	zassert_equal(snaps.probs_distribution.num_rows, TEST_NUM_CLASSES);

	const struct test_metric_capture *pd = &snaps.probs_distribution;

	for (uint16_t c = 0; c < pd->num_rows; c++) {
		uint32_t row_sum = 0;

		for (uint16_t b = 0; b < pd->num_cols; b++) {
			row_sum += pd->counts[(size_t)c * pd->num_cols + b];
		}
		zassert_equal(row_sum, ARRAY_SIZE(seq),
			      "every probability row must total the inference count");
	}
}

/* A streak still in progress is not recorded until it ends. */
ZTEST(obsv_cpd, test_active_streak_not_recorded)
{
	const uint16_t seq[] = {0, 0, 0, 0, 0};

	feed(seq, ARRAY_SIZE(seq));

	struct test_metric_capture cap = capture();

	zassert_equal(total(&cap), 0, "an unfinished streak must not be binned");
}

/* Streak length maps to the expected bin (TOP=5, 4 bins). */
ZTEST(obsv_cpd, test_length_one_lands_in_bin0)
{
	const uint16_t seq[] = {0};

	feed(seq, ARRAY_SIZE(seq));
	break_streak(1);

	struct test_metric_capture cap = capture();

	zassert_equal(cell(&cap, 0, 0), 1, "length-1 streak must land in bin 0");
	zassert_equal(total(&cap), 1);
}

ZTEST(obsv_cpd, test_length_two_lands_in_bin1)
{
	const uint16_t seq[] = {0, 0};

	feed(seq, ARRAY_SIZE(seq));
	break_streak(2);

	struct test_metric_capture cap = capture();

	zassert_equal(cell(&cap, 0, 1), 1, "length-2 streak must land in bin 1");
	zassert_equal(total(&cap), 1);
}

ZTEST(obsv_cpd, test_length_three_lands_in_bin2)
{
	const uint16_t seq[] = {0, 0, 0};

	feed(seq, ARRAY_SIZE(seq));
	break_streak(2);

	struct test_metric_capture cap = capture();

	zassert_equal(cell(&cap, 0, 2), 1, "length-3 streak must land in bin 2");
	zassert_equal(total(&cap), 1);
}

ZTEST(obsv_cpd, test_length_four_lands_in_top_bin)
{
	const uint16_t seq[] = {0, 0, 0, 0};

	feed(seq, ARRAY_SIZE(seq));
	break_streak(2);

	struct test_metric_capture cap = capture();

	zassert_equal(cell(&cap, 0, CPD_BINS - 1), 1, "length-4 streak must land in the top bin");
	zassert_equal(total(&cap), 1);
}

/* A run longer than TOP saturates (caps at TOP) and still lands in the top bin. */
ZTEST(obsv_cpd, test_long_streak_caps_in_top_bin)
{
	const uint16_t seq[] = {0, 0, 0, 0, 0, 0, 0, 0, 0, 0};

	feed(seq, ARRAY_SIZE(seq));
	break_streak(2);

	struct test_metric_capture cap = capture();

	zassert_equal(cell(&cap, 0, CPD_BINS - 1), 1, "capped streak must land in the top bin");
	zassert_equal(total(&cap), 1);
}

#if CPD_TOL == 0
/* Strict mode is the Kconfig default: the first mismatch ends the active streak. */
ZTEST(obsv_cpd, test_strict_mode_first_mismatch_breaks)
{
	const uint16_t seq[] = {0, 1};

	feed(seq, ARRAY_SIZE(seq));

	struct test_metric_capture cap = capture();

	zassert_equal(cell(&cap, 0, 0), 1, "first mismatch must close the length-1 streak");
	zassert_equal(total(&cap), 1);
}
#endif

#if CPD_TOL == 1
/*
 * A single interposed mismatch is bridged (TOLERANCE=1) and is NOT counted into
 * the length: {0,0,1,0,2,2} is a class-0 streak of length 3 (three 0s; the lone
 * 1 is bridged), so it lands in bin 2 — not bin 3, which is where length 4 (the
 * value it would have had if the bridged frame were counted) would go.
 */
ZTEST(obsv_cpd, test_single_mismatch_is_bridged_not_counted)
{
	const uint16_t seq[] = {0, 0, 1, 0, 2, 2};

	feed(seq, ARRAY_SIZE(seq));

	struct test_metric_capture cap = capture();

	zassert_equal(cell(&cap, 0, 2), 1, "bridged flicker must not add to the length");
	zassert_equal(total(&cap), 1);
}

/*
 * The tolerance boundary: one mismatch only bridges (nothing recorded yet); the
 * second consecutive mismatch ends the streak and records it.
 */
ZTEST(obsv_cpd, test_two_consecutive_mismatches_break)
{
	const uint16_t run[] = {0, 0, 0};

	feed(run, ARRAY_SIZE(run));

	struct test_metric_capture cap = capture();

	zassert_equal(total(&cap), 0, "active streak: nothing recorded");

	const uint16_t one_miss[] = {1};

	feed(one_miss, ARRAY_SIZE(one_miss));
	cap = capture();
	zassert_equal(total(&cap), 0, "a single mismatch is only bridged, not a break");

	const uint16_t second_miss[] = {1};

	feed(second_miss, ARRAY_SIZE(second_miss));
	cap = capture();

	zassert_equal(cell(&cap, 0, 2), 1, "2nd consecutive mismatch closes the len-3 streak");
	zassert_equal(total(&cap), 1);
}

/*
 * The frames that break a streak seed a new one for their own class, including the
 * bridged frames of the same class, and rows are independent. {0,0,1,1,1,1,2,2}:
 *   - 0,0 then bridged 1 then breaking 1 -> class 0 streak length 2 (bin 1);
 *   - the bridged + breaking 1s seed class 1 (length 2), extended by two more 1s
 *     -> length 4 (bin 3);
 *   - bridged 2 then breaking 2 closes it.
 */
ZTEST(obsv_cpd, test_break_seeds_new_streak_and_rows_are_independent)
{
	const uint16_t seq[] = {0, 0, 1, 1, 1, 1, 2, 2};

	feed(seq, ARRAY_SIZE(seq));

	struct test_metric_capture cap = capture();

	zassert_equal(cell(&cap, 0, 1), 1, "class 0: length-2 streak in bin 1");
	zassert_equal(cell(&cap, 1, 3), 1, "class 1 incl. bridged frame: len-4 in bin 3");
	zassert_equal(total(&cap), 2, "exactly two streaks completed");
}

/*
 * The bridged frame is not lost when the mismatch turns out to be a real class
 * change: {0,0,0,1,1,1,2,2} -> class 0 length 3 (bin 2); class 1 is bridged 1 +
 * breaking 1 + one more 1 = length 3 (bin 2), not 2 (bin 1).
 */
ZTEST(obsv_cpd, test_bridged_frames_count_toward_new_streak)
{
	const uint16_t seq[] = {0, 0, 0, 1, 1, 1, 2, 2};

	feed(seq, ARRAY_SIZE(seq));

	struct test_metric_capture cap = capture();

	zassert_equal(cell(&cap, 0, 2), 1, "class 0: length-3 streak in bin 2");
	zassert_equal(cell(&cap, 1, 2), 1, "class 1: bridged frame counted, len-3 in bin 2");
	zassert_equal(total(&cap), 2);
}

/* A returning original class discards the bridged frame (true flicker). */
ZTEST(obsv_cpd, test_bridged_frame_discarded_when_original_class_returns)
{
	const uint16_t seq[] = {0, 0, 1, 0, 1, 2, 2};

	feed(seq, ARRAY_SIZE(seq));

	struct test_metric_capture cap = capture();

	/* 0,0,(1),0 -> len 3; (1) bridged; 2 breaks: alt class 1 != 2 so the 2 seeds len 1. */
	zassert_equal(cell(&cap, 0, 2), 1, "class 0: length-3 streak in bin 2");
	zassert_equal(total(&cap), 1);
}
#endif

/* reset() zeroes counters and clears the in-progress streak state. */
ZTEST(obsv_cpd, test_reset_clears_counters_and_state)
{
	const uint16_t seq[] = {0, 0, 1, 1};

	feed(seq, ARRAY_SIZE(seq));

	struct test_metric_capture cap = capture();

	zassert_equal(total(&cap), 1, "sanity: one streak recorded before reset");

	zassert_ok(nrf_edgeai_obsv_core_reset(&ctx));
	cap = capture();
	zassert_equal(total(&cap), 0, "reset must zero the histogram");

	/* If reset did not clear the active class, the leading 2 would be treated as a
	 * mismatch against the pre-reset class instead of seeding a fresh streak.
	 */
	const uint16_t after[] = {2, 2, 2, 3, 3};

	feed(after, ARRAY_SIZE(after));
	cap = capture();

	zassert_equal(cell(&cap, 2, 2), 1, "post-reset class-2 length-3 streak in bin 2");
	zassert_equal(total(&cap), 1, "reset must forget the previous streak state");
}
```

## src/suite_class_streak_dist.c
```c
/*
 * Copyright (c) 2026 Nordic Semiconductor ASA
 *
 * SPDX-License-Identifier: LicenseRef-Nordic-5-Clause
 */

#include "common.h"

#include <nrf_edgeai_obsv/nrf_edgeai_obsv_metrics.h>

#define CSD_BINS CONFIG_NRF_EDGEAI_OBSV_CLASS_STREAK_DIST_BIN_NUM
#define CSD_TOP	 CONFIG_NRF_EDGEAI_OBSV_CLASS_STREAK_DIST_TOP
#define CSD_TOL	 CONFIG_NRF_EDGEAI_OBSV_CLASS_STREAK_DIST_TOLERANCE

/*
 * The bin/length arithmetic below is pinned to a specific configuration so the
 * expected bins are exact. Streak length L is normalised to (L-1)/(TOP-1) and
 * binned uniformly over [0, 1]; with TOP=5 and 4 bins that is:
 *   L=1 -> bin 0, L=2 -> bin 1, L=3 -> bin 2, L=4 -> bin 3, L>=5 -> top bin (3).
 * TOLERANCE=1 means a single consecutive mismatch is bridged (not counted into
 * the length) while two consecutive mismatches end the streak.
 */
BUILD_ASSERT(CSD_BINS == 4, "csd suite assumes 4 bins");
BUILD_ASSERT(CSD_TOP == 5, "csd suite assumes TOP=5 (L->bin: 1->0,2->1,3->2,4->3,>=5->top)");
BUILD_ASSERT(CSD_TOL == 1, "csd suite assumes TOLERANCE=1");

struct csd_capture {
	bool present;
	uint32_t metric_id;
	uint32_t version;
	uint16_t num_rows;
	uint16_t num_cols;
	uint32_t counts[TEST_NUM_CLASSES * 16];
};

static bool csd_capture_cb(const nrf_edgeai_obsv_metric_snapshot_t *snap, void *user)
{
	struct csd_capture *cap = user;

	if (snap->metric_id != NRF_EDGEAI_OBSV_METRIC_ID_CLASS_STREAK_DIST) {
		return true;
	}

	cap->present = true;
	cap->metric_id = snap->metric_id;
	cap->version = snap->version;
	cap->num_rows = snap->num_rows;
	cap->num_cols = snap->num_cols;

	const size_t cells = (size_t)snap->num_rows * snap->num_cols;

	for (size_t i = 0; i < cells && i < ARRAY_SIZE(cap->counts); i++) {
		cap->counts[i] = snap->counts[i];
	}

	return true;
}

/* Build a probability vector of TEST_NUM_CLASSES entries whose argmax is @p cls. */
static void make_probs(float *probs, uint16_t cls)
{
	for (uint16_t i = 0; i < TEST_NUM_CLASSES; i++) {
		probs[i] = 0.1f;
	}
	probs[cls] = 0.9f;
}

static nrf_edgeai_obsv_core_t ctx;
static uint32_t csd_buf[NRF_EDGEAI_OBSV_CSD_STORAGE_BYTES(TEST_NUM_CLASSES) / sizeof(uint32_t)];
static nrf_edgeai_obsv_metric_t csd_metric;

static void csd_setup(void *fixture)
{
	ARG_UNUSED(fixture);

	const nrf_edgeai_obsv_model_info_t model = {
		.model_id = TEST_MODEL_ID,
		.num_classes = TEST_NUM_CLASSES,
		.version = TEST_MODEL_VERSION,
	};

	zassert_ok(nrf_edgeai_obsv_core_init(&ctx, &model));

	nrf_edgeai_obsv_metric_csd_create(&csd_metric, csd_buf, TEST_NUM_CLASSES);
	zassert_ok(nrf_edgeai_obsv_core_register(&ctx, &csd_metric, NULL));
}

/* Feed a sequence of argmax classes, one inference per entry. */
static void feed(const uint16_t *classes, size_t n)
{
	float probs[TEST_NUM_CLASSES];

	for (size_t i = 0; i < n; i++) {
		make_probs(probs, classes[i]);
		zassert_ok(nrf_edgeai_obsv_core_update_probs(&ctx, probs));
	}
}

static struct csd_capture capture(void)
{
	struct csd_capture cap = {0};

	zassert_ok(nrf_edgeai_obsv_core_for_each_metric(&ctx, csd_capture_cb, &cap));
	zassert_true(cap.present, "CSD metric snapshot not visited");

	return cap;
}

static uint32_t cell(const struct csd_capture *cap, uint16_t row, uint16_t col)
{
	return cap->counts[(size_t)row * cap->num_cols + col];
}

static uint32_t total(const struct csd_capture *cap)
{
	uint32_t sum = 0;

	for (size_t i = 0; i < (size_t)cap->num_rows * cap->num_cols; i++) {
		sum += cap->counts[i];
	}
	return sum;
}

ZTEST_SUITE(obsv_csd, NULL, NULL, csd_setup, NULL, NULL);

/* Snapshot shape and identity: num_classes x bin_num, id 9, version 1. */
ZTEST(obsv_csd, test_snapshot_shape)
{
	struct csd_capture cap = capture();

	zassert_equal(cap.metric_id, NRF_EDGEAI_OBSV_METRIC_ID_CLASS_STREAK_DIST);
	zassert_equal(cap.version, 1);
	zassert_equal(cap.num_rows, TEST_NUM_CLASSES);
	zassert_equal(cap.num_cols, CSD_BINS);
	zassert_equal(total(&cap), 0, "no streak has completed yet");
}

/* create() stores the configured dimensions/config in the storage header. */
ZTEST(obsv_csd, test_header_config)
{
	const _nrf_obsv_csd_hdr_t *h = (const _nrf_obsv_csd_hdr_t *)csd_buf;

	zassert_equal(h->num_classes, TEST_NUM_CLASSES);
	zassert_equal(h->bin_num, CSD_BINS);
	zassert_equal(h->top, CSD_TOP);
	zassert_equal(h->tolerance, CSD_TOL);
}

/* A streak still in progress is not recorded until it ends. */
ZTEST(obsv_csd, test_active_streak_not_recorded)
{
	const uint16_t seq[] = {0, 0, 0, 0, 0};

	feed(seq, ARRAY_SIZE(seq));

	struct csd_capture cap = capture();

	zassert_equal(total(&cap), 0, "an unfinished streak must not be binned");
}

/*
 * Streak length maps to the expected bin (TOP=5, 4 bins). Each streak is closed
 * by two consecutive mismatches (TOLERANCE=1: one bridged, the second breaks).
 */
ZTEST(obsv_csd, test_length_one_lands_in_bin0)
{
	const uint16_t seq[] = {0, 1, 1}; /* class 0 held for 1 frame, then broken */

	feed(seq, ARRAY_SIZE(seq));

	struct csd_capture cap = capture();

	zassert_equal(cell(&cap, 0, 0), 1, "length-1 streak must land in bin 0");
	zassert_equal(total(&cap), 1);
}

ZTEST(obsv_csd, test_length_two_lands_in_bin1)
{
	const uint16_t seq[] = {0, 0, 2, 2};

	feed(seq, ARRAY_SIZE(seq));

	struct csd_capture cap = capture();

	zassert_equal(cell(&cap, 0, 1), 1, "length-2 streak must land in bin 1");
	zassert_equal(total(&cap), 1);
}

ZTEST(obsv_csd, test_length_three_lands_in_bin2)
{
	const uint16_t seq[] = {0, 0, 0, 2, 2};

	feed(seq, ARRAY_SIZE(seq));

	struct csd_capture cap = capture();

	zassert_equal(cell(&cap, 0, 2), 1, "length-3 streak must land in bin 2");
	zassert_equal(total(&cap), 1);
}

ZTEST(obsv_csd, test_length_four_lands_in_top_bin)
{
	const uint16_t seq[] = {0, 0, 0, 0, 2, 2};

	feed(seq, ARRAY_SIZE(seq));

	struct csd_capture cap = capture();

	zassert_equal(cell(&cap, 0, CSD_BINS - 1), 1, "length-4 streak must land in the top bin");
	zassert_equal(total(&cap), 1);
}

/* A run longer than TOP saturates (caps at TOP) and still lands in the top bin. */
ZTEST(obsv_csd, test_long_streak_caps_in_top_bin)
{
	const uint16_t seq[] = {0, 0, 0, 0, 0, 0, 0, 0, 0, 0, 2, 2}; /* 10x class 0 */

	feed(seq, ARRAY_SIZE(seq));

	struct csd_capture cap = capture();

	zassert_equal(cell(&cap, 0, CSD_BINS - 1), 1, "capped streak must land in the top bin");
	zassert_equal(total(&cap), 1);
}

/*
 * A single interposed mismatch is bridged (TOLERANCE=1) and is NOT counted into
 * the length: {0,0,1,0,2,2} is a class-0 streak of length 3 (three 0s; the lone
 * 1 is bridged), so it lands in bin 2 — not bin 3, which is where length 4 (the
 * value it would have had if the bridged frame were counted) would go.
 */
ZTEST(obsv_csd, test_single_mismatch_is_bridged_not_counted)
{
	const uint16_t seq[] = {0, 0, 1, 0, 2, 2};

	feed(seq, ARRAY_SIZE(seq));

	struct csd_capture cap = capture();

	zassert_equal(cell(&cap, 0, 2), 1, "bridged flicker must not add to the length");
	zassert_equal(total(&cap), 1);
}

/*
 * The tolerance boundary: one mismatch only bridges (nothing recorded yet); the
 * second consecutive mismatch ends the streak and records it.
 */
ZTEST(obsv_csd, test_two_consecutive_mismatches_break)
{
	const uint16_t run[] = {0, 0, 0};

	feed(run, ARRAY_SIZE(run));

	struct csd_capture cap = capture();

	zassert_equal(total(&cap), 0, "active streak: nothing recorded");

	const uint16_t one_miss[] = {1};

	feed(one_miss, ARRAY_SIZE(one_miss));
	cap = capture();
	zassert_equal(total(&cap), 0, "a single mismatch is only bridged, not a break");

	const uint16_t second_miss[] = {1};

	feed(second_miss, ARRAY_SIZE(second_miss));
	cap = capture();

	zassert_equal(cell(&cap, 0, 2), 1, "2nd consecutive mismatch closes the len-3 streak");
	zassert_equal(total(&cap), 1);
}

/*
 * The frame that breaks a streak seeds a new one for its own class, and rows are
 * independent. {0,0,1,1,1,1,2,2}:
 *   - 0,0 then bridged 1 then breaking 1 -> class 0 streak length 2 (bin 1);
 *   - the breaking 1 seeds class 1, extended by two more 1s -> length 3 (bin 2);
 *   - bridged 2 then breaking 2 closes it.
 */
ZTEST(obsv_csd, test_break_seeds_new_streak_and_rows_are_independent)
{
	const uint16_t seq[] = {0, 0, 1, 1, 1, 1, 2, 2};

	feed(seq, ARRAY_SIZE(seq));

	struct csd_capture cap = capture();

	zassert_equal(cell(&cap, 0, 1), 1, "class 0: length-2 streak in bin 1");
	zassert_equal(cell(&cap, 1, 2), 1, "class 1 seeded by breaking frame: len-3 in bin 2");
	zassert_equal(total(&cap), 2, "exactly two streaks completed");
}

/* reset() zeroes counters and clears the in-progress streak state. */
ZTEST(obsv_csd, test_reset_clears_counters_and_state)
{
	const uint16_t seq[] = {0, 0, 1, 1};

	feed(seq, ARRAY_SIZE(seq));

	struct csd_capture cap = capture();

	zassert_equal(total(&cap), 1, "sanity: one streak recorded before reset");

	zassert_ok(nrf_edgeai_obsv_core_reset(&ctx));
	cap = capture();
	zassert_equal(total(&cap), 0, "reset must zero the histogram");

	/* If reset did not clear the active class, the leading 2 would be treated as a
	 * mismatch against the pre-reset class instead of seeding a fresh streak.
	 */
	const uint16_t after[] = {2, 2, 2, 3, 3};

	feed(after, ARRAY_SIZE(after));
	cap = capture();

	zassert_equal(cell(&cap, 2, 2), 1, "post-reset class-2 length-3 streak in bin 2");
	zassert_equal(total(&cap), 1, "reset must forget the previous streak state");
}
```

## src/suite_core.c
```c
/*
 * Copyright (c) 2026 Nordic Semiconductor ASA
 *
 * SPDX-License-Identifier: LicenseRef-Nordic-5-Clause
 */

#include "common.h"

static nrf_edgeai_obsv_core_t ctx;

static const nrf_edgeai_obsv_model_info_t test_model = {
	.model_id = TEST_MODEL_ID,
	.num_classes = TEST_NUM_CLASSES,
	.version = TEST_MODEL_VERSION,
};

/* Per-file metric instances — each test that needs a metric uses these.
 * Using distinct instances per test suite file means no cross-suite state.
 */
static uint32_t core_pd_buf[NRF_EDGEAI_OBSV_CPD_STORAGE_BYTES(TEST_NUM_CLASSES) /
			     sizeof(uint32_t)];
static uint32_t core_tm_buf[NRF_EDGEAI_OBSV_TM_STORAGE_BYTES(TEST_NUM_CLASSES) /
			     sizeof(uint32_t)];
static nrf_edgeai_obsv_metric_t core_pd;
static nrf_edgeai_obsv_metric_t core_tm;

static uint32_t iso_pd_a_buf[NRF_EDGEAI_OBSV_CPD_STORAGE_BYTES(TEST_NUM_CLASSES) /
			      sizeof(uint32_t)];
static uint32_t iso_pd_b_buf[NRF_EDGEAI_OBSV_CPD_STORAGE_BYTES(TEST_NUM_CLASSES) /
			      sizeof(uint32_t)];
static nrf_edgeai_obsv_metric_t iso_pd_a;
static nrf_edgeai_obsv_metric_t iso_pd_b;

static void core_before(void *fixture)
{
	ARG_UNUSED(fixture);
	memset(&ctx, 0, sizeof(ctx));
	nrf_edgeai_obsv_core_init(&ctx, &test_model);
	nrf_edgeai_obsv_metric_cpd_create(&core_pd, core_pd_buf, TEST_NUM_CLASSES);
	nrf_edgeai_obsv_metric_tm_create(&core_tm, core_tm_buf, TEST_NUM_CLASSES);
	nrf_edgeai_obsv_metric_cpd_create(&iso_pd_a, iso_pd_a_buf, TEST_NUM_CLASSES);
	nrf_edgeai_obsv_metric_cpd_create(&iso_pd_b, iso_pd_b_buf, TEST_NUM_CLASSES);
}

ZTEST_SUITE(obsv_core, NULL, NULL, core_before, NULL, NULL);

ZTEST(obsv_core, test_init_copies_model)
{
	zassert_equal(ctx.model.model_id, TEST_MODEL_ID);
	zassert_equal(ctx.model.num_classes, TEST_NUM_CLASSES);
	zassert_equal(ctx.model.version, TEST_MODEL_VERSION);
}

ZTEST(obsv_core, test_init_zeroes_state)
{
	zassert_is_null(ctx.p_metrics_list);
	zassert_equal(ctx.num_inferences, 0);
	zassert_equal(ctx.num_features, 0);
	zassert_equal(ctx.num_metrics, 0);
}

ZTEST(obsv_core, test_init_null_ctx)
{
	int rc = nrf_edgeai_obsv_core_init(NULL, &test_model);

	zassert_true(rc < 0, "expected error on NULL ctx");
}

ZTEST(obsv_core, test_init_null_model)
{
	nrf_edgeai_obsv_core_t local;
	int rc = nrf_edgeai_obsv_core_init(&local, NULL);

	zassert_true(rc < 0, "expected error on NULL model");
}

ZTEST(obsv_core, test_init_num_classes_exceeds_max)
{
	nrf_edgeai_obsv_core_t local;
	const nrf_edgeai_obsv_model_info_t bad_model = {
		.model_id = 1,
		.num_classes = CONFIG_NRF_EDGEAI_OBSV_MAX_CLASSES + 1,
		.version = 1,
	};
	int rc = nrf_edgeai_obsv_core_init(&local, &bad_model);

	zassert_equal(rc, -EINVAL, "expected -EINVAL when num_classes exceeds max");
}

ZTEST(obsv_core, test_register_single_metric)
{
	int rc = nrf_edgeai_obsv_core_register(&ctx, &core_pd, NULL);

	zassert_equal(rc, 0);
	zassert_equal(ctx.num_metrics, 1);
	zassert_equal_ptr(ctx.p_metrics_list, &core_pd);
}

ZTEST(obsv_core, test_register_two_metrics)
{
	nrf_edgeai_obsv_core_register(&ctx, &core_pd, NULL);
	nrf_edgeai_obsv_core_register(&ctx, &core_tm, NULL);

	zassert_equal(ctx.num_metrics, 2);
	zassert_equal_ptr(ctx.p_metrics_list, &core_pd);
	zassert_equal_ptr(core_pd.p_next, &core_tm);
	zassert_is_null(core_tm.p_next);
}

ZTEST(obsv_core, test_register_null_params)
{
	zassert_true(nrf_edgeai_obsv_core_register(NULL, &core_pd, NULL) < 0);
	zassert_true(nrf_edgeai_obsv_core_register(&ctx, NULL, NULL) < 0);
}

ZTEST(obsv_core, test_deregister_head)
{
	nrf_edgeai_obsv_core_register(&ctx, &core_pd, NULL);
	nrf_edgeai_obsv_core_register(&ctx, &core_tm, NULL);
	nrf_edgeai_obsv_core_deregister(&ctx, &core_pd);

	zassert_equal(ctx.num_metrics, 1);
	zassert_equal_ptr(ctx.p_metrics_list, &core_tm);
	zassert_is_null(core_pd.p_next);
}

ZTEST(obsv_core, test_deregister_tail)
{
	nrf_edgeai_obsv_core_register(&ctx, &core_pd, NULL);
	nrf_edgeai_obsv_core_register(&ctx, &core_tm, NULL);
	nrf_edgeai_obsv_core_deregister(&ctx, &core_tm);

	zassert_equal(ctx.num_metrics, 1);
	zassert_equal_ptr(ctx.p_metrics_list, &core_pd);
	zassert_is_null(core_pd.p_next);
}

ZTEST(obsv_core, test_deregister_absent_is_noop)
{
	nrf_edgeai_obsv_core_register(&ctx, &core_pd, NULL);
	nrf_edgeai_obsv_core_deregister(&ctx, &core_tm);

	zassert_equal(ctx.num_metrics, 1);
	zassert_equal_ptr(ctx.p_metrics_list, &core_pd);
}

ZTEST(obsv_core, test_update_increments_counter)
{
	nrf_edgeai_obsv_core_register(&ctx, &core_pd, NULL);

	const float probs[TEST_NUM_CLASSES] = {0.25f, 0.25f, 0.25f, 0.25f};

	nrf_edgeai_obsv_core_update_probs(&ctx, probs);
	nrf_edgeai_obsv_core_update_probs(&ctx, probs);
	nrf_edgeai_obsv_core_update_probs(&ctx, probs);

	zassert_equal(ctx.num_inferences, 3);
}

ZTEST(obsv_core, test_update_features_increments_counter)
{
	const float feats[4] = {0.1f, 0.2f, 0.3f, 0.4f};
	const float probs[TEST_NUM_CLASSES] = {0.25f, 0.25f, 0.25f, 0.25f};

	nrf_edgeai_obsv_core_update_features(&ctx, feats, ARRAY_SIZE(feats));
	nrf_edgeai_obsv_core_update_features(&ctx, feats, ARRAY_SIZE(feats));

	zassert_equal(ctx.num_features, 2U);
	zassert_equal(ctx.num_inferences, 0U, "feature updates must not count inferences");

	/* The two stream counters are independent. */
	nrf_edgeai_obsv_core_update_probs(&ctx, probs);

	zassert_equal(ctx.num_inferences, 1U);
	zassert_equal(ctx.num_features, 2U, "inference updates must not count features");
}

ZTEST(obsv_core, test_update_features_null_params)
{
	const float feats[4] = {0.1f, 0.2f, 0.3f, 0.4f};

	zassert_true(nrf_edgeai_obsv_core_update_features(NULL, feats, ARRAY_SIZE(feats)) < 0);
	zassert_true(nrf_edgeai_obsv_core_update_features(&ctx, NULL, ARRAY_SIZE(feats)) < 0);
}

ZTEST(obsv_core, test_update_null_params)
{
	const float probs[TEST_NUM_CLASSES] = {0.25f, 0.25f, 0.25f, 0.25f};

	zassert_true(nrf_edgeai_obsv_core_update_probs(NULL, probs) < 0);
	zassert_true(nrf_edgeai_obsv_core_update_probs(&ctx, NULL) < 0);
}

ZTEST(obsv_core, test_reset_clears_inferences)
{
	nrf_edgeai_obsv_core_register(&ctx, &core_pd, NULL);

	const float probs[TEST_NUM_CLASSES] = {1.0f, 0.0f, 0.0f, 0.0f};
	const float feats[4] = {0.1f, 0.2f, 0.3f, 0.4f};

	nrf_edgeai_obsv_core_update_probs(&ctx, probs);
	nrf_edgeai_obsv_core_update_features(&ctx, feats, ARRAY_SIZE(feats));
	nrf_edgeai_obsv_core_reset(&ctx);

	zassert_equal(ctx.num_inferences, 0);
	zassert_equal(ctx.num_features, 0);
	zassert_equal(ctx.num_metrics, 1, "reset must keep metrics");
	zassert_equal(ctx.model.model_id, TEST_MODEL_ID, "reset must keep model");
}

/*
 * Two-context isolation test: feed inferences into model A only and verify
 * that model B's metric state remains zero. Each context uses its own metric
 * instance (no shared static storage).
 */
ZTEST(obsv_core, test_two_contexts_no_shared_state)
{
	nrf_edgeai_obsv_core_t ctx_a;
	nrf_edgeai_obsv_core_t ctx_b;

	const nrf_edgeai_obsv_model_info_t model_a = {
		.model_id = 10U,
		.num_classes = TEST_NUM_CLASSES,
		.version = 1U,
	};
	const nrf_edgeai_obsv_model_info_t model_b = {
		.model_id = 20U,
		.num_classes = TEST_NUM_CLASSES,
		.version = 1U,
	};

	zassert_equal(nrf_edgeai_obsv_core_init(&ctx_a, &model_a), 0);
	zassert_equal(nrf_edgeai_obsv_core_init(&ctx_b, &model_b), 0);

	zassert_equal(nrf_edgeai_obsv_core_register(&ctx_a, &iso_pd_a, NULL), 0);
	zassert_equal(nrf_edgeai_obsv_core_register(&ctx_b, &iso_pd_b, NULL), 0);

	/* Feed 2 inferences exclusively to model A. */
	const float probs[TEST_NUM_CLASSES] = {1.0f, 0.0f, 0.0f, 0.0f};

	nrf_edgeai_obsv_core_update_probs(&ctx_a, probs);
	nrf_edgeai_obsv_core_update_probs(&ctx_a, probs);

	zassert_equal(ctx_a.num_inferences, 2U);
	zassert_equal(ctx_b.num_inferences, 0U);

	/* Snapshot both contexts. */
	struct test_snapshots snaps_a = {0};
	struct test_snapshots snaps_b = {0};

	zassert_equal(nrf_edgeai_obsv_core_for_each_metric(&ctx_a, test_capture_cb, &snaps_a), 0);
	zassert_equal(nrf_edgeai_obsv_core_for_each_metric(&ctx_b, test_capture_cb, &snaps_b), 0);

	/* Sum all histogram entries for each model. */
	uint32_t sum_a = 0;
	uint32_t sum_b = 0;
	uint32_t total_cells =
		(uint32_t)snaps_a.probs_distribution.num_rows * snaps_a.probs_distribution.num_cols;

	for (uint32_t i = 0; i < total_cells; i++) {
		sum_a += snaps_a.probs_distribution.counts[i];
		sum_b += snaps_b.probs_distribution.counts[i];
	}

	zassert_equal(sum_a, 2U * TEST_NUM_CLASSES,
		      "model A must have 2*num_classes histogram entries");
	zassert_equal(sum_b, 0U, "model B must have 0 entries — instances are independent");
}
```

## src/suite_custom_metric.c
```c
/*
 * Copyright (c) 2026 Nordic Semiconductor ASA
 *
 * SPDX-License-Identifier: LicenseRef-Nordic-5-Clause
 */

/**
 * @file suite_custom_metric.c
 * @brief Tests for application-defined metrics (not the stock probs / TM descriptors).
 */

#include <stdbool.h>
#include <stdint.h>
#include <string.h>

#include <zephyr/ztest.h>

#include "common.h"

/** Outside the built-in metric ID range. */
#define CUSTOM_METRIC_ID  100U
#define CUSTOM_METRIC_VER 1U

static nrf_edgeai_obsv_core_t ctx;

static const nrf_edgeai_obsv_model_info_t test_model = {
	.model_id = TEST_MODEL_ID,
	.num_classes = TEST_NUM_CLASSES,
	.version = TEST_MODEL_VERSION,
};

static uint32_t custom_counter;
static uint32_t custom_shadow[1];

static void custom_init(const void *cfg, void *priv)
{
	ARG_UNUSED(cfg);
	ARG_UNUSED(priv);
	custom_counter = 0U;
}

static void custom_clear(void *priv)
{
	ARG_UNUSED(priv);
	custom_counter = 0U;
}

static void custom_update(const float *p_probs, uint16_t n, void *priv)
{
	ARG_UNUSED(p_probs);
	ARG_UNUSED(n);
	ARG_UNUSED(priv);
	custom_counter++;
}

static void custom_snapshot(nrf_edgeai_obsv_metric_snapshot_t *out, void *priv)
{
	ARG_UNUSED(priv);
	custom_shadow[0] = custom_counter;

	out->metric_id = CUSTOM_METRIC_ID;
	out->version = CUSTOM_METRIC_VER;
	out->num_rows = 1U;
	out->num_cols = 1U;
	out->counts = custom_shadow;
}

static nrf_edgeai_obsv_metric_t custom_metric = {
	.init = custom_init,
	.update = custom_update,
	.clear = custom_clear,
	.finalize = NULL,
	.snapshot = custom_snapshot,
	.priv = NULL,
	.p_next = NULL,
};

/* Built-in metric instance for this test suite. */
static uint32_t custom_suite_pd_buf[NRF_EDGEAI_OBSV_CPD_STORAGE_BYTES(TEST_NUM_CLASSES) /
				    sizeof(uint32_t)];
static nrf_edgeai_obsv_metric_t custom_suite_pd;

static void custom_before(void *fixture)
{
	ARG_UNUSED(fixture);
	memset(&ctx, 0, sizeof(ctx));
	nrf_edgeai_obsv_core_init(&ctx, &test_model);
	nrf_edgeai_obsv_metric_cpd_create(&custom_suite_pd, custom_suite_pd_buf, TEST_NUM_CLASSES);
}

ZTEST_SUITE(obsv_custom_metric, NULL, NULL, custom_before, NULL, NULL);

struct verify_custom_user {
	bool ok;
};

static bool verify_custom_snap_cb(const nrf_edgeai_obsv_metric_snapshot_t *snap, void *user)
{
	struct verify_custom_user *v = user;

	zassert_equal(snap->metric_id, CUSTOM_METRIC_ID);
	zassert_equal(snap->version, CUSTOM_METRIC_VER);
	zassert_equal(snap->num_rows, 1U);
	zassert_equal(snap->num_cols, 1U);
	zassert_equal(snap->counts[0], 2U);
	/* A metric that sets no config must read as "none": the core zeroes the snapshot. */
	zassert_is_null(snap->config);
	zassert_equal(snap->config_rows, 0U);
	v->ok = true;
	return true;
}

ZTEST(obsv_custom_metric, test_register_update_snapshot)
{
	zassert_equal(nrf_edgeai_obsv_core_register(&ctx, &custom_metric, NULL), 0);
	zassert_equal(ctx.num_metrics, 1U);

	const float probs[TEST_NUM_CLASSES] = {0.25f, 0.25f, 0.25f, 0.25f};

	nrf_edgeai_obsv_core_update_probs(&ctx, probs);
	nrf_edgeai_obsv_core_update_probs(&ctx, probs);

	zassert_equal(ctx.num_inferences, 2U);

	struct verify_custom_user vu = {.ok = false};

	zassert_equal(nrf_edgeai_obsv_core_for_each_metric(&ctx, verify_custom_snap_cb, &vu), 0);
	zassert_true(vu.ok, "custom metric snapshot not observed");
}

struct dual_verify {
	bool saw_probs;
	bool saw_custom;
};

static bool dual_capture_cb(const nrf_edgeai_obsv_metric_snapshot_t *snap, void *user)
{
	struct dual_verify *v = user;

	if (snap->metric_id == NRF_EDGEAI_OBSV_METRIC_ID_CLASS_PRED_DIST) {
		v->saw_probs = true;
	} else if (snap->metric_id == CUSTOM_METRIC_ID) {
		zassert_equal(snap->counts[0], 1U);
		v->saw_custom = true;
	}
	return true;
}

ZTEST(obsv_custom_metric, test_custom_alongside_builtin)
{
	zassert_equal(nrf_edgeai_obsv_core_register(&ctx, &custom_suite_pd, NULL), 0);
	zassert_equal(nrf_edgeai_obsv_core_register(&ctx, &custom_metric, NULL), 0);
	zassert_equal(ctx.num_metrics, 2U);

	const float probs[TEST_NUM_CLASSES] = {0.25f, 0.25f, 0.25f, 0.25f};

	nrf_edgeai_obsv_core_update_probs(&ctx, probs);

	zassert_equal(ctx.num_inferences, 1U);

	struct dual_verify dv = {
		.saw_probs = false,
		.saw_custom = false,
	};

	zassert_equal(nrf_edgeai_obsv_core_for_each_metric(&ctx, dual_capture_cb, &dv), 0);
	zassert_true(dv.saw_probs, "built-in probs metric missing from traversal");
	zassert_true(dv.saw_custom, "custom metric missing from traversal");
}

static bool read_custom_snap_after_reset_cb(const nrf_edgeai_obsv_metric_snapshot_t *snap,
					    void *user)
{
	bool *zero_snap = user;

	if (snap->metric_id == CUSTOM_METRIC_ID) {
		*zero_snap = (snap->counts[0] == 0U);
	}
	return true;
}

ZTEST(obsv_custom_metric, test_reset_reinitializes_custom)
{
	zassert_equal(nrf_edgeai_obsv_core_register(&ctx, &custom_metric, NULL), 0);

	const float probs[TEST_NUM_CLASSES] = {0.25f, 0.25f, 0.25f, 0.25f};

	nrf_edgeai_obsv_core_update_probs(&ctx, probs);
	zassert_equal(custom_counter, 1U);

	zassert_equal(nrf_edgeai_obsv_core_reset(&ctx), 0);

	bool zero_snap = false;
	int fe_ret = nrf_edgeai_obsv_core_for_each_metric(&ctx, read_custom_snap_after_reset_cb,
							  &zero_snap);

	zassert_equal(fe_ret, 0);
	zassert_true(zero_snap, "reset did not re-init custom metric counters");
}
```

## src/suite_iteration.c
```c
/*
 * Copyright (c) 2026 Nordic Semiconductor ASA
 *
 * SPDX-License-Identifier: LicenseRef-Nordic-5-Clause
 */

#include "common.h"

static nrf_edgeai_obsv_core_t ctx;

static const nrf_edgeai_obsv_model_info_t test_model = {
	.model_id = TEST_MODEL_ID,
	.num_classes = TEST_NUM_CLASSES,
	.version = TEST_MODEL_VERSION,
};

static uint32_t iter_pd_buf[NRF_EDGEAI_OBSV_CPD_STORAGE_BYTES(TEST_NUM_CLASSES) /
			     sizeof(uint32_t)];
static uint32_t iter_tm_buf[NRF_EDGEAI_OBSV_TM_STORAGE_BYTES(TEST_NUM_CLASSES) /
			     sizeof(uint32_t)];
static nrf_edgeai_obsv_metric_t iter_pd;
static nrf_edgeai_obsv_metric_t iter_tm;

static void iter_before(void *fixture)
{
	ARG_UNUSED(fixture);
	memset(&ctx, 0, sizeof(ctx));
	nrf_edgeai_obsv_core_init(&ctx, &test_model);
	nrf_edgeai_obsv_metric_cpd_create(&iter_pd, iter_pd_buf, TEST_NUM_CLASSES);
	nrf_edgeai_obsv_metric_tm_create(&iter_tm, iter_tm_buf, TEST_NUM_CLASSES);
}

ZTEST_SUITE(obsv_iteration, NULL, NULL, iter_before, NULL, NULL);

ZTEST(obsv_iteration, test_iterate_no_metrics)
{
	struct test_snapshots snaps = {0};

	int rc = nrf_edgeai_obsv_core_for_each_metric(&ctx, test_capture_cb, &snaps);

	zassert_equal(rc, 0);
	zassert_equal(snaps.visited, 0);
	zassert_false(snaps.probs_distribution.present);
	zassert_false(snaps.transition_matrix.present);
}

ZTEST(obsv_iteration, test_iterate_two_metrics_visits_both)
{
	nrf_edgeai_obsv_core_register(&ctx, &iter_pd, NULL);
	nrf_edgeai_obsv_core_register(&ctx, &iter_tm, NULL);

	struct test_snapshots snaps = {0};

	zassert_equal(nrf_edgeai_obsv_core_for_each_metric(&ctx, test_capture_cb, &snaps), 0);

	zassert_equal(snaps.visited, 2);
	zassert_true(snaps.probs_distribution.present);
	zassert_true(snaps.transition_matrix.present);

	zassert_equal(snaps.probs_distribution.metric_id,
		      NRF_EDGEAI_OBSV_METRIC_ID_CLASS_PRED_DIST);
	zassert_equal(snaps.probs_distribution.num_rows, TEST_NUM_CLASSES);
	zassert_equal(snaps.probs_distribution.num_cols, TEST_NUM_BINS);

	zassert_equal(snaps.transition_matrix.metric_id,
		      NRF_EDGEAI_OBSV_METRIC_ID_TRANSITION_MATRIX);
	zassert_equal(snaps.transition_matrix.num_rows, TEST_NUM_CLASSES);
	zassert_equal(snaps.transition_matrix.num_cols, TEST_NUM_CLASSES);

	/* Only the class predictions distribution reports config. */
	zassert_equal(snaps.probs_distribution.config_rows, 1);
	zassert_equal(snaps.probs_distribution.config_cols, NRF_EDGEAI_OBSV_CPD_CFG_COUNT);
	zassert_equal(snaps.transition_matrix.config_rows, 0);
}

ZTEST(obsv_iteration, test_null_params)
{
	struct test_snapshots snaps = {0};

	zassert_true(nrf_edgeai_obsv_core_for_each_metric(NULL, test_capture_cb, &snaps) < 0);
	zassert_true(nrf_edgeai_obsv_core_for_each_metric(&ctx, NULL, &snaps) < 0);
}

static bool stop_after_first(const nrf_edgeai_obsv_metric_snapshot_t *snap, void *user)
{
	uint32_t *count = user;

	ARG_UNUSED(snap);
	(*count)++;
	return false;
}

ZTEST(obsv_iteration, test_callback_can_stop_early)
{
	nrf_edgeai_obsv_core_register(&ctx, &iter_pd, NULL);
	nrf_edgeai_obsv_core_register(&ctx, &iter_tm, NULL);

	uint32_t visited = 0;

	zassert_equal(nrf_edgeai_obsv_core_for_each_metric(&ctx, stop_after_first, &visited), 0);
	zassert_equal(visited, 1, "callback returning false must halt iteration");
}

ZTEST(obsv_iteration, test_after_deregister)
{
	nrf_edgeai_obsv_core_register(&ctx, &iter_pd, NULL);
	nrf_edgeai_obsv_core_register(&ctx, &iter_tm, NULL);
	nrf_edgeai_obsv_core_deregister(&ctx, &iter_tm);

	struct test_snapshots snaps = {0};

	zassert_equal(nrf_edgeai_obsv_core_for_each_metric(&ctx, test_capture_cb, &snaps), 0);

	zassert_equal(snaps.visited, 1);
	zassert_true(snaps.probs_distribution.present);
	zassert_false(snaps.transition_matrix.present);
}
```
