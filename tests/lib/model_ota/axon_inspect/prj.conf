## CMakeLists.txt
```
#
# Copyright (c) 2026 Nordic Semiconductor ASA
#
# SPDX-License-Identifier: LicenseRef-Nordic-5-Clause
#

cmake_minimum_required(VERSION 3.20.0)

find_package(Zephyr REQUIRED HINTS $ENV{ZEPHYR_BASE})
project(test_model_ota_axon_inspect)

include(${ZEPHYR_EDGE_AI_MODULE_DIR}/lib/model_ota/cmake/backends/axon.cmake)

set(MODEL_HEADER
    ${ZEPHYR_EDGE_AI_MODULE_DIR}/samples/axon/axon_low_power/src/generated/nrf_axon_model_okay_nordic.h)
get_filename_component(MODEL_HEADER_DIR ${MODEL_HEADER} DIRECTORY)
get_filename_component(MODEL_HEADER_NAME ${MODEL_HEADER} NAME)
set(WORK_DIR ${CMAKE_CURRENT_BINARY_DIR}/model_ota/okay_nordic)
file(MAKE_DIRECTORY ${WORK_DIR})

model_ota_axon_add_probe(OUT_OBJ PROBE_OBJ WORK_DIR ${WORK_DIR} HEADER ${MODEL_HEADER})
model_ota_axon_inspect(
  TARGET okay_nordic
  PROBE ${PROBE_OBJ}
  HEADER_NAME ${MODEL_HEADER_NAME}
  WORK_DIR ${WORK_DIR}
)

target_sources(app PRIVATE src/main.c)
target_include_directories(app PRIVATE ${WORK_DIR} ${MODEL_HEADER_DIR})
set_source_files_properties(src/main.c PROPERTIES OBJECT_DEPENDS ${okay_nordic_AXON_PRIVATE_HEADER})
add_dependencies(app model_ota_axon_metadata_okay_nordic)
```

## prj.conf
```kconfig
#
# Copyright (c) 2026 Nordic Semiconductor ASA
#
# SPDX-License-Identifier: LicenseRef-Nordic-5-Clause
#

CONFIG_NRF_AXON=y
CONFIG_NRF_AXON_INTERLAYER_BUFFER_SIZE=6048
CONFIG_NRF_AXON_PSUM_BUFFER_SIZE=0
```

## src/main.c
```c
/*
 * Copyright (c) 2026 Nordic Semiconductor ASA
 *
 * SPDX-License-Identifier: LicenseRef-Nordic-5-Clause
 */

#include <assert.h>
#include <stddef.h>
#include <stdint.h>

#include <zephyr/sys/util.h>
#include <zephyr/toolchain.h>

#include <axon/nrf_axon_platform.h>

#include "model_ota_axon_model_config.h"

#include MODEL_OTA_AXON_HEADER

BUILD_ASSERT(MODEL_OTA_AXON_CONFIG_VERSION == 0);

BUILD_ASSERT(&MODEL_OTA_AXON_MODEL_SYM == &model_okay_nordic,
	     "MODEL_OTA_AXON_MODEL_SYM must refer to model_okay_nordic");

BUILD_ASSERT(&MODEL_OTA_AXON_PERSISTENT_VARS_SYM == &axon_model_okay_nordic_persistent_vars,
	     "MODEL_OTA_AXON_PERSISTENT_VARS_SYM must refer to the persistent-vars array");
BUILD_ASSERT(MODEL_OTA_AXON_PERSISTENT_VARS_REQUIRED > 0);
BUILD_ASSERT(MODEL_OTA_AXON_PERSISTENT_VARS_REQUIRED * sizeof(int32_t) ==
	     sizeof(axon_model_okay_nordic_persistent_vars));
BUILD_ASSERT(MODEL_OTA_AXON_PERSISTENT_VARS_CAP == MODEL_OTA_AXON_PERSISTENT_VARS_REQUIRED);

BUILD_ASSERT(MODEL_OTA_AXON_INPUT_VECTOR_CAP * sizeof(const int8_t *) ==
	     sizeof(MODEL_OTA_AXON_INPUT_VECTOR_LIST_SYM));
BUILD_ASSERT(MODEL_OTA_AXON_INPUT_VECTOR_CAP == NRF_AXON_MODEL_OKAY_NORDIC_INPUT_VECTOR_CNT);

/* The packed-output buffer is not owned by the firmware, but its size is still reported. */
BUILD_ASSERT(MODEL_OTA_AXON_PACKED_OUTPUT_ALLOC == 0);
BUILD_ASSERT(MODEL_OTA_AXON_PACKED_OUTPUT_BYTES == NRF_AXON_MODEL_OKAY_NORDIC_PACKED_OUTPUT_SIZE);
#ifdef MODEL_OTA_AXON_PACKED_OUTPUT_SYM
#error "MODEL_OTA_AXON_PACKED_OUTPUT_SYM must only be set for a firmware-owned buffer"
#endif

BUILD_ASSERT(MODEL_OTA_AXON_KEEP_SYMBOL_COUNT > 0);

/* Every keep symbol must be an identifier the application can take the address of. */
#define KEEP_REF(symbol) (const void *)&(symbol),
static const void *const keep_refs[] = {MODEL_OTA_AXON_KEEP_REFS(KEEP_REF)};
BUILD_ASSERT(ARRAY_SIZE(keep_refs) == MODEL_OTA_AXON_KEEP_SYMBOL_COUNT);

int main(void)
{
	/* Keep the reference table in the link, so every keep symbol must resolve. */
	__asm__ volatile("" : : "r"(keep_refs));

	return 0;
}
```
