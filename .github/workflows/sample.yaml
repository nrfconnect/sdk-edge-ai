## applications/fomo/src/drivers/Kconfig
```kconfig
# VIDEO driver configuration options

# Copyright (c) 2019 Linaro Limited
# SPDX-License-Identifier: Apache-2.0

menu "App Local Device Drivers"

if VIDEO

rsource "Kconfig.arducam_mega"

endif # VIDEO

endmenu
```

## applications/machine_learning/src/modules/Kconfig.inference_position
```kconfig
#
# Copyright (c) 2025 Nordic Semiconductor
#
# SPDX-License-Identifier: LicenseRef-Nordic-5-Clause
#

config ML_APP_INFERENCE_POSITION
	bool "Marking ML processing with pin state change"
	depends on ML_APP_ML_RESULT_EVENTS
	help
	  The module toggles pin state as last listener for sensor event and first listener for
	  ml result event. Pins are defined in dts file under ``zephyr,user`` node
	  in ``inference-position-gpios`` phandle.
```

## applications/machine_learning/src/modules/Kconfig.ml_runner
```kconfig
#
# Copyright (c) 2021 Nordic Semiconductor
#
# SPDX-License-Identifier: LicenseRef-Nordic-5-Clause
#

menuconfig ML_APP_ML_RUNNER
	bool "Machine learning model runner"
	depends on CAF_SENSOR_EVENTS
	select ML_APP_ML_RESULT_EVENTS

if ML_APP_ML_RUNNER

choice
	prompt "Select model"
	default ML_APP_ML_RUNNER_STUB

rsource "../runners/Kconfig.*"

endchoice

config ML_APP_ML_RUNNER_SENSOR_EVENT_DESCR
	string "Description of handled sensor event"
	default ML_APP_SENSOR_EVENT_DESCR
	help
	  The module handles data related to sensor events with predefined description.
	  Other sensor events are ignored.

module = ML_APP_ML_RUNNER
module-str = machine learning model runner
source "subsys/logging/Kconfig.template.log_config"

endif # ML_APP_ML_RUNNER
```

## applications/machine_learning/src/runners/Kconfig.ei_runner
```kconfig
#
# Copyright (c) 2025 Nordic Semiconductor
#
# SPDX-License-Identifier: LicenseRef-Nordic-5-Clause
#

menuconfig ML_APP_ML_RUNNER_EI
	bool "Edge Impulse based machine learning model"
	depends on EI_WRAPPER

if ML_APP_ML_RUNNER_EI

config ML_APP_ML_RUNNER_EI_WINDOW_SHIFT
	int "Prediction window shift [windows]"
	range 0 4096
	default 1
	help
	  Number of windows the prediction window is shifted between predictions.

config ML_APP_ML_RUNNER_EI_FRAME_SHIFT
	int "Prediction window shift [frames]"
	range 0 4096
	default 0
	help
	  Number of frames the prediction window is shifted between predictions.

endif # ML_APP_ML_RUNNER_EI
```

## applications/machine_learning/src/runners/Kconfig.neuton_runner
```kconfig
#
# Copyright (c) 2025 Nordic Semiconductor
#
# SPDX-License-Identifier: LicenseRef-Nordic-5-Clause
#

menuconfig ML_APP_ML_RUNNER_NEUTON
	bool "Neuton based machine learning model"
	imply FPU

if ML_APP_ML_RUNNER_NEUTON

config ML_APP_ML_RUNNER_NEUTON_ARCHIVE_NAME
	string "Name of archive with Neuton headers and lib"

config ML_APP_ML_RUNNER_NEUTON_THREAD_STACK_SIZE
	int "Size of EI wrapper thread stack"
	default 4096
	help
	  Neuton processes the data in a low-priority thread.
	  The stack size needs to be sufficient for used solution.

config ML_APP_ML_RUNNER_NEUTON_THREAD_PRIORITY
	int "Priority of Neuton thread"
	default 5
	help
	  It is recommended to use preemptive thread priority to make sure
	  that the thread will not block other operations in system for
	  a long time.

endif # ML_APP_ML_RUNNER_NEUTON
```

## applications/machine_learning/src/runners/Kconfig.stub_runner
```kconfig
#
# Copyright (c) 2025 Nordic Semiconductor
#
# SPDX-License-Identifier: LicenseRef-Nordic-5-Clause
#

menuconfig ML_APP_ML_RUNNER_STUB
	bool "Neuton based machine learning model"
	imply FPU
	help
	  Stub runner is used as baseline for power and memory comparison of ML models frameworks.

if ML_APP_ML_RUNNER_STUB

config ML_APP_ML_RUNNER_STUB_FRAME_SIZE
	int "Number of samples in frame"
	default 3

config ML_APP_ML_RUNNER_STUB_WINDOW_SIZE
	int "Number of frames needed to send fake result event"
	default 75

config ML_APP_ML_RUNNER_STUB_THREAD_STACK_SIZE
	int "Size of stub runner thread stack"
	default 4096
	help
	  Stub runner thread stack size. Size set to match other runners' thread for comparison.

config ML_APP_ML_RUNNER_STUB_THREAD_PRIORITY
	int "Priority of stub runner thread"
	default 5

endif # ML_APP_ML_RUNNER_STUB
```

## applications/matter_common/Kconfig.edgeai
```kconfig
#
# Copyright (c) 2026 Nordic Semiconductor ASA
#
# SPDX-License-Identifier: LicenseRef-Nordic-5-Clause
#

config MATTER_EDGEAI_DMIC_MEM_SLAB_NUM_BLOCKS
	int "DMIC PCM memory slab block count"
	range 4 24
	default 8
	help
	  Number of RX blocks for the Zephyr DMIC driver mem slab (matter_common dmic).
	  Fewer blocks reduce RAM when the reader keeps up with capture; increase if you
	  see audio underruns when inference occasionally stalls.

config MATTER_EDGEAI_DIMMING_FX_TICK_MS
	int "PWM dimming effect tick period (milliseconds)"
	range 10 50
	default 25
	help
	  Interval for the dimming work handler. Larger values reduce scheduling overhead
	  at the cost of slightly coarser LED PWM steps.
```

## drivers/axon/Kconfig
```kconfig
#
# Copyright (c) 2026 Nordic Semiconductor
#
# SPDX-License-Identifier: LicenseRef-Nordic-5-Clause
#

config NRF_AXON
	bool "Enable Axon Neural Processing Unit"
	select NRF_SYS_EVENT

config NRF_AXON_INTERLAYER_BUFFER_SIZE
	int "Axon Interlayer buffer size (in bytes)"
	default 0
	depends on NRF_AXON
	help
	  Specifies the size of the interlayer buffer used during neural net model inferencing.
	  Each compiled model specifies its interlayer buffer requirement, and this number must
	  be as big as the highest needed.

config NRF_AXON_INTERLAYER_BUFFER_MEMREGION_NAME
	string "Memory section/region to place interlayer buffer"
	default ".bss"
	depends on NRF_AXON
	help
	  Use this to specify which memory section/region to placed the interlayer buffer. It is recommended
	  that this be fastest memory available to the Axon NPU peripheral. By default, this is
	  .bss. Users may change from the default if the .bss region is not mapped to local memory
	  (on systems that support it) or if the .bss region is too small to accomodate the interlayer
	  buffer.

config NRF_AXON_PSUM_BUFFER_SIZE
	int "Axon partial sum buffer size (in bytes)"
	default 0
	depends on NRF_AXON
	help
	  Specifies the size of the partial sum buffer used during neural net model inferencing,
	  used on specific operations. The default neural network compiler settings are to not use a partial sum
	  so this should be left at 0. It will need to be populated if the model was compiled to use the
	  partial sum buffer. See the model header file for the size needed.

config NRF_AXON_MODEL_NAME
	string "Name of the model to use in single model examples"
	depends on NRF_AXON
```

## dts/bindings/nordic,axons.yaml
```yaml
# Copyright (c) 2022 Nordic Semiconductor ASA
# SPDX-License-Identifier: LicenseRef-Nordic-5-Clause

description: Nordic's Axons

compatible: "nordic,axons"

include:
  - "base.yaml"

properties:
    reg:
      required: true

    interrupts:
      required: true
```

## lib/Kconfig
```kconfig
#
# Copyright (c) 2025 Nordic Semiconductor ASA
#
# SPDX-License-Identifier: LicenseRef-Nordic-5-Clause
#

menu "Libraries"

rsource "nrf_edgeai/Kconfig"
rsource "nrf_edgeai_obsv/Kconfig"
rsource "nrf_edgeai_obsv_memfault/Kconfig"
rsource "axon/model_partition/Kconfig"

endmenu
```

## lib/axon/model_partition/Kconfig
```kconfig
#
# Copyright (c) 2026 Nordic Semiconductor ASA
#
# SPDX-License-Identifier: LicenseRef-Nordic-5-Clause
#

config NRF_AXON_MODEL_PARTITION
	bool "Axon updatable model partition support"
	depends on NRF_AXON
	help
	  Enable access to nrf_axon_nn_compiled_model_s images stored in a
	  dedicated flash partition. Model images are linked separately from the
	  application with absolute pointers resolved at build time.
```

## lib/nrf_edgeai_obsv_memfault/Kconfig
```kconfig
#
# Copyright (c) 2026 Nordic Semiconductor ASA
#
# SPDX-License-Identifier: LicenseRef-Nordic-5-Clause
#

menuconfig NRF_EDGEAI_OBSV_MEMFAULT
	bool "Memfault transport for Edge AI Observability"
	depends on NRF_EDGEAI_OBSV
	depends on MEMFAULT_CDR_ENABLE || ZTEST
	depends on NRF_EDGEAI_OBSV_ENCODE || ZTEST
	help
	  Encodes observability snapshots as CBOR and publishes them to Memfault
	  as a Custom Data Recording (CDR) binary blob.

if NRF_EDGEAI_OBSV_MEMFAULT

config NRF_EDGEAI_OBSV_MEMFAULT_MAX_CONTEXTS
	int "Maximum number of observability contexts registered with Memfault"
	default 1
	range 1 8
	help
	  Upper bound on the number of nrf_edgeai_obsv_ctx_t instances that can
	  be registered via nrf_edgeai_obsv_memfault_init(). Each additional
	  context increases the staging buffer by NRF_EDGEAI_OBSV_ENCODE_MAX_SIZE
	  bytes. The CDR payload is a CBOR array with one entry per context.

config NRF_EDGEAI_OBSV_MEMFAULT_AUTO_COLLECT
	bool "Periodically refresh the CDR payload"
	help
	  Spawns a delayable work item on the system workqueue that
	  calls nrf_edgeai_obsv_memfault_collect() on a fixed
	  interval. Use this when the transport drains opportunistically
	  (BT_MDS, MEMFAULT_HTTP_PERIODIC_UPLOAD) and the application
	  does not want to wire a timer itself. The first collect runs
	  one interval after initialization.

	  When enabled (and whenever collect can run concurrently with inference),
	  bind the transport with nrf_edgeai_obsv_memfault_init and drive
	  inference through nrf_edgeai_obsv_update_probs (see nrf_edgeai_obsv.h)
	  so encode inside collect does not race snapshot collection.

	  collect() allocates a NRF_EDGEAI_OBSV_ENCODE_LIST_BUFSZ-byte
	  temporary buffer on the calling thread's stack. When AUTO_COLLECT is
	  enabled, that thread is the system workqueue, so increase
	  CONFIG_SYSTEM_WORKQUEUE_STACK_SIZE accordingly (see
	  nrf_edgeai_obsv/nrf_edgeai_obsv_encode_sizes.h for the exact value
	  at your Kconfig dimensions). When calling collect() manually, ensure
	  your thread's stack is large enough.

config NRF_EDGEAI_OBSV_MEMFAULT_AUTO_COLLECT_INTERVAL_SEC
	int "Auto-collect interval (seconds)"
	depends on NRF_EDGEAI_OBSV_MEMFAULT_AUTO_COLLECT
	default 86400
	range 60 2592000
	help
	  How often the delayable work item refreshes the staged CDR payload.

	  Memfault's backend accepts at most 1 CDR per device per day by default.
	  The limit can be raised in the Memfault project settings, or bypassed
	  entirely for devices in developer mode. The default matches the 1-per-day
	  limit.

	  With HTTP periodic upload: align this interval with
	  MEMFAULT_HTTP_PERIODIC_UPLOAD_INTERVAL_SECS so every upload finds
	  fresh data.

	  With MDS (BLE GATT): the phone drives the drain cadence. Pick an
	  interval short enough that the phone, whenever it connects,
	  finds a recent-enough snapshot for your observability needs.


module = NRF_EDGEAI_OBSV_MEMFAULT
module-str = nrf_edgeai_obsv_mflt
source "subsys/logging/Kconfig.template.log_config"

endif # NRF_EDGEAI_OBSV_MEMFAULT
```

## subsys/edge_ai_banner/Kconfig
```kconfig
#
# Copyright (c) 2026 Nordic Semiconductor ASA
#
# SPDX-License-Identifier: LicenseRef-Nordic-5-Clause
#

config EDGE_AI_BOOT_BANNER
	bool "Edge AI Add-on boot banner"
	default y if BOOT_BANNER || NCS_BOOT_BANNER
	help
	  Prints the Edge AI Add-on version string at boot, immediately after
	  the Zephyr boot banner. Uses SYS_INIT at APPLICATION level, priority 1.
```

## tests/obsv_memfault/testcase.yaml
```yaml
#
# Copyright (c) 2026 Nordic Semiconductor ASA
#
# SPDX-License-Identifier: LicenseRef-Nordic-5-Clause
#

common:
  tags: edgeai obsv memfault
  platform_allow:
    - native_sim/native/64
    - qemu_cortex_m3
  integration_platforms:
    - native_sim/native/64

tests:
  edgeai.obsv_memfault: {}

  edgeai.obsv_memfault.auto_collect:
    extra_configs:
      - CONFIG_NRF_EDGEAI_OBSV_MEMFAULT_AUTO_COLLECT=y
      - CONFIG_NRF_EDGEAI_OBSV_MEMFAULT_AUTO_COLLECT_INTERVAL_SEC=60
```

## west.yml
```yaml
#
# Copyright (c) 2025 Nordic Semiconductor ASA
#
# SPDX-License-Identifier: LicenseRef-Nordic-5-Clause
#

manifest:
  version: "0.13"

  remotes:
    - name: ncs
      url-base: https://github.com/nrfconnect

  projects:
    - name: nrf
      remote: ncs
      repo-path: sdk-nrf
      revision: 0611b5887db87fde99cb7dec1620be5707231ca1
      import: true

    - name: edge-impulse-sdk-zephyr
      url: https://github.com/edgeimpulse/edge-impulse-sdk-zephyr
      path: modules/edge-impulse-sdk-zephyr
      revision: v1.82.3
      west-commands: west/west-commands.yml

  self:
    path: edge-ai
```

## zephyr/Kconfig.edge_ai
```kconfig
#
# Copyright (c) 2025 Nordic Semiconductor
#
# SPDX-License-Identifier: LicenseRef-Nordic-5-Clause
#

menu "Edge AI Add-on"

rsource "../drivers/Kconfig"
rsource "../lib/Kconfig"

endmenu
```
