## lib/model_ota/Kconfig
```kconfig
#
# Copyright (c) 2026 Nordic Semiconductor ASA
#
# SPDX-License-Identifier: LicenseRef-Nordic-5-Clause
#

config MODEL_OTA_TESTING
	bool "Model OTA testing mode (empty header pad, no MCUboot)"
	depends on FLASH && CRC && XIP
	depends on !BOOTLOADER_MCUBOOT
	help
	  Development and sample use only. Model partitions reserve a 32-byte header
	  slot at the partition base (zeroed, not MCUboot-signed) and link the model
	  payload at partition_base + 32, matching the production layout without
	  requiring MCUboot or imgtool signing. Flash the emitted *_model_partition.hex
	  files directly (for example multi_model with overlay-ota.conf).

menuconfig MODEL_OTA
	bool "Model-only OTA update (linked partition images)"
	depends on BOOTLOADER_MCUBOOT || MODEL_OTA_TESTING
	depends on FLASH && CRC && XIP
	select MCUBOOT_BOOTUTIL_LIB if BOOTLOADER_MCUBOOT
	help
	  Library that loads and validates NN models from dedicated flash partitions at
	  runtime, independently of the application image. Each model partition reserves
	  a 32-byte header slot at the partition base; the linked model payload follows
	  at partition_base + 32. With MCUboot, imgtool signs the payload as a separate
	  updateable image. In testing mode the header slot is left empty (zeroed).
	  Neuton and Axon models are built as self-contained partition images with a
	  header holding a DIRECT pointer to the model. Model pointers are used directly
	  in zephyr,mapped-partition storage (XIP). Enable CONFIG_FLASH and CONFIG_CRC
	  in the application's prj.conf.

if MODEL_OTA

config MODEL_OTA_NEUTON
	bool "Enable the Neuton model image loader"
	depends on NRF_EDGEAI
	help
	  Builds model_image_neuton.c and model_image_load_neuton(). OTA-wired models are compiled
	  via model_ota_edgeai_neuton_model(), which compiles
	  lib/model_ota/src/model_ota_edgeai_neuton_wired.c once per solution with -D defines
	  (includes generated nrf_edgeai_user_model.c and defines
	  nrf_edgeai_load_user_model_<SOLUTION_ID>()), then drops each wired model's payload from
	  its static library by archive-scoped linker /DISCARD/ rules.
	  Build-time macro contract: model_ota_stub_macros.h.
	  See lib/model_ota/cmake/model_ota_edgeai_neuton.cmake and include/model_ota/model_image.h.

config MODEL_OTA_AXON
	bool "Enable the Axon model image loader"
	depends on NRF_AXON
	help
	  Builds model_image_axon.c and model_image_load_axon(). Edge AI Lab solutions with an
	  Axon backend use model_ota_edgeai_axon_model(): only the compiled Axon model is
	  partition-loaded; the nrf_edgeai_t wrapper stays in the app. Raw Axon models are built
	  as self-contained partition images and wired to the application with one
	  model_ota_axon_model() declaration.
	  See lib/model_ota/cmake/model_ota_axon.cmake and include/model_ota/model_image.h.

config MODEL_OTA_LOG_LEVEL
	int "Log level for the model_image module"
	default 3
	range 0 4
	help
	  0 = off, 1 = err, 2 = wrn, 3 = inf, 4 = dbg.

config MODEL_OTA_GUARD_DRAIN_TIMEOUT_MS
	int "Timeout to wait for inference before rejecting model update (ms)"
	default 2000
	range 100 30000
	help
	  When a model update starts, the library waits this long for in-flight
	  model access to finish before rejecting the operation with -EBUSY or
	  MGMT_ERR_EBUSY. Use a value below typical SMP client command timeouts
	  (often 10-20 s) so the client receives a rejection before it times out.

config MODEL_OTA_SMP
	bool "Coordinate inference with MCUboot SMP model uploads"
	depends on BOOTLOADER_MCUBOOT
	depends on MCUMGR
	depends on MCUMGR_MGMT_NOTIFICATION_HOOKS
	depends on MCUMGR_GRP_IMG
	depends on MCUMGR_GRP_IMG_UPLOAD_CHECK_HOOK
	depends on MCUMGR_GRP_IMG_STATUS_HOOKS
	help
	  Register MCUMGR image-upload hooks that pause inference while a registered
	  MCUboot updateable model image is uploaded over SMP. After upload completes,
	  inference stays blocked until the device resets and reloads the new model.

if MODEL_OTA_SMP

config MODEL_OTA_SMP_MAX_SLOTS
	int "Maximum number of MCUboot model image slots"
	default 4
	range 1 16
	help
	  Upper bound on entries passed to model_ota_smp_register().

config MODEL_OTA_SMP_DRAIN_RETRY_WINDOW_MS
	int "Window to keep inference blocked for an upload retry (ms)"
	default 30000
	range 1000 600000
	help
	  When the first upload chunk is rejected because in-flight model access did
	  not finish within CONFIG_MODEL_OTA_GUARD_DRAIN_TIMEOUT_MS, inference stays
	  blocked for this long so that readers drain and a repeated upload attempt
	  is accepted without waiting again. If the client does not retry within the
	  window, or the retry still finds model access in flight, the block is
	  lifted and inference continues on the unchanged model. Size this to cover
	  the client's retry delay after an MGMT_ERR_EBUSY response.

endif # MODEL_OTA_SMP

endif # MODEL_OTA
```

## lib/nrf_edgeai/Kconfig
```kconfig
#
# Copyright (c) 2025 Nordic Semiconductor ASA
#
# SPDX-License-Identifier: LicenseRef-Nordic-5-Clause
#

menuconfig NRF_EDGEAI
	bool "nRF Edge AI Library"
	depends on FPU
	help
	  Enable Edge AI library.

if NRF_EDGEAI

config NRF_EDGEAI_FROM_SOURCE
	bool "Build nRF Edge AI runtime from edge-ai-srcx sources"
	default y if MODEL_OTA_SMP
	help
	  Compile libnrf_edgeai from a local edge-ai-srcx checkout instead of linking
	  the prebuilt archive. Required for the model-OTA inference guard (native
	  gate hooks in nrf_edgeai_gate.c). Set the NRF_EDGEAI_SRC_PATH environment
	  variable or CMake variable to the edge-ai-srcx repository root.

# General
config MAIN_STACK_SIZE
	default 2048
	help
	  Set the main stack size for Edge AI applications. It's recommended value, but could be adjusted for specific user solution.

endif # NRF_EDGEAI
```

## lib/nrf_edgeai_obsv/Kconfig
```kconfig
#
# Copyright (c) 2026 Nordic Semiconductor ASA
#
# SPDX-License-Identifier: LicenseRef-Nordic-5-Clause
#

menuconfig NRF_EDGEAI_OBSV
	bool "Edge AI Observability"
	help
	  Enable the Edge AI observability library.
	  Collects runtime metrics from class probabilities and exposes them
	  as typed snapshots that transport layers can serialize as they wish.

if NRF_EDGEAI_OBSV

config NRF_EDGEAI_OBSV_ENCODE
	bool "CBOR observability encoder"
	depends on ZCBOR
	help
	  Builds nrf_edgeai_obsv_encode.c and enables nrf_edgeai_obsv_encode()
	  in the Zephyr wrapper.

config NRF_EDGEAI_OBSV_EXTRA_ENCODE_BYTES
	int "Extra bytes reserved in the encode buffer for custom metrics"
	depends on NRF_EDGEAI_OBSV_ENCODE
	default 0
	help
	  Additional bytes added to NRF_EDGEAI_OBSV_ENCODE_MAX_SIZE to
	  accommodate custom metrics registered alongside the built-in ones.
	  Set to at least the sum of NRF_EDGEAI_OBSV_ENCODE_METRIC_SIZE(n_rows,
	  n_cols) evaluated for each custom metric. The Memfault staging buffer
	  encode buffer are sized from NRF_EDGEAI_OBSV_ENCODE_MAX_SIZE,
	  so they grow automatically.

config NRF_EDGEAI_OBSV_DIST_BINNING
	bool
	help
	  Selected by distribution-style metrics that share the histogram-binning
	  helpers in metrics/nrf_obsv_dist_binning.c. Not user-selectable.

config NRF_EDGEAI_OBSV_MAX_CLASSES
	int "Maximum number of model output classes"
	default 4
	range 1 65535
	help
	  Upper bound on model output classes tracked by observability metrics.
	  Both metric counter storage and the CBOR encode buffer scale with the
	  class count; the transition matrix grows as N^2.

config NRF_EDGEAI_OBSV_METRIC_TRANSITION_MATRIX
	bool "Transition matrix metric"
	help
	  Tracks class-to-class transitions across consecutive inferences.

config NRF_EDGEAI_OBSV_METRIC_MODEL_CERTAINTY_DESC
	bool "Model certainty descriptor metric"
	select NRF_EDGEAI_OBSV_DIST_BINNING
	help
	  Per-inference descriptor of prediction certainty and temporal stability,
	  derived from the output probability vector. Emits a 3 x bin_num matrix:
	  row 0 is the normalized Shannon-entropy histogram H(p)/ln(N) over [0, 1]
	  (uncertainty), row 1 is the top-2 margin histogram p_top1 - p_top2 over
	  [0, 1] (decisiveness), and row 2 carries stability counters
	  [switches, comparisons, majority_frames, confident_switches] padded with
	  zeros. The switching rate is derived off-device as switches / comparisons.
	  One bin count is shared by the entropy and margin histograms. Merges the
	  former prediction switching rate, probability entropy distribution and
	  probability top-2 margin distribution metrics.

if NRF_EDGEAI_OBSV_METRIC_MODEL_CERTAINTY_DESC

config NRF_EDGEAI_OBSV_MODEL_CERTAINTY_DESC_BIN_NUM
	int "Number of histogram bins (shared by entropy and top-2 margin)"
	default 4
	range 4 16
	help
	  Number of bins in each of the entropy and top-2 margin histogram rows.

endif # NRF_EDGEAI_OBSV_METRIC_MODEL_CERTAINTY_DESC

config NRF_EDGEAI_OBSV_METRIC_CLASS_PRED_DIST
	bool "Class predictions distribution metric"
	select NRF_EDGEAI_OBSV_DIST_BINNING
	help
	  Per-class picture of the model's predictions, in one 2*num_classes x bin_num
	  matrix. Rows [0, num_classes) are the probability distribution: a per-class
	  histogram of the predicted probability over uniform [0, 1] bins (every
	  inference contributes one sample to every class row). Rows
	  [num_classes, 2*num_classes) are the streak distribution: a per-class
	  histogram of how many consecutive inferences the dominant class (argmax)
	  stays the same, recorded when a streak ends. Merges the former probability
	  distribution and class streak distribution metrics. Consumes the
	  class-probability stream (NRF_EDGEAI_OBSV_SOURCE_PROBS).

if NRF_EDGEAI_OBSV_METRIC_CLASS_PRED_DIST

config NRF_EDGEAI_OBSV_CLASS_PRED_DIST_BIN_NUM
	int "Number of histogram bins (shared by both row groups)"
	default 4
	range 2 16
	help
	  Number of bins per class, shared by the probability-distribution rows
	  (uniform over [0, 1]) and the streak-length rows (uniform over [1, TOP]).

config NRF_EDGEAI_OBSV_CLASS_PRED_DIST_STREAK_TOP_BIN
	int "Streak length saturating the top streak bin"
	default 20
	range 2 255
	help
	  Streak lengths >= this value falls into the last streak bin; bins span
	  [1, TOP] uniformly, so a length of 1 lands in bin 0 and TOP (or longer) in
	  the top bin. Set it around the longest streak worth resolving.

config NRF_EDGEAI_OBSV_CLASS_PRED_DIST_STREAK_TOL
	int "Streak flicker tolerance (consecutive mismatched frames bridged)"
	default 0
	range 0 255
	help
	  How many consecutive inferences whose dominant class differs from the
	  active streak's class may be skipped without ending the streak. Bridged
	  frames are not counted into the streak length, unless the mismatch turns
	  into a real class change: then the trailing bridged frames of the new
	  class count toward its new streak. 0 means any mismatch ends
	  the streak (strict "N in a row"). One tolerance applies to all classes.

endif # NRF_EDGEAI_OBSV_METRIC_CLASS_PRED_DIST

config NRF_EDGEAI_OBSV_METRIC_MEL_ENERGY_DESC
	bool "Mel energy descriptor metric"
	select NRF_EDGEAI_OBSV_DIST_BINNING
	help
	  Per-frame summary statistics of the mel feature vector (mean energy,
	  max energy, dynamic range, floor-bin ratio), each accumulated into a
	  [0, 1] histogram. Feature values are normalized into [0, 1] against a
	  configured percentile range [p01, p99] (see SCALE_P01/P99_MILLI below).
	  Consumes the input-feature stream (NRF_EDGEAI_OBSV_SOURCE_FEATURES).

if NRF_EDGEAI_OBSV_METRIC_MEL_ENERGY_DESC

config NRF_EDGEAI_OBSV_MEL_ENERGY_DESC_BIN_NUM
	int "Number of histogram bins per descriptor row"
	default 4
	range 2 16
	help
	  Number of bins in each descriptor histogram row.

config NRF_EDGEAI_OBSV_MEL_ENERGY_DESC_MAX_FEATURES
	int "Maximum mel feature vector length"
	default 40
	range 1 64
	help
	  Upper bound on the feature vector length. Sizes a stack scratch buffer
	  used for the per-frame quantile (dynamic range) computation.

config NRF_EDGEAI_OBSV_MEL_ENERGY_DESC_SCALE_P01_MILLI
	int "Lower scaling percentile (p01), in thousandths of a feature unit"
	default 0
	help
	  Lower bound used to normalize feature values into [0, 1]:
	  x_norm = clamp((x - p01) / (p99 - p01), 0, 1). Expressed in thousandths
	  (e.g. 40 means 0.040 in feature units, where features are the float mel
	  values passed to nrf_edgeai_obsv_update_features). Measure p01 offline on
	  a representative dataset. Kconfig has no float type, hence the x1000 int.

config NRF_EDGEAI_OBSV_MEL_ENERGY_DESC_SCALE_P99_MILLI
	int "Upper scaling percentile (p99), in thousandths of a feature unit"
	default 4000
	help
	  Upper bound used to normalize feature values into [0, 1]; see
	  NRF_EDGEAI_OBSV_MEL_ENERGY_DESC_SCALE_P01_MILLI. Must be greater than the
	  lower bound. The default (4.0) is a rough order-of-magnitude placeholder
	  for the mel feature range and MUST be recalibrated against a representative
	  dataset: a value far below the true p99 saturates the mean/max/range rows
	  into the top bin, while a value far above it collapses them into bin 0.

endif # NRF_EDGEAI_OBSV_METRIC_MEL_ENERGY_DESC

config NRF_EDGEAI_OBSV_METRIC_MEL_SPECTRAL_DESC
	bool "Mel spectral descriptor metric"
	select NRF_EDGEAI_OBSV_DIST_BINNING
	help
	  Per-frame spectral-shape statistics of the mel feature vector
	  (low/mid/high band energy ratios, spectral centroid, spread, entropy,
	  flatness, contrast), each accumulated into a [0, 1] histogram. All rows
	  are scale-invariant (they divide by total energy or mean), so no
	  amplitude calibration is needed. Uses logf/expf/sqrtf (libm). Consumes
	  the input-feature stream (NRF_EDGEAI_OBSV_SOURCE_FEATURES).

if NRF_EDGEAI_OBSV_METRIC_MEL_SPECTRAL_DESC

config NRF_EDGEAI_OBSV_MEL_SPECTRAL_DESC_BIN_NUM
	int "Number of histogram bins per descriptor row"
	default 4
	range 2 16
	help
	  Number of bins in each descriptor histogram row.

endif # NRF_EDGEAI_OBSV_METRIC_MEL_SPECTRAL_DESC

endif # NRF_EDGEAI_OBSV
```

## tests/obsv/testcase.yaml
```yaml
common:
  tags: edgeai obsv
  platform_allow:
    - native_sim/native/64
  integration_platforms:
    - native_sim/native/64

tests:
  edgeai.obsv: {}

  edgeai.obsv.cpd_strict:
    extra_configs:
      - CONFIG_NRF_EDGEAI_OBSV_CLASS_PRED_DIST_STREAK_TOL=0

  edgeai.obsv.mcd_wide:
    extra_configs:
      - CONFIG_NRF_EDGEAI_OBSV_MODEL_CERTAINTY_DESC_BIN_NUM=16
```

## tests/obsv_size/testcase.yaml
```yaml
#
# Copyright (c) 2026 Nordic Semiconductor ASA
#
# SPDX-License-Identifier: LicenseRef-Nordic-5-Clause
#

tests:
  edgeai.obsv_size.max_config:
    tags: edgeai obsv
    platform_allow:
      - native_sim/native/64
    integration_platforms:
      - native_sim/native/64
```
