## lib/model_ota/Kconfig
```kconfig
#
# Copyright (c) 2026 Nordic Semiconductor ASA
#
# SPDX-License-Identifier: LicenseRef-Nordic-5-Clause
#

menuconfig MODEL_OTA
	bool "Model OTA [EXPERIMENTAL]"
	select EXPERIMENTAL
	help
	  Load models from model images placed in a memory-mapped model partition, so a model can be
	  updated without updating the firmware.

if MODEL_OTA

config MODEL_OTA_AXON
	bool "Axon model images"
	default y
	depends on NRF_AXON
	help
	  Load compiled Axon models from model images.

module = MODEL_OTA
module-str = Model OTA
source "subsys/logging/Kconfig.template.log_config"

endif # MODEL_OTA
```

## lib/nrf_edgeai_obsv_memfault/Kconfig
```kconfig
#
# Copyright (c) 2026 Nordic Semiconductor ASA
#
# SPDX-License-Identifier: LicenseRef-Nordic-5-Clause
#

menuconfig NRF_EDGEAI_OBSV_MEMFAULT
	bool "Memfault heartbeat transport for Edge AI Observability"
	depends on NRF_EDGEAI_OBSV
	depends on NRF_EDGEAI_OBSV_METRIC_MODEL_CERTAINTY_DESC
	depends on MEMFAULT || ZTEST
	help
	  Copies selected observability counters into application-defined Memfault
	  heartbeat metrics immediately before each heartbeat is serialized.

if NRF_EDGEAI_OBSV_MEMFAULT

config NRF_EDGEAI_OBSV_MEMFAULT_MAX_CONTEXTS
	int "Maximum number of observability contexts registered with Memfault"
	default 1
	range 1 8
	help
	  Upper bound on the number of nrf_edgeai_obsv_ctx_t instances that can
	  be registered via nrf_edgeai_obsv_memfault_init().

module = NRF_EDGEAI_OBSV_MEMFAULT
module-str = nrf_edgeai_obsv_mflt
source "subsys/logging/Kconfig.template.log_config"

endif # NRF_EDGEAI_OBSV_MEMFAULT
```

## tests/obsv_memfault/testcase.yaml
```yaml
#
# Copyright (c) 2026 Nordic Semiconductor ASA
#
# SPDX-License-Identifier: LicenseRef-Nordic-5-Clause
#

common:
  tags: edgeai obsv memfault
  platform_allow:
    - native_sim/native/64
    - qemu_cortex_m3
  integration_platforms:
    - native_sim/native/64

tests:
  edgeai.obsv_memfault: {}
```
