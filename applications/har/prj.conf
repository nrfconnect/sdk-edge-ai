## CMakeLists.txt
```
#
# Copyright (c) 2026 Nordic Semiconductor ASA
#
# SPDX-License-Identifier: LicenseRef-Nordic-5-Clause
#

cmake_minimum_required(VERSION 3.20.0)

set(APPLICATION_CONFIG_DIR "${CMAKE_CURRENT_SOURCE_DIR}/configuration/\${NORMALIZED_BOARD_TARGET}")

find_package(Zephyr REQUIRED HINTS $ENV{ZEPHYR_BASE})
project(har)

set(NN_SOURCE "${CMAKE_CURRENT_SOURCE_DIR}/src/nrf_edgeai_generated/${BOARD}")
set(NN_PATH "${NN_SOURCE}/nrf_edgeai_user_model.c")

if(NOT EXISTS "${NN_PATH}")
  message(FATAL_ERROR "Edge AI model file not found for board '${BOARD}'.\n"
    "Expected: ${NN_PATH}\n"
    "Create the model at that path or use a supported board.")
endif()
message(STATUS "Using Edge AI model: ${NN_SOURCE}")

target_include_directories(app PRIVATE
  ${CMAKE_CURRENT_SOURCE_DIR}/src/hw_modules
  ${CMAKE_CURRENT_SOURCE_DIR}/src/ble
  ${NN_SOURCE}
)

target_sources(app PRIVATE
  ${CMAKE_CURRENT_SOURCE_DIR}/src/main.c
  ${CMAKE_CURRENT_SOURCE_DIR}/src/inference_postprocessing.c
  ${CMAKE_CURRENT_SOURCE_DIR}/src/activity_led.c
  ${CMAKE_CURRENT_SOURCE_DIR}/src/hw_modules/button/button.c
  ${CMAKE_CURRENT_SOURCE_DIR}/src/hw_modules/led/led.c
  ${CMAKE_CURRENT_SOURCE_DIR}/src/hw_modules/sensor/imu/imu.c
  ${CMAKE_CURRENT_SOURCE_DIR}/src/ble/ble_common.c
  ${NN_PATH}
)

if(CONFIG_BLE_NUS_OUTPUT)
  target_sources(app PRIVATE ${CMAKE_CURRENT_SOURCE_DIR}/src/ble/nus/ble_nus.c)
endif()
```

## Kconfig
```
#
# Copyright (c) 2026 Nordic Semiconductor
#
# SPDX-License-Identifier: LicenseRef-Nordic-5-Clause
#

config HAR_INFERENCE_POSTPROCESSING
	bool "Apply inference postprocessing before publishing"
	help
	  When enabled, classification output is stabilized by requiring a
	  per-class number of consecutive identical predictions before being
	  logged, shown on the LED, and sent over BLE.

	  When disabled, every raw model prediction is logged and published.

config HAR_POSTPROCESSING_PUBLISH_TIMEOUT_MS
	int "Maximum time without a published classification [ms]"
	depends on HAR_INFERENCE_POSTPROCESSING
	range 1000 60000
	default 8000
	help
	  While the activity changes, the raw prediction may keep alternating so
	  that no class ever reaches its repeat count and nothing is published.
	  Once this time has passed without any output, the class predicted most
	  often since the last published result is published instead.

	  The gap is bounded by this value plus one inference period, because the
	  timeout is only evaluated when a new raw prediction arrives.

config HAR_LOG_RAW_PREDICTIONS
	bool "Report every raw prediction, before post-processing"
	depends on HAR_INFERENCE_POSTPROCESSING
	help
	  When enabled, every model output is reported with a "RAW," prefix in
	  addition to the results that postprocessing decides to publish. Both
	  line types carry the same fields, so a recording can be analyzed as a
	  raw prediction stream, as a published stream, or as both.

config BLE_NUS_OUTPUT
	bool "Send classification results over BLE NUS"
	depends on BT && BT_SMP
	select BT_NUS
	help
	  When enabled, recognized activity class, probability and average
	  acceleration values are sent as text over the Nordic UART Service.

source "Kconfig.zephyr"
```

## Kconfig.sysbuild
```
#
# Copyright (c) 2026 Nordic Semiconductor
#
# SPDX-License-Identifier: LicenseRef-Nordic-5-Clause
#

config PARTITION_MANAGER
	default y if BOARD_THINGY53

source "share/sysbuild/Kconfig"

config NRF_DEFAULT_IPC_RADIO
	default y

config NETCORE_IPC_RADIO_BT_HCI_IPC
	default y
```

## sample.yaml
```
sample:
  description: Human Activity Recognition application
  name: har

common:
  sysbuild: true
  tags:
    - ci_build
    - sysbuild
    - ci_applications_har
  harness: console
  harness_config:
    type: multi_line
    ordered: false
    regex:
      - "Booting MCUboot"
      - "I: Starting bootloader"
      - "I: Jumping to the first image slot"
      - "Booting nRF Connect SDK"
      - "nRF Edge AI Human Activity Recognition Demo"
      - "nRF Edge AI Runtime Version:"
      - "nRF Edge AI Lab Solution id:"

tests:
  applications.har.default:
    build_only: true
    platform_allow:
      - nrf54l15tag/nrf54l15/cpuapp
    integration_platforms:
      - nrf54l15tag/nrf54l15/cpuapp
  applications.har.nus:
    build_only: true
    platform_allow:
      - nrf54l15tag/nrf54l15/cpuapp
    integration_platforms:
      - nrf54l15tag/nrf54l15/cpuapp
    extra_args:
      - CONFIG_BLE_NUS_OUTPUT=y
```

## prj.conf
```kconfig
#
# Copyright (c) 2026 Nordic Semiconductor
#
# SPDX-License-Identifier: LicenseRef-Nordic-5-Clause
#

CONFIG_NRF_EDGEAI=y
CONFIG_FPU=y

# CONFIG_SPI=y
CONFIG_SENSOR=y
CONFIG_GPIO=y

CONFIG_LOG=y
CONFIG_LOG_BACKEND_RTT=y
CONFIG_USE_SEGGER_RTT=y
CONFIG_ASSERT=y

CONFIG_BT=y
CONFIG_BT_MAX_CONN=1
CONFIG_BT_SMP=y
CONFIG_BT_BONDABLE=y
CONFIG_BT_PERIPHERAL=y
CONFIG_BT_DEVICE_NAME="nRF Edge AI HAR"
CONFIG_BT_DEVICE_APPEARANCE=576

CONFIG_BT_DIS=y
CONFIG_BT_DIS_PNP=y
CONFIG_BT_DIS_MANUF_NAME_STR="NordicSemiconductor"
CONFIG_BT_DIS_PNP_VID_SRC=2
CONFIG_BT_DIS_PNP_VID=0x1915
CONFIG_BT_DIS_PNP_PID=0xEEEF
CONFIG_BT_DIS_PNP_VER=0x0100

CONFIG_BT_SETTINGS=y
CONFIG_FLASH=y
CONFIG_FLASH_PAGE_LAYOUT=y
CONFIG_FLASH_MAP=y
CONFIG_NVS=y
CONFIG_SETTINGS=y

CONFIG_MAIN_STACK_SIZE=4096
CONFIG_SYSTEM_WORKQUEUE_STACK_SIZE=2048

CONFIG_BLE_NUS_OUTPUT=y
```

## src/main.c
```c
/*
 * Copyright (c) 2026 Nordic Semiconductor ASA
 *
 * SPDX-License-Identifier: LicenseRef-Nordic-5-Clause
 */

#include <stddef.h>
#include <string.h>

#include <zephyr/drivers/sensor.h>
#include <zephyr/kernel.h>
#include <zephyr/logging/log.h>
#include <zephyr/sys/util.h>

#include <nrf_edgeai/nrf_edgeai.h>
#include <nrf_edgeai_user_model.h>

#include "activity_led.h"
#include "button/button.h"
#include "inference_postprocessing.h"
#include "sensor/imu/imu.h"

#if IS_ENABLED(CONFIG_BLE_NUS_OUTPUT)
#include "ble/nus/ble_nus.h"
#endif
#include "ble/ble_common.h"

LOG_MODULE_REGISTER(main);

#define NRF_EDGEAI_INPUT_DATA_LEN (ACCEL_AXIS_NUM + GYRO_AXIS_NUM)
#define IMU_SAMPLE_RATE_HZ (50)
#define HAR_INPUT_WINDOW_SAMPLES (128)

BUILD_ASSERT(HAR_INPUT_WINDOW_SAMPLES > 0);

typedef struct accel_window_s {
	float sum_g[ACCEL_AXIS_NUM];
	float samples_g[HAR_INPUT_WINDOW_SAMPLES][ACCEL_AXIS_NUM];
	int index;
	int count;
} accel_window_t;

static void execute_inference(flt32_t *input_data);
static void hw_modules_init(void);
static void handle_inference_result(nrf_edgeai_t *model);
static void publish_classification(class_label_t class_label, float probability);
static void report_raw_prediction(uint16_t predicted_target, float probability);
static void on_button_click(button_click_t click);
static void accel_window_reset(void);
static void accel_window_push(float x_g, float y_g, float z_g);
static void accel_window_get_average(float *x_g, float *y_g, float *z_g);

static struct k_sem imu_data_ready_sem;
static accel_window_t accel_window;
static nrf_edgeai_t *p_model;

int main(void)
{
	hw_modules_init();

	p_model = nrf_edgeai_user_model();
	__ASSERT_NO_MSG(p_model != NULL);
	__ASSERT_NO_MSG(nrf_edgeai_is_runtime_compatible(p_model));

	__maybe_unused nrf_edgeai_err_t res = nrf_edgeai_init(p_model);

	__ASSERT_NO_MSG(res == NRF_EDGEAI_ERR_SUCCESS);
	__ASSERT_NO_MSG(p_model->input.window_size == HAR_INPUT_WINDOW_SAMPLES);

	nrf_edgeai_rt_version_t version = nrf_edgeai_runtime_version();

	LOG_INF("nRF Edge AI Human Activity Recognition Demo");
	LOG_INF("nRF Edge AI Runtime Version: %d.%d.%d", version.field.major, version.field.minor,
		version.field.patch);
	LOG_INF("nRF Edge AI Lab Solution id: %s", nrf_edgeai_solution_id_str(p_model));

	imu_data_t imu_data = {0};
	flt32_t input_data[NRF_EDGEAI_INPUT_DATA_LEN];

	for (;;) {
		k_sem_take(&imu_data_ready_sem, K_FOREVER);

		if (imu_read(&imu_data) != STATUS_SUCCESS) {
			continue;
		}

		accel_window_push(imu_data.accel[0].g, imu_data.accel[1].g, imu_data.accel[2].g);

		/* Model expects accelerometer in g and gyroscope in rad/s. */
		input_data[0] = (flt32_t)(imu_data.accel[0].g);
		input_data[1] = (flt32_t)(imu_data.accel[1].g);
		input_data[2] = (flt32_t)(imu_data.accel[2].g);
		input_data[3] = (flt32_t)imu_data.gyro[0].rad_s;
		input_data[4] = (flt32_t)imu_data.gyro[1].rad_s;
		input_data[5] = (flt32_t)imu_data.gyro[2].rad_s;

		LOG_DBG("Accelerometer [G]: %f, %f, %f",
			(double)input_data[0], (double)input_data[1], (double)input_data[2]);
		LOG_DBG("Gyroscope [rad/s]: %f, %f, %f",
			(double)input_data[3], (double)input_data[4], (double)input_data[5]);

		execute_inference(input_data);
	}

	return 0;
}

static void imu_data_ready_cb(void)
{
	k_sem_give(&imu_data_ready_sem);
}

static void on_button_click(button_click_t click)
{
	int err;

	if (click != BUTTON_CLICK_SHORT) {
		return;
	}

	LOG_INF("Next phase");
	accel_window_reset();

#if IS_ENABLED(CONFIG_BLE_NUS_OUTPUT)
	err = ble_nus_send_message("Next phase");
	if (err != 0 && err != -ENOTCONN) {
		LOG_WRN("Failed to send phase marker over NUS (err %d)", err);
	}
#endif
}

static void accel_window_reset(void)
{
	memset(&accel_window, 0, sizeof(accel_window));
}

static void accel_window_push(float x_g, float y_g, float z_g)
{
	const float sample_g[ACCEL_AXIS_NUM] = {x_g, y_g, z_g};

	if (accel_window.count == HAR_INPUT_WINDOW_SAMPLES) {
		for (int axis = 0; axis < ACCEL_AXIS_NUM; axis++) {
			accel_window.sum_g[axis] -= accel_window.samples_g[accel_window.index][axis];
		}
	} else {
		accel_window.count++;
	}

	for (int axis = 0; axis < ACCEL_AXIS_NUM; axis++) {
		accel_window.samples_g[accel_window.index][axis] = sample_g[axis];
		accel_window.sum_g[axis] += sample_g[axis];
	}

	accel_window.index = (accel_window.index + 1) % HAR_INPUT_WINDOW_SAMPLES;
}

static void accel_window_get_average(float *x_g, float *y_g, float *z_g)
{
	float inv_count = 1.0f / (float)accel_window.count;

	*x_g = accel_window.sum_g[0] * inv_count;
	*y_g = accel_window.sum_g[1] * inv_count;
	*z_g = accel_window.sum_g[2] * inv_count;
}

static void hw_modules_init(void)
{
	int ret;
	imu_config_t imu_config = {
		.accel_fs_g = IMU_ACCEL_SCALE_2G,
		.gyro_fs_dps = IMU_GYRO_SCALE_1000DPS,
		.data_rate_hz = IMU_SAMPLE_RATE_HZ,
	};

	ret = activity_led_init();
	if (ret != 0) {
		LOG_ERR("Failed to initialize activity LED module (err %d)", ret);
	}

	ret = button_init();
	if (ret != 0) {
		LOG_ERR("Failed to initialize button module (err %d)", ret);
	}

	status_t status = imu_init(&imu_config, imu_data_ready_cb);

	if (status != STATUS_SUCCESS) {
		LOG_ERR("Failed to initialize IMU sensor, error = %d", (int)status);
		__ASSERT_NO_MSG(false);
	}

	k_sem_init(&imu_data_ready_sem, 0, 1);
	accel_window_reset();
	button_reg_click_handler(on_button_click);
	ble_common_init();

#if IS_ENABLED(CONFIG_BLE_NUS_OUTPUT)
	ret = ble_nus_init();
	if (ret != 0) {
		LOG_ERR("Failed to initialize BLE NUS service (err %d)", ret);
	}
#endif
}

static void execute_inference(flt32_t *input_data)
{
	nrf_edgeai_err_t res;

	res = nrf_edgeai_feed_inputs(p_model, (void *)input_data, NRF_EDGEAI_INPUT_DATA_LEN);

	if (res == NRF_EDGEAI_ERR_SUCCESS) {
		res = nrf_edgeai_run_inference(p_model);

		if (res == NRF_EDGEAI_ERR_SUCCESS) {
			handle_inference_result(p_model);
		} else {
			LOG_WRN("Failed to run inference, error = %d", (int)res);
		}
	} else if (res != NRF_EDGEAI_ERR_INPROGRESS) {
		LOG_WRN("Failed to feed inputs, error = %d", (int)res);
	}
}

static void publish_classification(class_label_t class_label, float probability)
{
	const char *class_name = inference_get_class_name(class_label);
	int probability_pct = (int)(100.0f * probability);
	float accel_x_g;
	float accel_y_g;
	float accel_z_g;

	accel_window_get_average(&accel_x_g, &accel_y_g, &accel_z_g);

	LOG_INF("Activity: %s (%d %%) accel avg [g]: %.3f, %.3f, %.3f", class_name,
		probability_pct, (double)accel_x_g, (double)accel_y_g, (double)accel_z_g);
	activity_led_show_class(class_label);

#if IS_ENABLED(CONFIG_BLE_NUS_OUTPUT)
	if (ble_common_is_connected()) {
		int err = ble_nus_send_classification(NULL, class_name, probability_pct, accel_x_g,
						     accel_y_g, accel_z_g);

		if (err != 0 && err != -ENOTCONN) {
			LOG_WRN("Failed to send classification over NUS (err %d)", err);
		}
	}
#endif
}

static void report_raw_prediction(uint16_t predicted_target, float probability)
{
#if IS_ENABLED(CONFIG_HAR_LOG_RAW_PREDICTIONS)
	const char *class_name = inference_get_class_name((class_label_t)predicted_target);
	int probability_pct = (int)(100.0f * probability);
	float accel_x_g;
	float accel_y_g;
	float accel_z_g;

	accel_window_get_average(&accel_x_g, &accel_y_g, &accel_z_g);

	LOG_INF("Raw: %s (%d %%) accel avg [g]: %.3f, %.3f, %.3f", class_name, probability_pct,
		(double)accel_x_g, (double)accel_y_g, (double)accel_z_g);

#if IS_ENABLED(CONFIG_BLE_NUS_OUTPUT)
	if (ble_common_is_connected()) {
		int err = ble_nus_send_classification("RAW,", class_name, probability_pct,
						      accel_x_g, accel_y_g, accel_z_g);

		if (err != 0 && err != -ENOTCONN) {
			LOG_WRN("Failed to send raw prediction over NUS (err %d)", err);
		}
	}
#endif
#else
	ARG_UNUSED(predicted_target);
	ARG_UNUSED(probability);
#endif
}

static void handle_inference_result(nrf_edgeai_t *model)
{
	uint16_t predicted_target;
	const flt32_t *p_probabilities;
	class_label_t class_label;
	float probability;

	__ASSERT_NO_MSG(model != NULL);

	predicted_target = model->decoded_output.classif.predicted_class;
	p_probabilities = model->decoded_output.classif.probabilities.p_f32;
	__ASSERT_NO_MSG(p_probabilities != NULL);

#if IS_ENABLED(CONFIG_HAR_INFERENCE_POSTPROCESSING)
	report_raw_prediction(predicted_target, p_probabilities[predicted_target]);

	prediction_ctx_t result =
		inference_postprocess(predicted_target, p_probabilities[predicted_target]);

	if (result.target >= CLASS_LABEL_COUNT) {
		return;
	}

	class_label = (class_label_t)result.target;
	probability = result.probability;
#else
	if (predicted_target >= CLASS_LABEL_COUNT) {
		LOG_INF("Activity: UNKNOWN");
		return;
	}

	class_label = (class_label_t)predicted_target;
	probability = p_probabilities[predicted_target];
#endif

	publish_classification(class_label, probability);
}
```

## src/activity_led.c
```c
/*
 * Copyright (c) 2026 Nordic Semiconductor ASA
 *
 * SPDX-License-Identifier: LicenseRef-Nordic-5-Clause
 */

#include "activity_led.h"

#include <zephyr/kernel.h>
#include <zephyr/logging/log.h>

#include "led/led.h"

LOG_MODULE_REGISTER(activity_led, CONFIG_LOG_DEFAULT_LEVEL);

#define ACTIVITY_LED_MAX_BRIGHTNESS (0.35f)
#define CONNECTED_LED_BRIGHTNESS (0.25f)
#define NOTIFY_BLINK_COUNT (3)
#define NOTIFY_BLINK_ON_MS (100)
#define NOTIFY_BLINK_OFF_MS (200)
#define NUS_TX_PULSE_MS (80)
#define NUS_TX_PULSE_BRIGHTNESS (1.0f)

typedef struct activity_color_s {
	float red;
	float green;
	float blue;
} activity_color_t;

static const activity_color_t CLASS_COLORS[] = {
	[CLASS_LABEL_WALKING] = {0.0f, 1.0f, 0.0f},
	[CLASS_LABEL_WALKING_UPSTAIRS] = {0.0f, 1.0f, 1.0f},
	[CLASS_LABEL_WALKING_DOWNSTAIRS] = {1.0f, 1.0f, 0.0f},
	[CLASS_LABEL_SITTING] = {0.0f, 0.0f, 1.0f},
	[CLASS_LABEL_STANDING] = {1.0f, 0.0f, 1.0f},
	[CLASS_LABEL_LYING] = {1.0f, 0.0f, 0.0f},
};

static const activity_color_t DISCONNECTED_COLOR = {0.15f, 0.15f, 0.15f};
static const activity_color_t CONNECTED_COLOR = {0.0f, 0.0f, 1.0f};

static bool ble_connected;
static class_label_t current_class = CLASS_LABEL_UNKNOWN;
static bool notify_blink_active;
static int notify_blink_remaining;
static activity_color_t notify_blink_color;
static float notify_blink_brightness;
static struct k_work_delayable notify_blink_work;
static struct k_work_delayable nus_tx_pulse_work;

static void apply_color(const activity_color_t *color, float brightness_scale)
{
	(void)led_set_leds(color->red * brightness_scale, color->green * brightness_scale,
			   color->blue * brightness_scale);
}

static const activity_color_t *current_display_color(void)
{
	if (!ble_connected) {
		return &DISCONNECTED_COLOR;
	}

	if (current_class < CLASS_LABEL_COUNT) {
		return &CLASS_COLORS[current_class];
	}

	return &CONNECTED_COLOR;
}

static float current_display_brightness(void)
{
	if (ble_connected && (current_class >= CLASS_LABEL_COUNT)) {
		return CONNECTED_LED_BRIGHTNESS;
	}

	return ACTIVITY_LED_MAX_BRIGHTNESS;
}

static void apply_current_state(void)
{
	apply_color(current_display_color(), current_display_brightness());
}

static void notify_blink_step(struct k_work *work)
{
	ARG_UNUSED(work);

	if (notify_blink_remaining <= 0) {
		notify_blink_active = false;
		apply_current_state();
		return;
	}

	if (notify_blink_remaining % 2 == 0) {
		apply_color(&notify_blink_color, notify_blink_brightness);
		notify_blink_remaining--;
		k_work_schedule(&notify_blink_work, K_MSEC(NOTIFY_BLINK_ON_MS));
		return;
	}

	(void)led_off();
	notify_blink_remaining--;
	if (notify_blink_remaining > 0) {
		k_work_schedule(&notify_blink_work, K_MSEC(NOTIFY_BLINK_OFF_MS));
		return;
	}

	notify_blink_active = false;
	apply_current_state();
}

static void start_notify_blink(const activity_color_t *blink_color, float brightness)
{
	k_work_cancel_delayable(&notify_blink_work);
	k_work_cancel_delayable(&nus_tx_pulse_work);

	notify_blink_color = *blink_color;
	notify_blink_brightness = brightness;
	notify_blink_active = true;
	notify_blink_remaining = NOTIFY_BLINK_COUNT * 2;
	k_work_schedule(&notify_blink_work, K_NO_WAIT);
}

static void nus_tx_pulse_end(struct k_work *work)
{
	ARG_UNUSED(work);

	if (!notify_blink_active) {
		apply_current_state();
	}
}

int activity_led_init(void)
{
	int ret = led_init();

	k_work_init_delayable(&notify_blink_work, notify_blink_step);
	k_work_init_delayable(&nus_tx_pulse_work, nus_tx_pulse_end);

	ble_connected = false;
	current_class = CLASS_LABEL_UNKNOWN;
	apply_current_state();

	return ret;
}

void activity_led_show_class(class_label_t class_label)
{
	if (class_label >= CLASS_LABEL_COUNT) {
		current_class = CLASS_LABEL_UNKNOWN;
	} else {
		current_class = class_label;
	}

	if (!notify_blink_active) {
		apply_current_state();
	}
}

void activity_led_set_ble_connected(bool connected)
{
	ble_connected = connected;

	if (connected) {
		start_notify_blink(&CONNECTED_COLOR, CONNECTED_LED_BRIGHTNESS);
		return;
	}

	current_class = CLASS_LABEL_UNKNOWN;
	start_notify_blink(&DISCONNECTED_COLOR, ACTIVITY_LED_MAX_BRIGHTNESS);
}

void activity_led_nus_tx_pulse(void)
{
	if (notify_blink_active) {
		return;
	}

	k_work_cancel_delayable(&nus_tx_pulse_work);
	apply_color(current_display_color(), NUS_TX_PULSE_BRIGHTNESS);
	k_work_schedule(&nus_tx_pulse_work, K_MSEC(NUS_TX_PULSE_MS));
}
```

## src/activity_led.h
```c
/*
 * Copyright (c) 2026 Nordic Semiconductor ASA
 *
 * SPDX-License-Identifier: LicenseRef-Nordic-5-Clause
 */

#ifndef __ACTIVITY_LED_H__
#define __ACTIVITY_LED_H__

#include "inference_postprocessing.h"

#include <stdbool.h>

#ifdef __cplusplus
extern "C" {
#endif

int activity_led_init(void);

void activity_led_show_class(class_label_t class_label);

void activity_led_set_ble_connected(bool connected);

void activity_led_nus_tx_pulse(void);

#ifdef __cplusplus
}
#endif

#endif /* __ACTIVITY_LED_H__ */
```

## src/inference_postprocessing.c
```c
/*
 * Copyright (c) 2026 Nordic Semiconductor ASA
 *
 * SPDX-License-Identifier: LicenseRef-Nordic-5-Clause
 */

#include "inference_postprocessing.h"

#include <stdbool.h>
#include <zephyr/kernel.h>
#include <zephyr/sys/util.h>

static const char *get_name_by_target(uint8_t predicted_target)
{
	static const char *const LABEL_VS_NAME[] = {
		[CLASS_LABEL_WALKING] = "WALKING",
		[CLASS_LABEL_WALKING_UPSTAIRS] = "WALKING_UPSTAIRS",
		[CLASS_LABEL_WALKING_DOWNSTAIRS] = "WALKING_DOWNSTAIRS",
		[CLASS_LABEL_SITTING] = "SITTING",
		[CLASS_LABEL_STANDING] = "STANDING",
		[CLASS_LABEL_LYING] = "LYING",
	};

	BUILD_ASSERT(ARRAY_SIZE(LABEL_VS_NAME) == CLASS_LABEL_COUNT);

	if (predicted_target >= CLASS_LABEL_COUNT) {
		return "UNKNOWN";
	}

	return LABEL_VS_NAME[predicted_target];
}

#if IS_ENABLED(CONFIG_HAR_INFERENCE_POSTPROCESSING)

/* Consecutive identical raw predictions required before a class is published.
 *
 * The counts are asymmetric on purpose. A class the model often predicts by
 * mistake must clear a higher bar than the class it is taken from, or the
 * false positive always wins the race to the repeat count. WALKING is the
 * dominant confusion for WALKING_UPSTAIRS, so while a stair ascent is in
 * progress a lower count for WALKING lets almost every window be published as
 * level walking.
 *
 * Probabilities are averaged for reporting but never gated: on-device testing
 * showed the model is over-confident on the ambulation classes, so a
 * probability threshold suppresses correct and incorrect predictions alike.
 */
static const uint16_t MIN_REPEAT_COUNT[] = {
	[CLASS_LABEL_WALKING] = 3,
	[CLASS_LABEL_WALKING_UPSTAIRS] = 2,
	[CLASS_LABEL_WALKING_DOWNSTAIRS] = 3,
	[CLASS_LABEL_SITTING] = 3,
	[CLASS_LABEL_STANDING] = 3,
	[CLASS_LABEL_LYING] = 2,
};

BUILD_ASSERT(ARRAY_SIZE(MIN_REPEAT_COUNT) == CLASS_LABEL_COUNT);

/** Current run of identical raw predictions. */
typedef struct prediction_run_s {
	uint16_t target;
	uint16_t count;
	float probability_sum;
} prediction_run_t;

/** Raw predictions accumulated since the last published classification. */
typedef struct prediction_history_s {
	uint16_t count[CLASS_LABEL_COUNT];
	float probability_sum[CLASS_LABEL_COUNT];
	int64_t last_publish_uptime_ms;
} prediction_history_t;

static prediction_run_t prediction_run = {
	.target = CLASS_LABEL_UNKNOWN,
};

static prediction_history_t prediction_history;

static void reset_run(uint16_t target)
{
	prediction_run.target = target;
	prediction_run.count = 0;
	prediction_run.probability_sum = 0.0f;
}

static void reset_history(void)
{
	prediction_history = (prediction_history_t){
		.last_publish_uptime_ms = k_uptime_get(),
	};
}

static bool publish_timeout_expired(void)
{
	int64_t elapsed_ms = k_uptime_get() - prediction_history.last_publish_uptime_ms;

	return elapsed_ms >= CONFIG_HAR_POSTPROCESSING_PUBLISH_TIMEOUT_MS;
}

/**
 * @brief Pick the class predicted most often since the last published result.
 *
 * Used when the raw prediction keeps changing and no class ever reaches its
 * repeat count. Ties are resolved in favour of the higher accumulated
 * probability.
 */
static prediction_ctx_t most_frequent_prediction(void)
{
	prediction_ctx_t result = {
		.target = CLASS_LABEL_UNKNOWN,
		.probability = 0.0f,
	};
	uint16_t best_count = 0;
	float best_sum = 0.0f;

	for (uint16_t target = 0; target < CLASS_LABEL_COUNT; target++) {
		uint16_t count = prediction_history.count[target];
		float sum = prediction_history.probability_sum[target];

		if (count == 0) {
			continue;
		}

		if (count > best_count || (count == best_count && sum > best_sum)) {
			best_count = count;
			best_sum = sum;
			result.target = target;
			result.probability = sum / count;
		}
	}

	return result;
}

prediction_ctx_t inference_postprocess(uint16_t target, float probability)
{
	prediction_ctx_t result = {
		.target = CLASS_LABEL_UNKNOWN,
		.probability = 0.0f,
	};

	if (target >= CLASS_LABEL_COUNT) {
		reset_run(CLASS_LABEL_UNKNOWN);
		return result;
	}

	if (prediction_run.target != target) {
		reset_run(target);
	}

	prediction_run.count++;
	prediction_run.probability_sum += probability;
	prediction_history.count[target]++;
	prediction_history.probability_sum[target] += probability;

	if (prediction_run.count >= MIN_REPEAT_COUNT[target]) {
		result.target = target;
		result.probability = prediction_run.probability_sum / prediction_run.count;
	} else if (publish_timeout_expired()) {
		result = most_frequent_prediction();
	} else {
		return result;
	}

	reset_run(target);
	reset_history();
	return result;
}

#endif /* IS_ENABLED(CONFIG_HAR_INFERENCE_POSTPROCESSING) */

const char *inference_get_class_name(class_label_t class_label)
{
	if (class_label >= CLASS_LABEL_COUNT) {
		return "UNKNOWN";
	}

	return get_name_by_target((uint8_t)class_label);
}
```

## src/inference_postprocessing.h
```c
/*
 * Copyright (c) 2026 Nordic Semiconductor ASA
 *
 * SPDX-License-Identifier: LicenseRef-Nordic-5-Clause
 */

#ifndef __INFERENCE_POSTPROCESSING_H__
#define __INFERENCE_POSTPROCESSING_H__

#include <stdint.h>

typedef enum {
	CLASS_LABEL_WALKING = 0,
	CLASS_LABEL_WALKING_UPSTAIRS,
	CLASS_LABEL_WALKING_DOWNSTAIRS,
	CLASS_LABEL_SITTING,
	CLASS_LABEL_STANDING,
	CLASS_LABEL_LYING,
	CLASS_LABEL_COUNT,
	CLASS_LABEL_UNKNOWN = 0xFF,
} class_label_t;

typedef struct prediction_ctx_s {
	uint16_t target;
	float probability;
} prediction_ctx_t;

prediction_ctx_t inference_postprocess(uint16_t predicted_target, float probability);

const char *inference_get_class_name(class_label_t class_label);

#endif /* __INFERENCE_POSTPROCESSING_H__ */
```
