/*
 * Copyright (c) 2026 Nordic Semiconductor ASA
 *
 * SPDX-License-Identifier: LicenseRef-Nordic-5-Clause
 */

/* Match the MCUboot partition shrink applied to the application image so that
 * FPROTECT inside MCUboot can cover the boot partition on this SoC.
 */
/delete-node/ &boot_partition;

&cpuapp_rram {
	partitions {
		compatible = "fixed-partitions";
		#address-cells = <1>;
		#size-cells = <1>;

		boot_partition: partition@0 {
			label = "mcuboot";
			reg = <0x00000000 0x0000f800>;
		};
	};
};
