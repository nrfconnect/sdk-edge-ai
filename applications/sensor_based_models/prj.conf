## CMakeLists.txt
```
#
# Copyright (c) 2026 Nordic Semiconductor ASA
#
# SPDX-License-Identifier: LicenseRef-Nordic-5-Clause
#

cmake_minimum_required(VERSION 3.20.0)

find_package(Zephyr REQUIRED HINTS $ENV{ZEPHYR_BASE})
project(sensor_based_models)

target_include_directories(app PRIVATE
  ${CMAKE_CURRENT_SOURCE_DIR}/src/hw_modules
  ${CMAKE_CURRENT_SOURCE_DIR}/src/ble
)

if(CONFIG_SBM_HAR_MODEL)
  target_include_directories(app PRIVATE
    ${CMAKE_CURRENT_SOURCE_DIR}/src/models/har
  )
endif()

if(CONFIG_SBM_CAPTURE_24_MODEL)
  target_include_directories(app PRIVATE
    ${CMAKE_CURRENT_SOURCE_DIR}/src/models/capture_24
  )
endif()

target_sources(app PRIVATE
  ${CMAKE_CURRENT_SOURCE_DIR}/src/main.c
  ${CMAKE_CURRENT_SOURCE_DIR}/src/inference_postprocessing.c
  ${CMAKE_CURRENT_SOURCE_DIR}/src/activity_led.c
  ${CMAKE_CURRENT_SOURCE_DIR}/src/hw_modules/button/button.c
  ${CMAKE_CURRENT_SOURCE_DIR}/src/hw_modules/led/led.c
  ${CMAKE_CURRENT_SOURCE_DIR}/src/hw_modules/sensor/imu/imu.c
  ${CMAKE_CURRENT_SOURCE_DIR}/src/ble/ble_common.c
)

target_sources_ifdef(CONFIG_SBM_OBSERVABILITY app PRIVATE
  ${CMAKE_CURRENT_SOURCE_DIR}/src/sbm_obsv.c
)

if(CONFIG_SBM_HAR_MODEL)
  target_sources(app PRIVATE
    ${CMAKE_CURRENT_SOURCE_DIR}/src/models/har/nrf_edgeai_user_model.c
  )
endif()

if(CONFIG_SBM_CAPTURE_24_MODEL)
  target_sources(app PRIVATE
    ${CMAKE_CURRENT_SOURCE_DIR}/src/models/capture_24/nrf_edgeai_user_model.c
  )
endif()

if(CONFIG_BLE_NUS_OUTPUT)
  target_sources(app PRIVATE ${CMAKE_CURRENT_SOURCE_DIR}/src/ble/ble_services.c)
endif()
```

## Kconfig
```
#
# Copyright (c) 2026 Nordic Semiconductor
#
# SPDX-License-Identifier: LicenseRef-Nordic-5-Clause
#

choice SBM_MODEL_CHOICE
	prompt "Choose the model to use"
	default SBM_HAR_MODEL

	config SBM_HAR_MODEL
		bool "Use the HAR model"
		help
		  Use the HAR (Human Activity Recognition) model recognizing
		  the following activities:
		  - Walking
		  - Sitting
		  - Standing
		  - Lying

	config SBM_CAPTURE_24_MODEL
		bool "Use the Capture-24 model"
		help
		  Use the Capture-24 model recognizing the following activities:
		  - Bicycling
		  - Sleep
		  - Vehicle
		  - Waling
endchoice

config SBM_INFERENCE_POSTPROCESSING
	bool "Apply inference postprocessing before publishing"
	help
	  When enabled, classification output is stabilized by requiring a
	  per-class number of consecutive identical predictions before being
	  logged, shown on the LED, and sent over BLE.

	  When disabled, every raw model prediction is logged and published.

config SBM_POSTPROCESSING_PUBLISH_TIMEOUT_MS
	int "Maximum time without a published classification [ms]"
	depends on SBM_INFERENCE_POSTPROCESSING
	range 1000 60000
	default 8000
	help
	  While the activity changes, the raw prediction may keep alternating so
	  that no class ever reaches its repeat count and nothing is published.
	  Once this time has passed without any output, the class predicted most
	  often since the last published result is published instead.

	  The gap is bounded by this value plus one inference period, because the
	  timeout is only evaluated when a new raw prediction arrives.

config SBM_LOG_RAW_PREDICTIONS
	bool "Report every raw prediction, before post-processing"
	depends on SBM_INFERENCE_POSTPROCESSING
	help
	  When enabled, every model output is reported with a "RAW," prefix in
	  addition to the results that postprocessing decides to publish. Both
	  line types carry the same fields, so a recording can be analyzed as a
	  raw prediction stream, as a published stream, or as both.

config SBM_OBSERVABILITY
	bool "Edge AI output observability"
	depends on NRF_EDGEAI_OBSV
	depends on NRF_EDGEAI_OBSV_MEMFAULT
	help
	  Collect observability metrics from the model class-probability
	  output. Input and feature metrics are not collected.

config BLE_NUS_OUTPUT
	bool "Send classification results over BLE NUS"
	depends on BT && BT_SMP
	select BT_NUS
	help
	  When enabled, recognized activity class, probability and average
	  acceleration values are sent as text over the Nordic UART Service.

source "Kconfig.zephyr"
```

## Kconfig.sysbuild
```
#
# Copyright (c) 2026 Nordic Semiconductor
#
# SPDX-License-Identifier: LicenseRef-Nordic-5-Clause
#

source "share/sysbuild/Kconfig"
```

## sample.yaml
```
sample:
  description: Sensor based models application
  name: sensor based models

common:
  sysbuild: true
  tags:
    - ci_build
    - sysbuild
    - ci_applications_sensor_based_models
  harness: console
  harness_config:
    type: multi_line
    ordered: false
    regex:
      - "Booting MCUboot"
      - "I: Starting bootloader"
      - "I: Jumping to the first image slot"
      - "Booting nRF Connect SDK"
      - "nRF Edge AI Sensor Based Models Demo"
      - "nRF Edge AI Runtime Version:"
      - "nRF Edge AI Lab Solution id:"

tests:
  applications.sensor_based_models.default:
    build_only: true
    platform_allow:
      - nrf54l15tag/nrf54l15/cpuapp
    integration_platforms:
      - nrf54l15tag/nrf54l15/cpuapp
  applications.sensor_based_models.nus:
    build_only: true
    platform_allow:
      - nrf54l15tag/nrf54l15/cpuapp
    integration_platforms:
      - nrf54l15tag/nrf54l15/cpuapp
    extra_args:
      - CONFIG_BLE_NUS_OUTPUT=y
  applications.sensor_based_models.observability:
    build_only: true
    platform_allow:
      - nrf54l15tag/nrf54l15/cpuapp
    integration_platforms:
      - nrf54l15tag/nrf54l15/cpuapp
    extra_args:
      - EXTRA_CONF_FILE="observability.conf"
```

## prj.conf
```kconfig
#
# Copyright (c) 2026 Nordic Semiconductor
#
# SPDX-License-Identifier: LicenseRef-Nordic-5-Clause
#

CONFIG_NRF_EDGEAI=y
CONFIG_FPU=y

# CONFIG_SPI=y
CONFIG_SENSOR=y
CONFIG_GPIO=y

CONFIG_LOG=y
CONFIG_LOG_BACKEND_RTT=y
CONFIG_USE_SEGGER_RTT=y
CONFIG_ASSERT=y

CONFIG_BT=y
CONFIG_BT_MAX_CONN=1
CONFIG_BT_SMP=y
CONFIG_BT_BONDABLE=y
CONFIG_BT_PERIPHERAL=y
CONFIG_BT_DEVICE_NAME="nRF Edge AI SBM"
CONFIG_BT_DEVICE_APPEARANCE=576

CONFIG_BT_DIS=y
CONFIG_BT_DIS_PNP=y
CONFIG_BT_DIS_MANUF_NAME_STR="NordicSemiconductor"
CONFIG_BT_DIS_PNP_VID_SRC=2
CONFIG_BT_DIS_PNP_VID=0x1915
CONFIG_BT_DIS_PNP_PID=0xEEEF
CONFIG_BT_DIS_PNP_VER=0x0100

CONFIG_BT_SETTINGS=y
CONFIG_FLASH=y
CONFIG_FLASH_PAGE_LAYOUT=y
CONFIG_FLASH_MAP=y
CONFIG_NVS=y
CONFIG_SETTINGS=y

CONFIG_MAIN_STACK_SIZE=4096
CONFIG_SYSTEM_WORKQUEUE_STACK_SIZE=2048

CONFIG_BLE_NUS_OUTPUT=y
```

## observability.conf
```kconfig
#
# Copyright (c) 2026 Nordic Semiconductor
#
# SPDX-License-Identifier: LicenseRef-Nordic-5-Clause
#

# Enable output observability.
CONFIG_NRF_EDGEAI_OBSV=y
CONFIG_NRF_EDGEAI_OBSV_ENCODE=y
CONFIG_SBM_OBSERVABILITY=y

# Both available models have four classes.
CONFIG_NRF_EDGEAI_OBSV_MAX_CLASSES=4
CONFIG_SYSTEM_WORKQUEUE_STACK_SIZE=8192

# Output probability metrics.
CONFIG_NRF_EDGEAI_OBSV_METRIC_CLASS_PRED_DIST=y
CONFIG_NRF_EDGEAI_OBSV_CLASS_PRED_DIST_BIN_NUM=16
CONFIG_NRF_EDGEAI_OBSV_CLASS_PRED_DIST_STREAK_TOP_BIN=30
CONFIG_NRF_EDGEAI_OBSV_CLASS_PRED_DIST_STREAK_TOL=1
CONFIG_NRF_EDGEAI_OBSV_METRIC_TRANSITION_MATRIX=y
CONFIG_NRF_EDGEAI_OBSV_METRIC_MODEL_CERTAINTY_DESC=y
CONFIG_NRF_EDGEAI_OBSV_MODEL_CERTAINTY_DESC_BIN_NUM=16

# Enable Memfault observability and automatic collection.
CONFIG_NRF_EDGEAI_OBSV_MEMFAULT=y
CONFIG_NRF_EDGEAI_OBSV_MEMFAULT_AUTO_COLLECT=y
CONFIG_NRF_EDGEAI_OBSV_MEMFAULT_AUTO_COLLECT_INTERVAL_SEC=60
CONFIG_ZCBOR=y

CONFIG_MEMFAULT=y
CONFIG_MEMFAULT_USER_CONFIG_ENABLE=n
CONFIG_MEMFAULT_NCS_PROJECT_KEY=""
CONFIG_MEMFAULT_NCS_DEVICE_ID_STATIC=y
CONFIG_MEMFAULT_NCS_DEVICE_ID="sbm-obsv"

# Upload observability data through the Memfault Diagnostic Service.
CONFIG_BT_MDS=y
CONFIG_BT_PRIVACY=y
CONFIG_BT_DEVICE_NAME="SBM Obsv"
CONFIG_BT_MAX_CONN=2

CONFIG_BT_BUF_ACL_RX_SIZE=251
CONFIG_BT_L2CAP_TX_MTU=247
CONFIG_BT_BUF_ACL_TX_SIZE=251
CONFIG_BT_CTLR_DATA_LENGTH_MAX=251
```

## prj_capture_24.conf
```kconfig
#
# Copyright (c) 2026 Nordic Semiconductor
#
# SPDX-License-Identifier: LicenseRef-Nordic-5-Clause
#

CONFIG_NRF_EDGEAI=y
CONFIG_FPU=y

# CONFIG_SPI=y
CONFIG_SENSOR=y
CONFIG_GPIO=y

CONFIG_LOG=y
CONFIG_LOG_BACKEND_RTT=y
CONFIG_USE_SEGGER_RTT=y
CONFIG_ASSERT=y

CONFIG_BT=y
CONFIG_BT_MAX_CONN=1
CONFIG_BT_SMP=y
CONFIG_BT_BONDABLE=y
CONFIG_BT_PERIPHERAL=y
CONFIG_BT_DEVICE_NAME="nRF Edge AI SBM"
CONFIG_BT_DEVICE_APPEARANCE=576

CONFIG_BT_DIS=y
CONFIG_BT_DIS_PNP=y
CONFIG_BT_DIS_MANUF_NAME_STR="NordicSemiconductor"
CONFIG_BT_DIS_PNP_VID_SRC=2
CONFIG_BT_DIS_PNP_VID=0x1915
CONFIG_BT_DIS_PNP_PID=0xEEEF
CONFIG_BT_DIS_PNP_VER=0x0100

CONFIG_BT_SETTINGS=y
CONFIG_FLASH=y
CONFIG_FLASH_PAGE_LAYOUT=y
CONFIG_FLASH_MAP=y
CONFIG_NVS=y
CONFIG_SETTINGS=y

CONFIG_MAIN_STACK_SIZE=4096
CONFIG_SYSTEM_WORKQUEUE_STACK_SIZE=2048

CONFIG_BLE_NUS_OUTPUT=y

CONFIG_SBM_CAPTURE_24_MODEL=y
```

## src/main.c
```c
/*
 * Copyright (c) 2026 Nordic Semiconductor ASA
 *
 * SPDX-License-Identifier: LicenseRef-Nordic-5-Clause
 */

#include <stddef.h>
#include <string.h>

#include <zephyr/drivers/sensor.h>
#include <zephyr/kernel.h>
#include <zephyr/logging/log.h>
#include <zephyr/sys/util.h>

#include <nrf_edgeai/nrf_edgeai.h>
#include <nrf_edgeai_user_model.h>

#include "activity_led.h"
#include "button/button.h"
#include "inference_postprocessing.h"
#include "sensor/imu/imu.h"

#if IS_ENABLED(CONFIG_SBM_OBSERVABILITY)
#include "sbm_obsv.h"
#endif

#if IS_ENABLED(CONFIG_BLE_NUS_OUTPUT)
#include "ble/ble_services.h"
#endif
#include "ble/ble_common.h"

LOG_MODULE_REGISTER(main);

#if IS_ENABLED(CONFIG_SBM_HAR_MODEL)
#define NRF_EDGEAI_INPUT_DATA_LEN (ACCEL_AXIS_NUM + GYRO_AXIS_NUM)
#elif IS_ENABLED(CONFIG_SBM_CAPTURE_24_MODEL)
#define NRF_EDGEAI_INPUT_DATA_LEN (ACCEL_AXIS_NUM)
#endif

#if IS_ENABLED(CONFIG_SBM_HAR_MODEL)
#define INPUT_WINDOW_SAMPLES (50)
#elif IS_ENABLED(CONFIG_SBM_CAPTURE_24_MODEL)
#define INPUT_WINDOW_SAMPLES (200)
#endif

BUILD_ASSERT(INPUT_WINDOW_SAMPLES > 0);

typedef struct accel_window_s {
	float sum_g[ACCEL_AXIS_NUM];
	float samples_g[INPUT_WINDOW_SAMPLES][ACCEL_AXIS_NUM];
	int index;
	int count;
} accel_window_t;

static struct k_sem imu_data_ready_sem;
static accel_window_t accel_window;
static nrf_edgeai_t *p_model;

static void imu_data_ready_cb(void)
{
	k_sem_give(&imu_data_ready_sem);
}

static void accel_window_reset(void)
{
	memset(&accel_window, 0, sizeof(accel_window));
}

static void accel_window_push(float x_g, float y_g, float z_g)
{
	const float sample_g[ACCEL_AXIS_NUM] = {x_g, y_g, z_g};

	if (accel_window.count == INPUT_WINDOW_SAMPLES) {
		for (int axis = 0; axis < ACCEL_AXIS_NUM; axis++) {
			accel_window.sum_g[axis] -= accel_window.samples_g[accel_window.index][axis];
		}
	} else {
		accel_window.count++;
	}

	for (int axis = 0; axis < ACCEL_AXIS_NUM; axis++) {
		accel_window.samples_g[accel_window.index][axis] = sample_g[axis];
		accel_window.sum_g[axis] += sample_g[axis];
	}

	accel_window.index = (accel_window.index + 1) % INPUT_WINDOW_SAMPLES;
}

static void accel_window_get_average(float *x_g, float *y_g, float *z_g)
{
	__ASSERT_NO_MSG(accel_window.count > 0);

	float inv_count = 1.0f / (float)accel_window.count;

	*x_g = accel_window.sum_g[0] * inv_count;
	*y_g = accel_window.sum_g[1] * inv_count;
	*z_g = accel_window.sum_g[2] * inv_count;
}

static void on_button_click(button_click_t click)
{
	if (click == BUTTON_CLICK_SHORT) {
		LOG_INF("next");
		accel_window_reset();

#if IS_ENABLED(CONFIG_BLE_NUS_OUTPUT)
		int err = ble_nus_send_message("next");

		if (err != 0) {
			LOG_WRN("Failed to send phase marker over NUS (err %d)", err);
		}
#endif
	} else if (click == BUTTON_CLICK_LONG) {
#if IS_ENABLED(CONFIG_BLE_NUS_OUTPUT)
		LOG_INF("Long press: removing Bluetooth bonds");
		int err = ble_nus_unpair();

		if (err) {
			LOG_ERR("Failed to remove Bluetooth bonds (err %d)", err);
		}
#endif
	}
}

static const imu_config_t imu_config = {
#if IS_ENABLED(CONFIG_SBM_HAR_MODEL)
	.accel_fs_g   = IMU_ACCEL_SCALE_2G,
	.gyro_fs_dps  = IMU_GYRO_SCALE_1000DPS,
	.data_rate_hz = 50,
	.accel_enabled = true,
	.gyro_enabled  = true,
#elif IS_ENABLED(CONFIG_SBM_CAPTURE_24_MODEL)
	.accel_fs_g   = IMU_ACCEL_SCALE_8G,
	.gyro_fs_dps  = IMU_GYRO_SCALE_UNDEFINED,
	.data_rate_hz = 100,
	.accel_enabled = true,
	.gyro_enabled  = false,
#endif
};

static void hw_modules_init(void)
{
	int ret;

	ret = activity_led_init();
	if (ret != 0) {
		LOG_ERR("Failed to initialize activity LED module (err %d)", ret);
	}

	ret = button_init();
	if (ret != 0) {
		LOG_ERR("Failed to initialize button module (err %d)", ret);
	}

	int imu_ret = imu_init(&imu_config, imu_data_ready_cb);

	if (imu_ret != 0) {
		LOG_ERR("Failed to initialize IMU sensor, error = %d", imu_ret);
		__ASSERT_NO_MSG(false);
	}

	k_sem_init(&imu_data_ready_sem, 0, 1);
	accel_window_reset();
	button_reg_click_handler(on_button_click);
	ble_common_init();

#if IS_ENABLED(CONFIG_BLE_NUS_OUTPUT)
	ret = ble_nus_init();
	if (ret != 0) {
		LOG_ERR("Failed to initialize BLE NUS service (err %d)", ret);
	}
#endif
}

static void publish_classification(class_label_t class_label, float probability)
{
	const char *class_name = inference_get_class_name(class_label);
	int probability_pct = (int)(100.0f * probability);
	float accel_x_g;
	float accel_y_g;
	float accel_z_g;

	accel_window_get_average(&accel_x_g, &accel_y_g, &accel_z_g);

	LOG_INF("Activity: %s (%d %%) accel avg [g]: %.3f, %.3f, %.3f", class_name,
		probability_pct, (double)accel_x_g, (double)accel_y_g, (double)accel_z_g);
	activity_led_show_class(class_label);

#if IS_ENABLED(CONFIG_BLE_NUS_OUTPUT)
	if (ble_common_is_connected()) {
		int err = ble_nus_send_classification(NULL, class_name, probability_pct, accel_x_g,
						     accel_y_g, accel_z_g);

		if (err != 0 && err != -ENOTCONN) {
			LOG_WRN("Failed to send classification over NUS (err %d)", err);
		}
	}
#endif
}

#if IS_ENABLED(CONFIG_SBM_LOG_RAW_PREDICTIONS)
static void report_raw_prediction(uint16_t predicted_target, float probability)
{
	const char *class_name = inference_get_class_name((class_label_t)predicted_target);
	int probability_pct = (int)(100.0f * probability);
	float accel_x_g;
	float accel_y_g;
	float accel_z_g;

	accel_window_get_average(&accel_x_g, &accel_y_g, &accel_z_g);

	LOG_INF("Raw: %s (%d %%) accel avg [g]: %.3f, %.3f, %.3f", class_name, probability_pct,
		(double)accel_x_g, (double)accel_y_g, (double)accel_z_g);

#if IS_ENABLED(CONFIG_BLE_NUS_OUTPUT)
	if (ble_common_is_connected()) {
		int err = ble_nus_send_classification("RAW,", class_name, probability_pct,
						      accel_x_g, accel_y_g, accel_z_g);

		if (err != 0 && err != -ENOTCONN) {
			LOG_WRN("Failed to send raw prediction over NUS (err %d)", err);
		}
	}
#endif
}
#endif

static void handle_inference_result(nrf_edgeai_t *model)
{
	uint16_t predicted_target;
	const flt32_t *p_probabilities;
	class_label_t class_label;
	float probability;

	__ASSERT_NO_MSG(model != NULL);

	predicted_target = model->decoded_output.classif.predicted_class;
	p_probabilities = model->decoded_output.classif.probabilities.p_f32;
	__ASSERT_NO_MSG(p_probabilities != NULL);

#if IS_ENABLED(CONFIG_SBM_OBSERVABILITY)
	sbm_obsv_update_probs(p_probabilities);
#endif

#if IS_ENABLED(CONFIG_SBM_INFERENCE_POSTPROCESSING)
	report_raw_prediction(predicted_target, p_probabilities[predicted_target]);

	prediction_ctx_t result =
		inference_postprocess(predicted_target, p_probabilities[predicted_target]);

	if (result.target >= CLASS_LABEL_COUNT) {
		return;
	}

	class_label = (class_label_t)result.target;
	probability = result.probability;
#else
	if (predicted_target >= CLASS_LABEL_COUNT) {
		LOG_INF("Activity: UNKNOWN");
		return;
	}

	class_label = (class_label_t)predicted_target;
	probability = p_probabilities[predicted_target];
#endif

	publish_classification(class_label, probability);
}

static void execute_inference(flt32_t *input_data)
{
	nrf_edgeai_err_t res;

	res = nrf_edgeai_feed_inputs(p_model, (void *)input_data, NRF_EDGEAI_INPUT_DATA_LEN);

	if (res == NRF_EDGEAI_ERR_SUCCESS) {
		res = nrf_edgeai_run_inference(p_model);

		if (res == NRF_EDGEAI_ERR_SUCCESS) {
			handle_inference_result(p_model);
		} else {
			LOG_WRN("Failed to run inference, error = %d", (int)res);
		}
	} else if (res != NRF_EDGEAI_ERR_INPROGRESS) {
		LOG_WRN("Failed to feed inputs, error = %d", (int)res);
	}
}

int main(void)
{
	hw_modules_init();

	p_model = nrf_edgeai_user_model();
	__ASSERT_NO_MSG(p_model != NULL);
	__ASSERT_NO_MSG(nrf_edgeai_is_runtime_compatible(p_model));

	__maybe_unused nrf_edgeai_err_t res = nrf_edgeai_init(p_model);

	__ASSERT_NO_MSG(res == NRF_EDGEAI_ERR_SUCCESS);
	__ASSERT_NO_MSG(p_model->input.window_size == INPUT_WINDOW_SAMPLES);

#if IS_ENABLED(CONFIG_SBM_OBSERVABILITY)
	int obsv_err = sbm_obsv_init(p_model);

	if (obsv_err) {
		LOG_ERR("Observability init failed (err %d)", obsv_err);
	}
#endif

	nrf_edgeai_rt_version_t version = nrf_edgeai_runtime_version();

	LOG_INF("nRF Edge AI Sensor Based Models Demo");
	LOG_INF("nRF Edge AI Runtime Version: %d.%d.%d", version.field.major, version.field.minor,
		version.field.patch);
	LOG_INF("nRF Edge AI Lab Solution id: %s", nrf_edgeai_solution_id_str(p_model));

	imu_data_t imu_data = {0};
	flt32_t input_data[NRF_EDGEAI_INPUT_DATA_LEN];

	for (;;) {
		k_sem_take(&imu_data_ready_sem, K_FOREVER);

		if (imu_read(&imu_data) != 0) {
			continue;
		}

		accel_window_push(imu_data.accel[0].g, imu_data.accel[1].g, imu_data.accel[2].g);

		/* Model expects accelerometer in g and gyroscope in rad/s. */
		input_data[0] = (flt32_t)(imu_data.accel[0].g);
		input_data[1] = (flt32_t)(imu_data.accel[1].g);
		input_data[2] = (flt32_t)(imu_data.accel[2].g);
#if IS_ENABLED(CONFIG_SBM_HAR_MODEL)
		input_data[3] = (flt32_t)imu_data.gyro[0].rad_s;
		input_data[4] = (flt32_t)imu_data.gyro[1].rad_s;
		input_data[5] = (flt32_t)imu_data.gyro[2].rad_s;
#endif

		LOG_DBG("Accelerometer [G]: %f, %f, %f",
			(double)input_data[0], (double)input_data[1], (double)input_data[2]);

#if IS_ENABLED(CONFIG_SBM_HAR_MODEL)
		LOG_DBG("Gyroscope [rad/s]: %f, %f, %f",
			(double)input_data[3], (double)input_data[4], (double)input_data[5]);
#endif

		execute_inference(input_data);
	}

	return 0;
}
```

## src/activity_led.c
```c
/*
 * Copyright (c) 2026 Nordic Semiconductor ASA
 *
 * SPDX-License-Identifier: LicenseRef-Nordic-5-Clause
 */

#include "activity_led.h"

#include <zephyr/kernel.h>
#include <zephyr/logging/log.h>

#include "led/led.h"

LOG_MODULE_REGISTER(activity_led, CONFIG_LOG_DEFAULT_LEVEL);

#define ACTIVITY_LED_MAX_BRIGHTNESS (0.35f)
#define CONNECTED_LED_BRIGHTNESS (0.25f)
#define NOTIFY_BLINK_COUNT (3)
#define NOTIFY_BLINK_ON_MS (100)
#define NOTIFY_BLINK_OFF_MS (200)
#define NUS_TX_PULSE_MS (80)
#define NUS_TX_PULSE_BRIGHTNESS (1.0f)

typedef struct activity_color_s {
	float red;
	float green;
	float blue;
} activity_color_t;

#if IS_ENABLED(CONFIG_SBM_HAR_MODEL)
static const activity_color_t CLASS_COLORS[] = {
	[CLASS_LABEL_WALKING] = {0.0f, 1.0f, 0.0f},
	[CLASS_LABEL_SITTING] = {0.0f, 0.0f, 1.0f},
	[CLASS_LABEL_STANDING] = {1.0f, 0.0f, 1.0f},
	[CLASS_LABEL_LYING] = {1.0f, 0.0f, 0.0f},
};
#elif IS_ENABLED(CONFIG_SBM_CAPTURE_24_MODEL)
static const activity_color_t CLASS_COLORS[] = {
	[CLASS_LABEL_BICYCLING] = {0.0f, 1.0f, 0.0f},
	[CLASS_LABEL_SLEEP] = {0.0f, 1.0f, 1.0f},
	[CLASS_LABEL_VEHICLE] = {1.0f, 1.0f, 0.0f},
	[CLASS_LABEL_WALKING] = {0.0f, 0.0f, 1.0f},
};
#endif

static const activity_color_t DISCONNECTED_COLOR = {0.15f, 0.15f, 0.15f};
static const activity_color_t CONNECTED_COLOR = {0.0f, 0.0f, 1.0f};

static bool ble_connected;
static class_label_t current_class = CLASS_LABEL_UNKNOWN;
static bool notify_blink_active;
static int notify_blink_remaining;
static activity_color_t notify_blink_color;
static float notify_blink_brightness;
static struct k_work_delayable notify_blink_work;
static struct k_work_delayable nus_tx_pulse_work;

static void apply_color(const activity_color_t *color, float brightness_scale)
{
	(void)led_set_leds(color->red * brightness_scale, color->green * brightness_scale,
			   color->blue * brightness_scale);
}

static const activity_color_t *current_display_color(void)
{
	if (!ble_connected) {
		return &DISCONNECTED_COLOR;
	}

	if (current_class < CLASS_LABEL_COUNT) {
		return &CLASS_COLORS[current_class];
	}

	return &CONNECTED_COLOR;
}

static float current_display_brightness(void)
{
	if (ble_connected && (current_class >= CLASS_LABEL_COUNT)) {
		return CONNECTED_LED_BRIGHTNESS;
	}

	return ACTIVITY_LED_MAX_BRIGHTNESS;
}

static void apply_current_state(void)
{
	apply_color(current_display_color(), current_display_brightness());
}

static void notify_blink_step(struct k_work *work)
{
	ARG_UNUSED(work);

	if (notify_blink_remaining <= 0) {
		notify_blink_active = false;
		apply_current_state();
		return;
	}

	if (notify_blink_remaining % 2 == 0) {
		apply_color(&notify_blink_color, notify_blink_brightness);
		notify_blink_remaining--;
		k_work_schedule(&notify_blink_work, K_MSEC(NOTIFY_BLINK_ON_MS));
		return;
	}

	(void)led_off();
	notify_blink_remaining--;
	if (notify_blink_remaining > 0) {
		k_work_schedule(&notify_blink_work, K_MSEC(NOTIFY_BLINK_OFF_MS));
		return;
	}

	notify_blink_active = false;
	apply_current_state();
}

static void start_notify_blink(const activity_color_t *blink_color, float brightness)
{
	k_work_cancel_delayable(&notify_blink_work);
	k_work_cancel_delayable(&nus_tx_pulse_work);

	notify_blink_color = *blink_color;
	notify_blink_brightness = brightness;
	notify_blink_active = true;
	notify_blink_remaining = NOTIFY_BLINK_COUNT * 2;
	k_work_schedule(&notify_blink_work, K_NO_WAIT);
}

static void nus_tx_pulse_end(struct k_work *work)
{
	ARG_UNUSED(work);

	if (!notify_blink_active) {
		apply_current_state();
	}
}

int activity_led_init(void)
{
	int ret = led_init();

	k_work_init_delayable(&notify_blink_work, notify_blink_step);
	k_work_init_delayable(&nus_tx_pulse_work, nus_tx_pulse_end);

	ble_connected = false;
	current_class = CLASS_LABEL_UNKNOWN;
	apply_current_state();

	return ret;
}

void activity_led_show_class(class_label_t class_label)
{
	if (class_label >= CLASS_LABEL_COUNT) {
		current_class = CLASS_LABEL_UNKNOWN;
	} else {
		current_class = class_label;
	}

	if (!notify_blink_active) {
		apply_current_state();
	}
}

void activity_led_set_ble_connected(bool connected)
{
	ble_connected = connected;

	if (connected) {
		start_notify_blink(&CONNECTED_COLOR, CONNECTED_LED_BRIGHTNESS);
		return;
	}

	current_class = CLASS_LABEL_UNKNOWN;
	start_notify_blink(&DISCONNECTED_COLOR, ACTIVITY_LED_MAX_BRIGHTNESS);
}

void activity_led_nus_tx_pulse(void)
{
	if (notify_blink_active) {
		return;
	}

	k_work_cancel_delayable(&nus_tx_pulse_work);
	apply_color(current_display_color(), NUS_TX_PULSE_BRIGHTNESS);
	k_work_schedule(&nus_tx_pulse_work, K_MSEC(NUS_TX_PULSE_MS));
}
```

## src/inference_postprocessing.c
```c
/*
 * Copyright (c) 2026 Nordic Semiconductor ASA
 *
 * SPDX-License-Identifier: LicenseRef-Nordic-5-Clause
 */

#include "inference_postprocessing.h"

#include <stdbool.h>
#include <zephyr/kernel.h>
#include <zephyr/sys/util.h>

static const char *get_name_by_target(uint8_t predicted_target)
{
#if IS_ENABLED(CONFIG_SBM_HAR_MODEL)
	static const char *const LABEL_VS_NAME[] = {
		[CLASS_LABEL_WALKING] = "WALKING",
		[CLASS_LABEL_SITTING] = "SITTING",
		[CLASS_LABEL_STANDING] = "STANDING",
		[CLASS_LABEL_LYING] = "LYING",
	};
#elif IS_ENABLED(CONFIG_SBM_CAPTURE_24_MODEL)
	static const char *const LABEL_VS_NAME[] = {
		[CLASS_LABEL_BICYCLING] = "BICYCLING",
		[CLASS_LABEL_SLEEP] = "SLEEP",
		[CLASS_LABEL_VEHICLE] = "VEHICLE",
		[CLASS_LABEL_WALKING] = "WALKING",
	};
#endif

	BUILD_ASSERT(ARRAY_SIZE(LABEL_VS_NAME) == CLASS_LABEL_COUNT);

	if (predicted_target >= CLASS_LABEL_COUNT) {
		return "UNKNOWN";
	}

	return LABEL_VS_NAME[predicted_target];
}

#if IS_ENABLED(CONFIG_SBM_INFERENCE_POSTPROCESSING)

/* Consecutive identical raw predictions required before a class is published.
 *
 * Probabilities are averaged for reporting but never gated: on-device testing
 * showed the previous model was over-confident, so a probability threshold
 * suppressed correct and incorrect predictions alike.
 */
static const uint16_t MIN_REPEAT_COUNT[] = {
	[CLASS_LABEL_WALKING] = 3,
	[CLASS_LABEL_SITTING] = 3,
	[CLASS_LABEL_STANDING] = 3,
	[CLASS_LABEL_LYING] = 2,
};

BUILD_ASSERT(ARRAY_SIZE(MIN_REPEAT_COUNT) == CLASS_LABEL_COUNT);

/** Current run of identical raw predictions. */
typedef struct prediction_run_s {
	uint16_t target;
	uint16_t count;
	float probability_sum;
} prediction_run_t;

/** Raw predictions accumulated since the last published classification. */
typedef struct prediction_history_s {
	uint16_t count[CLASS_LABEL_COUNT];
	float probability_sum[CLASS_LABEL_COUNT];
	int64_t last_publish_uptime_ms;
} prediction_history_t;

static prediction_run_t prediction_run = {
	.target = CLASS_LABEL_UNKNOWN,
};

static prediction_history_t prediction_history;

static void reset_run(uint16_t target)
{
	prediction_run.target = target;
	prediction_run.count = 0;
	prediction_run.probability_sum = 0.0f;
}

static void reset_history(void)
{
	prediction_history = (prediction_history_t){
		.last_publish_uptime_ms = k_uptime_get(),
	};
}

static bool publish_timeout_expired(void)
{
	int64_t elapsed_ms = k_uptime_get() - prediction_history.last_publish_uptime_ms;

	return elapsed_ms >= CONFIG_SBM_POSTPROCESSING_PUBLISH_TIMEOUT_MS;
}

/**
 * @brief Pick the class predicted most often since the last published result.
 *
 * Used when the raw prediction keeps changing and no class ever reaches its
 * repeat count. Ties are resolved in favour of the higher accumulated
 * probability.
 */
static prediction_ctx_t most_frequent_prediction(void)
{
	prediction_ctx_t result = {
		.target = CLASS_LABEL_UNKNOWN,
		.probability = 0.0f,
	};
	uint16_t best_count = 0;
	float best_sum = 0.0f;

	for (uint16_t target = 0; target < CLASS_LABEL_COUNT; target++) {
		uint16_t count = prediction_history.count[target];
		float sum = prediction_history.probability_sum[target];

		if (count == 0) {
			continue;
		}

		if (count > best_count || (count == best_count && sum > best_sum)) {
			best_count = count;
			best_sum = sum;
			result.target = target;
			result.probability = sum / count;
		}
	}

	return result;
}

prediction_ctx_t inference_postprocess(uint16_t target, float probability)
{
	prediction_ctx_t result = {
		.target = CLASS_LABEL_UNKNOWN,
		.probability = 0.0f,
	};

	if (target >= CLASS_LABEL_COUNT) {
		reset_run(CLASS_LABEL_UNKNOWN);
		return result;
	}

	if (prediction_run.target != target) {
		reset_run(target);
	}

	prediction_run.count++;
	prediction_run.probability_sum += probability;
	prediction_history.count[target]++;
	prediction_history.probability_sum[target] += probability;

	if (prediction_run.count >= MIN_REPEAT_COUNT[target]) {
		result.target = target;
		result.probability = prediction_run.probability_sum / prediction_run.count;
	} else if (publish_timeout_expired()) {
		result = most_frequent_prediction();
	} else {
		return result;
	}

	reset_run(target);
	reset_history();
	return result;
}

#endif /* IS_ENABLED(CONFIG_SBM_INFERENCE_POSTPROCESSING) */

const char *inference_get_class_name(class_label_t class_label)
{
	if (class_label >= CLASS_LABEL_COUNT) {
		return "UNKNOWN";
	}

	return get_name_by_target((uint8_t)class_label);
}
```

## src/inference_postprocessing.h
```c
/*
 * Copyright (c) 2026 Nordic Semiconductor ASA
 *
 * SPDX-License-Identifier: LicenseRef-Nordic-5-Clause
 */

/**
 * @defgroup app_sbm Sensor Based Models Application
 *
 * @defgroup inference_postprocessing Inference Postprocessing
 * @{
 * @ingroup app_sbm
 */

#ifndef __INFERENCE_POSTPROCESSING_H__
#define __INFERENCE_POSTPROCESSING_H__

#include <stdint.h>
#include <zephyr/sys/util.h>

#if IS_ENABLED(CONFIG_SBM_HAR_MODEL)
typedef enum {
	CLASS_LABEL_WALKING = 0,
	CLASS_LABEL_SITTING,
	CLASS_LABEL_STANDING,
	CLASS_LABEL_LYING,
	CLASS_LABEL_COUNT,
	CLASS_LABEL_UNKNOWN = 0xFF,
} class_label_t;
#elif IS_ENABLED(CONFIG_SBM_CAPTURE_24_MODEL)
typedef enum {
	CLASS_LABEL_BICYCLING = 0,
	CLASS_LABEL_SLEEP,
	CLASS_LABEL_VEHICLE,
	CLASS_LABEL_WALKING,
	CLASS_LABEL_COUNT,
	CLASS_LABEL_UNKNOWN = 0xFF,
} class_label_t;
#endif

typedef struct prediction_ctx_s {
	uint16_t target;
	float probability;
} prediction_ctx_t;

#if IS_ENABLED(CONFIG_SBM_INFERENCE_POSTPROCESSING)
prediction_ctx_t inference_postprocess(uint16_t predicted_target, float probability);
#endif

const char *inference_get_class_name(class_label_t class_label);

#endif /* __INFERENCE_POSTPROCESSING_H__ */
```

## src/sbm_obsv.c
```c
/*
 * Copyright (c) 2026 Nordic Semiconductor ASA
 *
 * SPDX-License-Identifier: LicenseRef-Nordic-5-Clause
 */

#include <zephyr/logging/log.h>
#include <zephyr/sys/__assert.h>
#include <zephyr/sys/util.h>

#include <nrf_edgeai_obsv/nrf_edgeai_obsv.h>
#include <nrf_edgeai_obsv/nrf_edgeai_obsv_memfault.h>
#include <nrf_edgeai_obsv/nrf_edgeai_obsv_metrics.h>

#include "inference_postprocessing.h"
#include "sbm_obsv.h"

LOG_MODULE_REGISTER(sbm_obsv);

#define SBM_OBSV_CLASSES CLASS_LABEL_COUNT
#define OBSV_WORDS(bytes) DIV_ROUND_UP(bytes, sizeof(uint32_t))

#if IS_ENABLED(CONFIG_SBM_HAR_MODEL)
#define SBM_OBSV_MODEL_ID 1U
#elif IS_ENABLED(CONFIG_SBM_CAPTURE_24_MODEL)
#define SBM_OBSV_MODEL_ID 2U
#endif

BUILD_ASSERT(CONFIG_NRF_EDGEAI_OBSV_MAX_CLASSES >= SBM_OBSV_CLASSES,
	     "CONFIG_NRF_EDGEAI_OBSV_MAX_CLASSES is below the model class count");

static nrf_edgeai_obsv_ctx_t ctx;

#if defined(CONFIG_NRF_EDGEAI_OBSV_METRIC_CLASS_PRED_DIST)
static nrf_edgeai_obsv_metric_t cpd;
static uint32_t cpd_buf[OBSV_WORDS(NRF_EDGEAI_OBSV_CPD_STORAGE_BYTES(SBM_OBSV_CLASSES))];
#endif
#if defined(CONFIG_NRF_EDGEAI_OBSV_METRIC_TRANSITION_MATRIX)
static nrf_edgeai_obsv_metric_t tm;
static uint32_t tm_buf[OBSV_WORDS(NRF_EDGEAI_OBSV_TM_STORAGE_BYTES(SBM_OBSV_CLASSES))];
#endif
#if defined(CONFIG_NRF_EDGEAI_OBSV_METRIC_MODEL_CERTAINTY_DESC)
static nrf_edgeai_obsv_metric_t mcd;
static uint32_t mcd_buf[OBSV_WORDS(NRF_EDGEAI_OBSV_MCD_STORAGE_BYTES(SBM_OBSV_CLASSES))];
#endif

static int model_info_get(nrf_edgeai_t *model, nrf_edgeai_obsv_model_info_t *info)
{
	__ASSERT_NO_MSG(model != NULL);
	__ASSERT_NO_MSG(info != NULL);
	__ASSERT_NO_MSG(nrf_edgeai_model_outputs_num(model) == SBM_OBSV_CLASSES);

	const nrf_edgeai_dsp_feature_extraction_t *features_ctx =
		nrf_edgeai_dsp_features_ctx(model);

	info->model_id = SBM_OBSV_MODEL_ID;
	info->num_classes = SBM_OBSV_CLASSES;
	info->num_features = features_ctx != NULL ? features_ctx->overall_num : 0;
	info->version = model->metadata.version.combined;

	return 0;
}

int sbm_obsv_init(nrf_edgeai_t *model)
{
	nrf_edgeai_obsv_model_info_t info;
	int err;

	err = model_info_get(model, &info);
	if (err) {
		LOG_ERR("Failed to get model info (err %d)", err);
		return err;
	}

	err = nrf_edgeai_obsv_init(&ctx, &info);
	if (err) {
		LOG_ERR("Observability init failed (err %d)", err);
		return err;
	}

#if defined(CONFIG_NRF_EDGEAI_OBSV_METRIC_CLASS_PRED_DIST)
	nrf_edgeai_obsv_metric_cpd_create(&cpd, cpd_buf, SBM_OBSV_CLASSES);
	err = nrf_edgeai_obsv_register(&ctx, &cpd, NULL);
	if (err) {
		LOG_ERR("Failed to register cpd metric (err %d)", err);
		return err;
	}
#endif
#if defined(CONFIG_NRF_EDGEAI_OBSV_METRIC_TRANSITION_MATRIX)
	nrf_edgeai_obsv_metric_tm_create(&tm, tm_buf, SBM_OBSV_CLASSES);
	err = nrf_edgeai_obsv_register(&ctx, &tm, NULL);
	if (err) {
		LOG_ERR("Failed to register tm metric (err %d)", err);
		return err;
	}
#endif
#if defined(CONFIG_NRF_EDGEAI_OBSV_METRIC_MODEL_CERTAINTY_DESC)
	nrf_edgeai_obsv_metric_mcd_create(&mcd, mcd_buf, SBM_OBSV_CLASSES);
	err = nrf_edgeai_obsv_register(&ctx, &mcd, NULL);
	if (err) {
		LOG_ERR("Failed to register mcd metric (err %d)", err);
		return err;
	}
#endif

	err = nrf_edgeai_obsv_memfault_init(&ctx);
	if (err) {
		LOG_ERR("Memfault transport init failed (err %d)", err);
	}

	return err;
}

void sbm_obsv_update_probs(const float *probs)
{
	int err = nrf_edgeai_obsv_update_probs(&ctx, probs);

	if (err) {
		LOG_ERR("Failed to update probs (err %d)", err);
	}
}
```

## src/sbm_obsv.h
```c
/*
 * Copyright (c) 2026 Nordic Semiconductor ASA
 *
 * SPDX-License-Identifier: LicenseRef-Nordic-5-Clause
 */

#ifndef SBM_OBSV_H_
#define SBM_OBSV_H_

#include <nrf_edgeai/nrf_edgeai.h>

/** @brief Initialize output observability for the sensor-based model.
 *
 * @param[in] model Initialized Edge AI model used to read model metadata.
 *
 * @return 0 on success, or a negative errno code on failure.
 */
int sbm_obsv_init(nrf_edgeai_t *model);

/** @brief Feed one class-probability vector to the output metrics.
 *
 * @param[in] probs Probability per model output class, in label order.
 */
void sbm_obsv_update_probs(const float *probs);

#endif /* SBM_OBSV_H_ */
```
