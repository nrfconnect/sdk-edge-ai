/*
 * Copyright (c) 2026 Nordic Semiconductor ASA
 *
 * SPDX-License-Identifier: LicenseRef-Nordic-5-Clause
 *
 * Link the MCUboot child image into boot_partition (not slot0).
 * Same pattern as nrf/samples/dfu/smp_svr/sysbuild/mcuboot/boards/.
 */

/ {
	chosen {
		zephyr,code-partition = &boot_partition;
	};
};
