## CMakeLists.txt
```
#
# Copyright (c) 2026 Nordic Semiconductor ASA
#
# SPDX-License-Identifier: LicenseRef-Nordic-5-Clause
#

cmake_minimum_required(VERSION 3.20.0)

find_package(Zephyr REQUIRED HINTS $ENV{ZEPHYR_BASE})
project(model_observability)

target_include_directories(app PRIVATE
  ${CMAKE_CURRENT_SOURCE_DIR}/src
  ${CMAKE_CURRENT_SOURCE_DIR}/src/nrf_edgeai_generated
)

target_sources(app PRIVATE
  ${CMAKE_CURRENT_SOURCE_DIR}/src/main.c
  ${CMAKE_CURRENT_SOURCE_DIR}/src/accel.c
  ${CMAKE_CURRENT_SOURCE_DIR}/src/ux_state_manager.c
  ${CMAKE_CURRENT_SOURCE_DIR}/src/nrf_edgeai_generated/nrf_edgeai_user_model.c
)

target_sources_ifdef(CONFIG_MODEL_OBSERVABILITY app PRIVATE src/model_obsv.c)
target_sources_ifdef(CONFIG_APP_BLE_NUS app PRIVATE src/ble/ble_nus.c)
target_sources_ifdef(CONFIG_APP_BLE_MDS app PRIVATE src/ble/ble_mds.c)
```

## Kconfig
```
#
# Copyright (c) 2026 Nordic Semiconductor ASA
#
# SPDX-License-Identifier: LicenseRef-Nordic-5-Clause
#

menu "Model Observability application"

config MODEL_OBSERVABILITY
	bool "Edge AI observability for the model"
	depends on NRF_EDGEAI_OBSV
	depends on NRF_EDGEAI_OBSV_MEMFAULT
	help
	  Collect observability metrics from the model output probabilities
	  (src/model_obsv.c) and publish them as a Memfault CDR.

choice APP_BLE
	prompt "Bluetooth LE service"
	default APP_BLE_NUS

config APP_BLE_NUS
	bool "Nordic UART Service (NUS)"
	help
	  Send the recognized class and its probability as a
	  "<class>,<probability_pct>\r\n" text line after each inference.

config APP_BLE_MDS
	bool "Memfault Diagnostic Service (MDS)"
	help
	  Expose the staged observability CDR over MDS. A bonded phone
	  (nRF Memfault app) drains it and forwards it to the Memfault cloud.
	  The recognized class is only logged, not sent over Bluetooth LE.

endchoice

configdefault BT_NUS
	default y if APP_BLE_NUS

configdefault BT_MDS
	default y if APP_BLE_MDS

configdefault BT_SMP
	default y if APP_BLE_MDS

endmenu

source "Kconfig.zephyr"
```

## sample.yaml
```
sample:
  description: Model Observability application
  name: model observability

common:
  sysbuild: true
  build_only: true
  tags:
    - ci_build
    - sysbuild
    - ci_applications_model_observability
  platform_allow:
    - nrf54l15tag/nrf54l15/cpuapp
  integration_platforms:
    - nrf54l15tag/nrf54l15/cpuapp

tests:
  applications.model_observability: {}

  applications.model_observability.obsv:
    extra_args:
      - EXTRA_CONF_FILE="observability.conf"
```

## prj.conf
```kconfig
#
# Copyright (c) 2026 Nordic Semiconductor
#
# SPDX-License-Identifier: LicenseRef-Nordic-5-Clause
#

# nRF Edge AI
CONFIG_NRF_EDGEAI=y
# nRF Edge AI dependencies
CONFIG_FPU=y

# Enable sensor and LED
CONFIG_SPI=y
CONFIG_SENSOR=y
CONFIG_BMI270=y
CONFIG_GPIO=y

# Enable logging and assert
CONFIG_LOG=y
CONFIG_CONSOLE=y
CONFIG_USE_SEGGER_RTT=y
CONFIG_ASSERT=y

# Bluetooth configuration. The service is selected with CONFIG_APP_BLE_NUS
# (default, sends the recognized class) or CONFIG_APP_BLE_MDS (see observability.conf)
CONFIG_BT=y
CONFIG_BT_PERIPHERAL=y
CONFIG_BT_DEVICE_NAME="nRF Edge AI Obsv"
```

## observability.conf
```kconfig
#
# Copyright (c) 2026 Nordic Semiconductor
#
# SPDX-License-Identifier: LicenseRef-Nordic-5-Clause
#

# Enable observability
CONFIG_NRF_EDGEAI_OBSV=y
CONFIG_NRF_EDGEAI_OBSV_ENCODE=y
CONFIG_MODEL_OBSERVABILITY=y

# Bluetooth LE service:
#   CONFIG_APP_BLE_MDS=y - collect observability and forward the CDR to Memfault over MDS
#   CONFIG_APP_BLE_MDS=n - send the recognized class over NUS (observability is
#                          not initialized or updated)
CONFIG_APP_BLE_MDS=y

# Resource sizing: the model has 4 classes. The workqueue stack holds the
# CDR encode buffer used by auto collect.
CONFIG_NRF_EDGEAI_OBSV_MAX_CLASSES=4
CONFIG_NRF_EDGEAI_OBSV_MEMFAULT_MAX_CONTEXTS=1
CONFIG_SYSTEM_WORKQUEUE_STACK_SIZE=4096

# Output metrics
CONFIG_NRF_EDGEAI_OBSV_METRIC_CLASS_PRED_DIST=y
CONFIG_NRF_EDGEAI_OBSV_CLASS_PRED_DIST_BIN_NUM=16
CONFIG_NRF_EDGEAI_OBSV_CLASS_PRED_DIST_STREAK_TOP_BIN=30
CONFIG_NRF_EDGEAI_OBSV_CLASS_PRED_DIST_STREAK_TOL=1
CONFIG_NRF_EDGEAI_OBSV_METRIC_TRANSITION_MATRIX=y
CONFIG_NRF_EDGEAI_OBSV_METRIC_MODEL_CERTAINTY_DESC=y
CONFIG_NRF_EDGEAI_OBSV_MODEL_CERTAINTY_DESC_BIN_NUM=16

# Enable Memfault observability and auto collect
CONFIG_NRF_EDGEAI_OBSV_MEMFAULT=y
CONFIG_NRF_EDGEAI_OBSV_MEMFAULT_AUTO_COLLECT=y
CONFIG_NRF_EDGEAI_OBSV_MEMFAULT_AUTO_COLLECT_INTERVAL_SEC=180
CONFIG_ZCBOR=y

# Memfault settings
CONFIG_MEMFAULT=y
CONFIG_MEMFAULT_USER_CONFIG_ENABLE=n
CONFIG_MEMFAULT_NCS_PROJECT_KEY=""
CONFIG_MEMFAULT_NCS_DEVICE_ID_STATIC=y
CONFIG_MEMFAULT_NCS_DEVICE_ID="addon-model-obsv"

# Bluetooth buffers for MDS chunk transfer
CONFIG_BT_PRIVACY=y
CONFIG_BT_BUF_ACL_RX_SIZE=251
CONFIG_BT_L2CAP_TX_MTU=247
CONFIG_BT_BUF_ACL_TX_SIZE=251
CONFIG_BT_CTLR_DATA_LENGTH_MAX=251

# Enable bonding
CONFIG_SETTINGS=y
CONFIG_ZMS=y
CONFIG_BT_SETTINGS=y
CONFIG_FLASH=y
CONFIG_FLASH_PAGE_LAYOUT=y
CONFIG_FLASH_MAP=y
```

## src/main.c
```c
/*
 * Copyright (c) 2026 Nordic Semiconductor ASA
 *
 * SPDX-License-Identifier: LicenseRef-Nordic-5-Clause
 */
#include <errno.h>
#include <math.h>
#include <zephyr/kernel.h>
#include <zephyr/logging/log.h>

#include <nrf_edgeai/nrf_edgeai.h>
#include <nrf_edgeai_user_model.h>

#include "accel.h"
#include "ble/ble_mds.h"
#include "ble/ble_nus.h"
#include "model_obsv.h"
#include "ux_state_manager.h"

/* One value per feed: accelerometer magnitude sqrt(ax^2 + ay^2 + az^2), m/s^2 */
#define NRF_EDGEAI_INPUT_DATA_LEN (1U)

LOG_MODULE_REGISTER(main);

static K_SEM_DEFINE(accel_data_ready_sem, 0, 1);

static void accel_data_ready_cb(void)
{
	k_sem_give(&accel_data_ready_sem);
}

static nrf_edgeai_t *nrf_edgeai_init_model(void)
{
	nrf_edgeai_t *p_model = nrf_edgeai_user_model();

	__ASSERT_NO_MSG(p_model != NULL);
	__ASSERT_NO_MSG(nrf_edgeai_is_runtime_compatible(p_model));
	/* The model must be trained on the data_forwarder BMI270 float dataset */
	__ASSERT(nrf_edgeai_input_type(p_model) == NRF_EDGEAI_INPUT_F32,
		 "Model input must be float32");
	__ASSERT(nrf_edgeai_uniq_inputs_num(p_model) == NRF_EDGEAI_INPUT_DATA_LEN,
		 "Model must take %u input (acc_mag)", NRF_EDGEAI_INPUT_DATA_LEN);

	nrf_edgeai_err_t res = nrf_edgeai_init(p_model);

	__ASSERT_NO_MSG(res == NRF_EDGEAI_ERR_SUCCESS);

	nrf_edgeai_rt_version_t version = nrf_edgeai_runtime_version();

	LOG_INF("nRF Edge AI Model Observability Demo:");
	LOG_INF("nRF Edge AI Runtime Version: %d.%d.%d", version.field.major, version.field.minor,
		version.field.patch);
	LOG_INF("nRF Edge AI Lab Solution id: %s", nrf_edgeai_solution_id_str(p_model));

	return p_model;
}

static void handle_inference_result(nrf_edgeai_t *p_model)
{
	int err;
	uint16_t predicted_class;
	const flt32_t *p_probabilities;

	predicted_class = p_model->decoded_output.classif.predicted_class;
	p_probabilities = p_model->decoded_output.classif.probabilities.p_f32;
	__ASSERT_NO_MSG(p_probabilities != NULL);

	/* update the LED color based on the predicted class */
	uxsm_set_current_activity(predicted_class);

#if IS_ENABLED(CONFIG_APP_BLE_MDS)
	/* feed the class probabilities to the model observability metrics (MDS)*/
	err = model_obsv_update_probs(p_probabilities);
	if (err != 0) {
		LOG_WRN("Failed to update model observability, error = %d", err);
	}
#else
	uint8_t probability_pct;

	probability_pct = (uint8_t)(100.0f * p_probabilities[predicted_class]);

	/* send the recognized class over NUS */
	err = ble_nus_send_result(predicted_class, probability_pct);
	if ((err != 0) && (err != -ENOTCONN)) {
		LOG_WRN("Failed to send result over NUS, error = %d", err);
	}
#endif
}

int main(void)
{
	int err;
	nrf_edgeai_err_t res;

	err = uxsm_init();
	__ASSERT(err == 0, "Failed to initialize UX state manager");

	nrf_edgeai_t *p_model = nrf_edgeai_init_model();

	__ASSERT_NO_MSG(p_model != NULL);

#if IS_ENABLED(CONFIG_APP_BLE_MDS)
	err = model_obsv_init(p_model);
	__ASSERT(err == 0, "Failed to initialize model observability (err %d)", err);

	err = ble_mds_init(uxsm_set_ble_connected);
	__ASSERT(err == 0, "Failed to initialize BLE MDS service (err %d)", err);

#else
	err = ble_nus_init(uxsm_set_ble_connected);
	__ASSERT(err == 0, "Failed to initialize BLE NUS service (err %d)", err);
#endif

	err = accel_init(accel_data_ready_cb);
	__ASSERT(err == 0, "Failed to initialize accelerometer (err %d)", err);

	float accel[ACCEL_AXES_NUM];
	flt32_t input_data[NRF_EDGEAI_INPUT_DATA_LEN];

	for (;;) {
		/* Wait for the semaphore to be released by accelerometer data ready timer */
		k_sem_take(&accel_data_ready_sem, K_FOREVER);

		if (accel_read(accel) != 0) {
			continue;
		}

		/* accel = ax, ay, az in m/s^2 */
		input_data[0] =
			sqrtf(accel[0] * accel[0] + accel[1] * accel[1] + accel[2] * accel[2]);

		res = nrf_edgeai_feed_inputs(p_model, (void *)input_data,
					     NRF_EDGEAI_INPUT_DATA_LEN);

		if (res != NRF_EDGEAI_ERR_SUCCESS) {
			/* INPROGRESS is expected until INPUT_WINDOW_SHIFT samples are collected */
			if (res != NRF_EDGEAI_ERR_INPROGRESS) {
				LOG_WRN("Failed to feed inputs, error = %d", (int)res);
			}
			continue;
		}

		/* Input window is full: run the model */
		res = nrf_edgeai_run_inference(p_model);

		if (res != NRF_EDGEAI_ERR_SUCCESS) {
			LOG_WRN("Failed to run inference, error = %d", (int)res);
			continue;
		}

		handle_inference_result(p_model);
	}

	return 0;
}
```

## src/accel.c
```c
/*
 * Copyright (c) 2026 Nordic Semiconductor ASA
 *
 * SPDX-License-Identifier: LicenseRef-Nordic-5-Clause
 */

#include "accel.h"

#include <errno.h>

#include <zephyr/types.h>
#include <zephyr/device.h>
#include <zephyr/kernel.h>
#include <zephyr/drivers/sensor.h>
#include <zephyr/logging/log.h>

LOG_MODULE_REGISTER(accel, LOG_LEVEL_INF);

static const struct device *const accel_dev = DEVICE_DT_GET_ONE(bosch_bmi270);

static accel_data_ready_cb_t accel_data_ready_cb;

static void data_ready_timer_handler(struct k_timer *timer)
{
	ARG_UNUSED(timer);
	if (accel_data_ready_cb) {
		accel_data_ready_cb();
	}
}

static K_TIMER_DEFINE(data_ready_timer, data_ready_timer_handler, NULL);

static int accel_set_attr(enum sensor_attribute attr, int32_t val1)
{
	const struct sensor_value val = {.val1 = val1, .val2 = 0};

	return sensor_attr_set(accel_dev, SENSOR_CHAN_ACCEL_XYZ, attr, &val);
}

int accel_init(accel_data_ready_cb_t data_ready_cb)
{
	int err;

	if (!device_is_ready(accel_dev)) {
		LOG_ERR("Accelerometer device %s is not ready", accel_dev->name);
		return -ENODEV;
	}

	err = accel_set_attr(SENSOR_ATTR_FULL_SCALE, ACCEL_SCALE_G);
	if (err) {
		LOG_ERR("Failed to set full scale to %d G (err %d)", ACCEL_SCALE_G, err);
		return err;
	}

	err = accel_set_attr(SENSOR_ATTR_OVERSAMPLING, 1);
	if (err) {
		LOG_ERR("Failed to set oversampling (err %d)", err);
		return err;
	}

	err = accel_set_attr(SENSOR_ATTR_SAMPLING_FREQUENCY, ACCEL_SAMPLE_RATE_HZ);
	if (err) {
		LOG_ERR("Failed to set sampling frequency to %u Hz (err %d)", ACCEL_SAMPLE_RATE_HZ,
			err);
		return err;
	}

	accel_data_ready_cb = data_ready_cb;
	k_timer_start(&data_ready_timer, K_NO_WAIT, K_NSEC(NSEC_PER_SEC / ACCEL_SAMPLE_RATE_HZ));

	return 0;
}

int accel_read(float p_data[ACCEL_AXES_NUM])
{
	struct sensor_value accel[ACCEL_AXES_NUM];
	int err;

	if (p_data == NULL) {
		LOG_ERR("Output buffer is NULL");
		return -EINVAL;
	}

	/* BMI270 driver supports SENSOR_CHAN_ALL only */
	err = sensor_sample_fetch(accel_dev);
	if (err) {
		return err;
	}

	err = sensor_channel_get(accel_dev, SENSOR_CHAN_ACCEL_XYZ, accel);
	if (err) {
		return err;
	}

	for (uint32_t i = 0; i < ACCEL_AXES_NUM; i++) {
		p_data[i] = sensor_value_to_float(&accel[i]);
	}

	return 0;
}
```

## src/accel.h
```c
/*
 * Copyright (c) 2026 Nordic Semiconductor ASA
 *
 * SPDX-License-Identifier: LicenseRef-Nordic-5-Clause
 */

/**
 *
 * @defgroup accel Accelerometer
 * @{
 * @ingroup app_mo
 *
 * @brief BMI270 accelerometer control functions.
 *
 * Sensor settings and sample conversion match the data_forwarder sample
 * (samples/data_forwarder, BMI270 build) used to collect the training dataset,
 * so the model sees the same data on device as during training.
 */
#ifndef __SENSOR_ACCEL_H__
#define __SENSOR_ACCEL_H__

#ifdef __cplusplus
extern "C" {
#endif /* __cplusplus */

/** Accelerometer full scale in G, as in data_forwarder */
#define ACCEL_SCALE_G (4)

/** Accelerometer sampling rate in Hz, as in data_forwarder */
#define ACCEL_SAMPLE_RATE_HZ (100U)

/** Number of accelerometer axes */
#define ACCEL_AXES_NUM (3U)

/** Data ready callback, called from timer (ISR) context every sample period */
typedef void (*accel_data_ready_cb_t)(void);

/**
 * @brief Initialize the accelerometer and start generation of data ready events
 *
 * @param data_ready_cb Data ready callback, can be NULL
 *
 * @retval 0 Success.
 * @retval -ENODEV Sensor device is not ready.
 * @retval -errno Negative error code from the sensor driver.
 */
int accel_init(accel_data_ready_cb_t data_ready_cb);

/**
 * @brief Read one accelerometer sample
 *
 * Fills @p p_data as ax, ay, az in m/s^2 (Zephyr sensor units), converted
 * with sensor_value_to_float() as in data_forwarder.
 *
 * @param p_data Output buffer of @ref ACCEL_AXES_NUM values
 *
 * @retval 0 Success.
 * @retval -EINVAL @p p_data is NULL.
 * @retval -errno Negative error code from the sensor driver.
 */
int accel_read(float p_data[ACCEL_AXES_NUM]);

#ifdef __cplusplus
}
#endif /* __cplusplus */

#endif /* __SENSOR_ACCEL_H__ */

/**
 * @}
 */
```

## src/model_obsv.c
```c
/*
 * Copyright (c) 2026 Nordic Semiconductor ASA
 *
 * SPDX-License-Identifier: LicenseRef-Nordic-5-Clause
 */

#include "model_obsv.h"

#include <errno.h>
#include <stdlib.h>

#include <zephyr/logging/log.h>
#include <zephyr/sys/util.h>

#include <nrf_edgeai_obsv/nrf_edgeai_obsv.h>
#include <nrf_edgeai_obsv/nrf_edgeai_obsv_memfault.h>
#include <nrf_edgeai_obsv/nrf_edgeai_obsv_metrics.h>

LOG_MODULE_REGISTER(model_obsv, LOG_LEVEL_INF);

/* Metric buffers are sized for the configured maximum; the actual class count
 * is read from the model at init.
 */
#define OBSV_MAX_CLASSES CONFIG_NRF_EDGEAI_OBSV_MAX_CLASSES

#define OBSV_WORDS(bytes) DIV_ROUND_UP(bytes, sizeof(uint32_t))

static nrf_edgeai_obsv_ctx_t ctx;

#if defined(CONFIG_NRF_EDGEAI_OBSV_METRIC_CLASS_PRED_DIST)
static nrf_edgeai_obsv_metric_t cpd;
static uint32_t cpd_buf[OBSV_WORDS(NRF_EDGEAI_OBSV_CPD_STORAGE_BYTES(OBSV_MAX_CLASSES))];
#endif
#if defined(CONFIG_NRF_EDGEAI_OBSV_METRIC_TRANSITION_MATRIX)
static nrf_edgeai_obsv_metric_t tm;
static uint32_t tm_buf[OBSV_WORDS(NRF_EDGEAI_OBSV_TM_STORAGE_BYTES(OBSV_MAX_CLASSES))];
#endif
#if defined(CONFIG_NRF_EDGEAI_OBSV_METRIC_MODEL_CERTAINTY_DESC)
static nrf_edgeai_obsv_metric_t mcd;
static uint32_t mcd_buf[OBSV_WORDS(NRF_EDGEAI_OBSV_MCD_STORAGE_BYTES(OBSV_MAX_CLASSES))];
#endif

static int model_info_get(nrf_edgeai_t *model, nrf_edgeai_obsv_model_info_t *info)
{
	errno = 0;
	const unsigned long model_id = strtoul(nrf_edgeai_solution_id_str(model), NULL, 10);
	const uint16_t num_classes = nrf_edgeai_model_outputs_num(model);

	if ((errno == ERANGE) || ((uint64_t)model_id > UINT32_MAX)) {
		LOG_ERR("Solution id %s does not fit model_id", nrf_edgeai_solution_id_str(model));
		return -EINVAL;
	}

	if ((num_classes == 0) || (num_classes > OBSV_MAX_CLASSES)) {
		LOG_ERR("Model has %u classes, CONFIG_NRF_EDGEAI_OBSV_MAX_CLASSES is %u",
			num_classes, OBSV_MAX_CLASSES);
		return -EINVAL;
	}

	info->model_id = (uint32_t)model_id;
	info->num_classes = num_classes;
	/* No FEATURES-source metrics: the feature stream is unused */
	info->num_features = 0;
	info->version = model->metadata.version.combined;

	return 0;
}

int model_obsv_init(nrf_edgeai_t *model)
{
	nrf_edgeai_obsv_model_info_t info;
	int err;

	__ASSERT_NO_MSG(model != NULL);

	err = model_info_get(model, &info);
	if (err) {
		return err;
	}

	err = nrf_edgeai_obsv_init(&ctx, &info);
	if (err) {
		LOG_ERR("Observability init failed (err %d)", err);
		return err;
	}

	/* The dump and CDR payload follow the registration order */
#if defined(CONFIG_NRF_EDGEAI_OBSV_METRIC_CLASS_PRED_DIST)
	nrf_edgeai_obsv_metric_cpd_create(&cpd, cpd_buf, info.num_classes);
	err = nrf_edgeai_obsv_register(&ctx, &cpd, NULL);
	if (err) {
		LOG_ERR("Failed to register cpd metric (err %d)", err);
		return err;
	}
#endif
#if defined(CONFIG_NRF_EDGEAI_OBSV_METRIC_TRANSITION_MATRIX)
	nrf_edgeai_obsv_metric_tm_create(&tm, tm_buf, info.num_classes);
	err = nrf_edgeai_obsv_register(&ctx, &tm, NULL);
	if (err) {
		LOG_ERR("Failed to register tm metric (err %d)", err);
		return err;
	}
#endif
#if defined(CONFIG_NRF_EDGEAI_OBSV_METRIC_MODEL_CERTAINTY_DESC)
	nrf_edgeai_obsv_metric_mcd_create(&mcd, mcd_buf, info.num_classes);
	err = nrf_edgeai_obsv_register(&ctx, &mcd, NULL);
	if (err) {
		LOG_ERR("Failed to register mcd metric (err %d)", err);
		return err;
	}
#endif

	err = nrf_edgeai_obsv_memfault_init(&ctx);
	if (err) {
		LOG_ERR("Memfault transport init failed (err %d)", err);
		return err;
	}

	LOG_INF("Observability initialized: model id %u, %u classes", (unsigned int)info.model_id,
		info.num_classes);

	return 0;
}

int model_obsv_update_probs(const flt32_t *probs)
{
	int err = nrf_edgeai_obsv_update_probs(&ctx, probs);

	if (err) {
		LOG_ERR("Failed to update probs (err %d)", err);
	}
	return err;
}
```

## src/model_obsv.h
```c
/*
 * Copyright (c) 2026 Nordic Semiconductor ASA
 *
 * SPDX-License-Identifier: LicenseRef-Nordic-5-Clause
 */

/**
 * @file model_obsv.h
 * @defgroup model_obsv Model observability
 * @{
 * @ingroup app_mo
 *
 * nRF Edge AI observability for the application model: output metrics
 * (class predictions distribution, transition matrix, model certainty
 * descriptor) published as a Memfault CDR.
 *
 * With @c CONFIG_MODEL_OBSERVABILITY disabled, the functions are empty stubs.
 */

#ifndef __MODEL_OBSV_H__
#define __MODEL_OBSV_H__

#include <zephyr/sys/util.h>

#include <nrf_edgeai/nrf_edgeai.h>

#ifdef __cplusplus
extern "C" {
#endif

/**
 * @brief Create the observability context and metrics, bind the Memfault transport
 *
 * @param model Initialized Edge AI model, used to read the model metadata
 *
 * @return 0 on success, negative errno on failure
 */
int model_obsv_init(nrf_edgeai_t *model);

/**
 * @brief Feed one class-probability vector to the observability metrics
 *
 * @param probs Probability per model output class, in model output order
 *
 * @return 0 on success, negative errno on failure
 */
int model_obsv_update_probs(const flt32_t *probs);

#ifdef __cplusplus
}
#endif

#endif /* __MODEL_OBSV_H__ */

/**
 * @}
 */
```

## src/ux_state_manager.c
```c
/*
 * Copyright (c) 2026 Nordic Semiconductor ASA
 *
 * SPDX-License-Identifier: LicenseRef-Nordic-5-Clause
 */

#include "ux_state_manager.h"

#include <errno.h>
#include <zephyr/drivers/gpio.h>
#include <zephyr/kernel.h>
#include <zephyr/logging/log.h>
#include <zephyr/sys/atomic.h>
#include <zephyr/sys/util.h>

#include "nrf_edgeai_user_model_labels.h"

LOG_MODULE_REGISTER(uxsm, CONFIG_LOG_DEFAULT_LEVEL);

/** Blink period per state: 3 Hz before BLE connection, 1 Hz after */
static const uint32_t BLINK_PERIOD_MS[] = {
	[UX_STATE_ADVERTISING] = 1000U / 3U,
	[UX_STATE_CONNECTED] = 1000U,
};

BUILD_ASSERT(UX_LED_ON_MS < (1000U / 3U), "LED ON time must be shorter than the blink period");

/** RGB LED channels, bit positions in the activity color mask */
enum {
	LED_CH_RED,
	LED_CH_GREEN,
	LED_CH_BLUE,
	LED_CH_NUM,
};

#define LED_RED   BIT(LED_CH_RED)
#define LED_GREEN BIT(LED_CH_GREEN)
#define LED_BLUE  BIT(LED_CH_BLUE)

/* led0 is the blue channel of the RGB LED */
static const struct gpio_dt_spec rgb_led[LED_CH_NUM] = {
	[LED_CH_RED] = GPIO_DT_SPEC_GET(DT_NODELABEL(led1_red), gpios),
	[LED_CH_GREEN] = GPIO_DT_SPEC_GET(DT_NODELABEL(led1_green), gpios),
	[LED_CH_BLUE] = GPIO_DT_SPEC_GET(DT_ALIAS(led0), gpios),
};

/** LED color per model label; idle is the default */
static const uint8_t ACTIVITY_COLOR[MODEL_USER_LABEL_COUNT] = {
	[MODEL_USER_LABEL_IDLE] = LED_BLUE,
	[MODEL_USER_LABEL_UPDOWN] = LED_RED,
	[MODEL_USER_LABEL_CIRCLE] = LED_GREEN,
	[MODEL_USER_LABEL_FLIP] = LED_RED | LED_GREEN,
};

/* Written from BT stack callbacks, read from the system workqueue */
static atomic_t ux_state = ATOMIC_INIT(UX_STATE_ADVERTISING);

/* Written from the inference thread, read from the system workqueue */
static atomic_t led_color = ATOMIC_INIT(LED_BLUE);

/* Activity debounce state, used from the inference thread only */
static uint16_t current_activity = MODEL_USER_LABEL_IDLE;
static uint16_t candidate_activity;
static uint8_t candidate_hits;
static uint8_t candidate_misses;

static struct k_work_delayable led_blink_work;

static void led_blink_work_handler(struct k_work *work)
{
	static bool led_on;
	ux_state_t state = (ux_state_t)atomic_get(&ux_state);

	ARG_UNUSED(work);
	__ASSERT_NO_MSG(state < ARRAY_SIZE(BLINK_PERIOD_MS));

	uint32_t color = (uint32_t)atomic_get(&led_color);

	led_on = !led_on;
	for (size_t ch = 0; ch < LED_CH_NUM; ch++) {
		(void)gpio_pin_set_dt(&rgb_led[ch], led_on && ((color & BIT(ch)) != 0U));
	}

	k_work_schedule(&led_blink_work,
			K_MSEC(led_on ? UX_LED_ON_MS : (BLINK_PERIOD_MS[state] - UX_LED_ON_MS)));
}

int uxsm_init(void)
{
	int err;

	for (size_t ch = 0; ch < LED_CH_NUM; ch++) {
		if (!gpio_is_ready_dt(&rgb_led[ch])) {
			LOG_ERR("Status LED GPIO is not ready (channel %zu)", ch);
			return -ENODEV;
		}

		err = gpio_pin_configure_dt(&rgb_led[ch], GPIO_OUTPUT_INACTIVE);
		if (err != 0) {
			LOG_ERR("Failed to configure status LED (channel %zu, err %d)", ch, err);
			return err;
		}
	}

	atomic_set(&ux_state, (atomic_val_t)UX_STATE_ADVERTISING);
	atomic_set(&led_color, (atomic_val_t)ACTIVITY_COLOR[MODEL_USER_LABEL_IDLE]);
	current_activity = MODEL_USER_LABEL_IDLE;
	candidate_hits = 0U;
	candidate_misses = 0U;

	k_work_init_delayable(&led_blink_work, led_blink_work_handler);
	k_work_schedule(&led_blink_work, K_NO_WAIT);

	return 0;
}

void uxsm_set_ble_connected(bool connected)
{
	ux_state_t new_state = connected ? UX_STATE_CONNECTED : UX_STATE_ADVERTISING;
	ux_state_t old = (ux_state_t)atomic_set(&ux_state, (atomic_val_t)new_state);

	if (old == new_state) {
		return;
	}

	LOG_INF("State transition -> %s",
		(new_state == UX_STATE_CONNECTED) ? "CONNECTED" : "ADVERTISING");

	/* Apply the new blink rate right away instead of after the current phase */
	k_work_reschedule(&led_blink_work, K_NO_WAIT);
}

ux_state_t uxsm_get_state(void)
{
	return (ux_state_t)atomic_get(&ux_state);
}

void uxsm_set_current_activity(uint16_t label)
{
	if (label >= MODEL_USER_LABEL_COUNT) {
		return;
	}

	if (label == current_activity) {
		/* Back to the shown class: drop any pending change */
		candidate_hits = 0U;
		candidate_misses = 0U;
		return;
	}

	if ((candidate_hits > 0U) && (label == candidate_activity)) {
		candidate_hits++;
	} else {
		if ((candidate_hits > 0U) && (candidate_misses < UX_ACTIVITY_FLICKER_TOLERANCE)) {
			/* Single outlier inside a run of the candidate class: tolerate it */
			candidate_misses++;
			return;
		}

		candidate_activity = label;
		candidate_hits = 1U;
		candidate_misses = 0U;
	}

	if (candidate_hits < UX_ACTIVITY_CONFIRM_COUNT) {
		return;
	}

	current_activity = candidate_activity;
	candidate_hits = 0U;
	candidate_misses = 0U;
	atomic_set(&led_color, (atomic_val_t)ACTIVITY_COLOR[current_activity]);

	LOG_INF("Activity -> %s", NRF_EDGEAI_USER_LABELS_NAME[current_activity]);
}
```

## src/ux_state_manager.h
```c
/*
 * Copyright (c) 2026 Nordic Semiconductor ASA
 *
 * SPDX-License-Identifier: LicenseRef-Nordic-5-Clause
 */

/**
 * @defgroup app_mo Model Observability Application
 *
 * @defgroup uxsm UX State Machine
 * @{
 * @ingroup app_mo
 *
 * uxsm means ux_state_machine.
 *
 * @brief Tracks the BLE connection state of the application and drives
 *        the status LED accordingly.
 *
 * LED indication (LED ON time is @ref UX_LED_ON_MS in both states):
 *
 *   - @ref UX_STATE_ADVERTISING : blink at 3 Hz (waiting for BLE connection)
 *   - @ref UX_STATE_CONNECTED   : blink at 1 Hz (BLE peer connected)
 *
 * LED color shows the recognized activity (see @ref uxsm_set_current_activity):
 * idle - blue (default), updown - red, circle - green, flip - red + green.
 */
#ifndef __UXSM_H__
#define __UXSM_H__

#include <stdbool.h>
#include <stdint.h>

#ifdef __cplusplus
extern "C" {
#endif /* __cplusplus */

/** Status LED ON time per blink, in milliseconds */
#define UX_LED_ON_MS (100U)

/** Consecutive recognitions of a class needed to switch the LED color */
#define UX_ACTIVITY_CONFIRM_COUNT (3U)

/** Number of other-class samples tolerated inside a run before it is dropped */
#define UX_ACTIVITY_FLICKER_TOLERANCE (1U)

/**
 * @brief Application UX state.
 */
typedef enum {
	UX_STATE_ADVERTISING = 0,
	UX_STATE_CONNECTED,
} ux_state_t;

/**
 * @brief Initialize the UX state manager.
 *
 * Initializes the status LED and starts blinking in @ref UX_STATE_ADVERTISING.
 *
 * @return 0 on success, negative error code otherwise.
 */
int uxsm_init(void);

/**
 * @brief Update the state from the BLE connection state.
 *
 * Safe to call from BLE stack callbacks. Matches @ref ble_nus_conn_cb_t.
 *
 * @param connected true if a peer is connected, false otherwise.
 */
void uxsm_set_ble_connected(bool connected);

/**
 * @brief Report the class recognized by the model; updates the LED color.
 *
 * The color changes only after @ref UX_ACTIVITY_CONFIRM_COUNT recognitions of
 * the same class, where up to @ref UX_ACTIVITY_FLICKER_TOLERANCE sample of
 * another class inside the run is ignored. Call from a single thread.
 *
 * @param label Model class (nrf_edgeai_user_label_t). Out of range values are ignored.
 */
void uxsm_set_current_activity(uint16_t label);

/**
 * @brief Get the current UX state.
 */
ux_state_t uxsm_get_state(void);

#ifdef __cplusplus
}
#endif /* __cplusplus */

#endif /* __UXSM_H__ */

/**
 * @}
 */
```
