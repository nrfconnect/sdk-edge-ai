## CMakeLists.txt
```
# Copyright (c) 2026 Nordic Semiconductor
# SPDX-License-Identifier: LicenseRef-Nordic-5-Clause

cmake_minimum_required(VERSION 3.20.0)
find_package(Zephyr REQUIRED HINTS $ENV{ZEPHYR_BASE})
project(person_det_picture)

# Reuse compiled model + demo JPEG from person_recognition application.
set(PERSON_REC_APP "${CMAKE_CURRENT_SOURCE_DIR}/../person_recognition")
set(COMPILED_MODELS_DIR "${PERSON_REC_APP}/outputs")
set(PERSON_DET_HDR "${COMPILED_MODELS_DIR}/nrf_axon_model_person_det_.h")

if(NOT EXISTS "${PERSON_DET_HDR}")
  message(FATAL_ERROR
    "person_det model header not found:\n  ${PERSON_DET_HDR}\n"
    "Build or copy Axon outputs under person_recognition/outputs/.")
endif()

set(DEMO_JPEG "${CMAKE_CURRENT_SOURCE_DIR}/pictures/demo_2.jpeg")
if(NOT EXISTS "${DEMO_JPEG}")
  message(FATAL_ERROR
    "demo_picture.jpeg not found:\n  ${DEMO_JPEG}")
endif()

set(GEN_HEADER "${CMAKE_CURRENT_SOURCE_DIR}/src/generated/person_det_demo_input.h")
find_package(Python3 REQUIRED COMPONENTS Interpreter)

execute_process(
  COMMAND "${Python3_EXECUTABLE}"
    "${CMAKE_CURRENT_SOURCE_DIR}/scripts/embed_demo_input.py"
    --axon-header "${PERSON_DET_HDR}"
    --model-symbol model_person_det
    --jpeg "${DEMO_JPEG}"
    --out "${GEN_HEADER}"
  RESULT_VARIABLE _embed_st
  ERROR_VARIABLE _embed_err
  OUTPUT_VARIABLE _embed_out
)
if(NOT _embed_st EQUAL 0)
  message(FATAL_ERROR
    "embed_demo_input.py failed (install Pillow in build env: pip install Pillow).\n"
    "${_embed_err}${_embed_out}")
endif()

target_include_directories(app PRIVATE
  "${COMPILED_MODELS_DIR}"
  "${CMAKE_CURRENT_SOURCE_DIR}/src"
  "${CMAKE_CURRENT_SOURCE_DIR}/src/generated")

zephyr_compile_definitions(NRF_AXON_MODEL_NAME=person_det)

target_sources(app PRIVATE src/main.c src/person_det_postprocess.c)
```

## Kconfig
```
# Copyright (c) 2026 Nordic Semiconductor ASA
#
# SPDX-License-Identifier: LicenseRef-Nordic-5-Clause

source "Kconfig.zephyr"
```

## prj.conf
```kconfig
# Copyright (c) 2026 Nordic Semiconductor
# SPDX-License-Identifier: LicenseRef-Nordic-5-Clause

CONFIG_PRINTK=y
CONFIG_LOG=y
CONFIG_LOG_MODE_IMMEDIATE=y
CONFIG_CBPRINTF_FP_SUPPORT=y

CONFIG_NRF_AXON=y
CONFIG_NRF_AXON_MODEL_NAME="person_det"

CONFIG_NRF_AXON_INTERLAYER_BUFFER_SIZE=229376
CONFIG_NRF_AXON_PSUM_BUFFER_SIZE=0

CONFIG_MAIN_STACK_SIZE=16384
```

## src/main.c
```c
/*
 * Copyright (c) 2026 Nordic Semiconductor ASA
 * SPDX-License-Identifier: LicenseRef-Nordic-5-Clause
 *
 * Minimal person_det test: run inference on PC-generated int8 tensor from demo_picture.jpeg.
 * Regenerate input with: scripts/embed_demo_input.py (invoked from CMake).
 */

#include <zephyr/kernel.h>
#include <zephyr/logging/log.h>

#include <stdint.h>

#include <drivers/axon/nrf_axon_driver.h>
#include <drivers/axon/nrf_axon_nn_infer.h>
#include <axon/nrf_axon_platform.h>

#include "nrf_axon_model_person_det_.h"
#include "person_det_demo_input.h"
#include "person_det_postprocess.h"

LOG_MODULE_REGISTER(person_det_picture);

#define PACKED_OUTPUT_BYTES NRF_AXON_MODEL_PERSON_DET_PACKED_OUTPUT_SIZE

static int8_t output_buf[PACKED_OUTPUT_BYTES];

int main(void)
{
	const nrf_axon_nn_compiled_model_s *model = &model_person_det;
	struct person_det_box boxes[16];
	const int max_boxes = (int)(sizeof(boxes) / sizeof(boxes[0]));
	nrf_axon_result_e result;

	LOG_INF("person_det picture test (embedded tensor %d bytes)", PERSON_DET_DEMO_INPUT_BYTES);

	result = nrf_axon_platform_init();
	if (result != NRF_AXON_RESULT_SUCCESS) {
		LOG_ERR("Axon platform init failed: %d", result);
		return -1;
	}

	result = nrf_axon_nn_model_validate(model);
	if (result != NRF_AXON_RESULT_SUCCESS) {
		LOG_ERR("Model validation failed: %d", result);
		return -1;
	}

	if (nrf_axon_nn_model_init_vars(model) != 0) {
		LOG_ERR("Model init_vars failed");
		return -1;
	}

	result = nrf_axon_nn_model_infer_sync(model, person_det_demo_input, output_buf);
	if (result != NRF_AXON_RESULT_SUCCESS) {
		LOG_ERR("inference failed: %d", result);
		return -1;
	}

	int n = person_det_decode_and_nms(model, boxes, max_boxes, 0.15f, 0.45f);

	LOG_INF("detections after NMS: %d", n);
	for (int i = 0; i < n; i++) {
		LOG_INF("  box %d: [%.1f, %.1f, %.1f, %.1f] score %.3f", i, (double)boxes[i].x1,
			(double)boxes[i].y1, (double)boxes[i].x2, (double)boxes[i].y2,
			(double)boxes[i].score);
	}

	return 0;
}
```

## src/person_det_postprocess.c
```c
/*
 * Copyright (c) 2026 Nordic Semiconductor ASA
 * SPDX-License-Identifier: LicenseRef-Nordic-5-Clause
 */

#include "person_det_postprocess.h"

#include <math.h>
#include <stdbool.h>
#include <stdlib.h>
#include <string.h>

#define NUM_ANCHORS    3
#define PRED_PER_ANCH  6
#define MAX_CANDIDATES 400

static const float k_anchors_stride32[6] = {116.f, 90.f, 156.f, 198.f, 373.f, 326.f};
static const float k_anchors_stride16[6] = {30.f, 61.f, 62.f, 45.f, 59.f, 119.f};
static const float k_anchors_stride8[6] = {10.f, 13.f, 16.f, 30.f, 33.f, 23.f};

static float dequant(int8_t q, uint32_t mult, uint8_t round, int8_t zp)
{
	return (float)((int)q - (int)zp) * (float)mult / (float)(1U << round);
}

static float sigmoid(float x)
{
	if (x >= 0.f) {
		float z = expf(-x);

		return 1.f / (1.f + z);
	}
	float z = expf(x);

	return z / (1.f + z);
}

static int8_t read_ch(const int8_t *base, uint16_t h, uint16_t row_stride, uint16_t c, uint16_t y,
		      uint16_t x)
{
	return base[(size_t)c * (size_t)h * (size_t)row_stride + (size_t)y * (size_t)row_stride +
		    (size_t)x];
}

static void decode_scale(const int8_t *base, uint16_t fh, uint16_t fw, uint16_t row_stride,
			 uint32_t dqm, uint8_t dqr, int8_t dqz, int stride_px, const float *anchors,
			 float in_w, float in_h, struct person_det_box *cand, int *ncand,
			 float score_thresh)
{
	for (unsigned y = 0; y < fh; y++) {
		for (unsigned x = 0; x < fw; x++) {
			for (int a = 0; a < NUM_ANCHORS; a++) {
				int o = a * PRED_PER_ANCH;
				float rcx = dequant(read_ch(base, fh, row_stride, (uint16_t)(o + 0), y, x),
						    dqm, dqr, dqz);
				float rcy = dequant(read_ch(base, fh, row_stride, (uint16_t)(o + 1), y, x),
						    dqm, dqr, dqz);
				float rw = dequant(read_ch(base, fh, row_stride, (uint16_t)(o + 2), y, x),
						   dqm, dqr, dqz);
				float rh = dequant(read_ch(base, fh, row_stride, (uint16_t)(o + 3), y, x),
						   dqm, dqr, dqz);
				float robj = dequant(read_ch(base, fh, row_stride, (uint16_t)(o + 4), y, x),
						     dqm, dqr, dqz);
				float rcls = dequant(read_ch(base, fh, row_stride, (uint16_t)(o + 5), y, x),
						     dqm, dqr, dqz);

				float cx = (sigmoid(rcx) + (float)x) * (float)stride_px;
				float cy = (sigmoid(rcy) + (float)y) * (float)stride_px;

				rw = fminf(rw, 10.f);
				rh = fminf(rh, 10.f);
				float bw = expf(rw) * anchors[a * 2 + 0];
				float bh = expf(rh) * anchors[a * 2 + 1];

				float hw = bw * 0.5f;
				float hh = bh * 0.5f;

				float conf = sigmoid(robj) * sigmoid(rcls);
				if (conf < score_thresh || *ncand >= MAX_CANDIDATES) {
					continue;
				}

				float x1 = cx - hw;
				float y1 = cy - hh;
				float x2 = cx + hw;
				float y2 = cy + hh;

				if (x1 < 0.f) {
					x1 = 0.f;
				}
				if (y1 < 0.f) {
					y1 = 0.f;
				}
				if (x2 > in_w) {
					x2 = in_w;
				}
				if (y2 > in_h) {
					y2 = in_h;
				}
				if (x2 <= x1 || y2 <= y1) {
					continue;
				}

				cand[*ncand].x1 = x1;
				cand[*ncand].y1 = y1;
				cand[*ncand].x2 = x2;
				cand[*ncand].y2 = y2;
				cand[*ncand].score = conf;
				(*ncand)++;
			}
		}
	}
}

static float bbox_iou(const struct person_det_box *a, const struct person_det_box *b)
{
	float xx1 = fmaxf(a->x1, b->x1);
	float yy1 = fmaxf(a->y1, b->y1);
	float xx2 = fminf(a->x2, b->x2);
	float yy2 = fminf(a->y2, b->y2);
	float w = fmaxf(0.f, xx2 - xx1);
	float h = fmaxf(0.f, yy2 - yy1);
	float inter = w * h;
	float area_a = (a->x2 - a->x1) * (a->y2 - a->y1);
	float area_b = (b->x2 - b->x1) * (b->y2 - b->y1);

	return inter / (area_a + area_b - inter + 1e-6f);
}

static int cmp_score_desc(const void *va, const void *vb)
{
	const struct person_det_box *a = va;
	const struct person_det_box *b = vb;

	if (a->score > b->score) {
		return -1;
	}
	if (a->score < b->score) {
		return 1;
	}
	return 0;
}

static int nms(struct person_det_box *dets, int n, struct person_det_box *out, int max_out,
	       float iou_thres)
{
	if (n <= 0) {
		return 0;
	}

	qsort(dets, (size_t)n, sizeof(dets[0]), cmp_score_desc);

	int kept = 0;

	for (int i = 0; i < n && kept < max_out; i++) {
		bool take = true;

		for (int j = 0; j < kept; j++) {
			if (bbox_iou(&dets[i], &out[j]) > iou_thres) {
				take = false;
				break;
			}
		}
		if (take) {
			out[kept++] = dets[i];
		}
	}

	return kept;
}

int person_det_decode_and_nms(const nrf_axon_nn_compiled_model_s *model, struct person_det_box *out,
			      int max_out, float score_thresh, float nms_iou)
{
	struct person_det_box cand[MAX_CANDIDATES];
	int ncand = 0;

	const nrf_axon_nn_model_layer_dimensions_s *idim = &model->inputs[model->external_input_ndx].dimensions;
	float in_w = (float)idim->width;
	float in_h = (float)idim->height;

	if (model->extra_output_cnt >= 2) {
		const nrf_axon_compiled_model_output_s *e1 = &model->extra_outputs[1];

		decode_scale(e1->ptr, e1->dimensions.height, e1->dimensions.width, e1->stride,
			     e1->dequant_mult, e1->dequant_round, e1->dequant_zp, 32,
			     k_anchors_stride32, in_w, in_h, cand, &ncand, score_thresh);
	}

	if (model->extra_output_cnt >= 1) {
		const nrf_axon_compiled_model_output_s *e0 = &model->extra_outputs[0];

		decode_scale(e0->ptr, e0->dimensions.height, e0->dimensions.width, e0->stride,
			     e0->dequant_mult, e0->dequant_round, e0->dequant_zp, 16,
			     k_anchors_stride16, in_w, in_h, cand, &ncand, score_thresh);
	}

	decode_scale(model->output_ptr, model->output_dimensions.height, model->output_dimensions.width,
		     model->output_stride, model->output_dequant_mult, model->output_dequant_round,
		     model->output_dequant_zp, 8, k_anchors_stride8, in_w, in_h, cand, &ncand,
		     score_thresh);

	return nms(cand, ncand, out, max_out, nms_iou);
}
```

## src/person_det_postprocess.h
```c
/*
 * Copyright (c) 2026 Nordic Semiconductor ASA
 * SPDX-License-Identifier: LicenseRef-Nordic-5-Clause
 *
 * YOLOv3-style decode + greedy NMS for MCUNet person_det Axon model (matches
 * mcunet/utils/det_helper.py + run_det_camera.py).
 */

#pragma once

#include <drivers/axon/nrf_axon_nn_infer.h>
#include <stdint.h>

struct person_det_box {
	float x1, y1, x2, y2;
	float score;
};

int person_det_decode_and_nms(const nrf_axon_nn_compiled_model_s *model, struct person_det_box *out,
				int max_out, float score_thresh, float nms_iou);
```
