## CMakeLists.txt
```
#
# Copyright (c) 2026 Nordic Semiconductor ASA
#
# SPDX-License-Identifier: LicenseRef-Nordic-5-Clause
#

cmake_minimum_required(VERSION 3.20.0)

# Zephyr CMake project
find_package(Zephyr REQUIRED HINTS $ENV{ZEPHYR_BASE})
project(hello_axon)

# Source files
target_sources(app PRIVATE
    src/main.c
)

if(CONFIG_HELLO_AXON_MODEL_OTA)
  include(${CMAKE_CURRENT_SOURCE_DIR}/../../../lib/model_ota/cmake/nrf_axon_model_stub.cmake)
  nrf_axon_model_stub(
    TARGET hello_axon
    MODEL_NAME hello_axon
    HEADER ${CMAKE_CURRENT_SOURCE_DIR}/src/generated/nrf_axon_model_hello_axon_.h
    PARTITION_NODELABEL model_partition
  )
endif()
```

## Kconfig
```
#
# Copyright (c) 2026 Nordic Semiconductor
#
# SPDX-License-Identifier: LicenseRef-Nordic-5-Clause
#

source "Kconfig.zephyr"

menu "Hello Axon"

config ASYNC_INFERENCE
	bool "Run inference asynchronously"
	default y

config AVOID_INPUT_DOUBLE_COPY
	bool "Avoid copying of input data twice in synchronous inference mode"
	depends on !ASYNC_INFERENCE
	default y
	help
	  This option removes unnecessary copying of input data between buffers, but it requires
	  exclusive access to the Axon NPU interlayer buffer to preserve consistency.

config HELLO_AXON_MODEL_OTA
	bool "Load the model from the model_storage flash partition (model-only OTA)"
	default y
	select FLASH
	select FLASH_MAP
	select CRC
	select MODEL_OTA
	select MODEL_OTA_AXON
	help
	  When enabled (the default), this sample does not ship a compiled-in model: it loads,
	  validates, and periodically reloads an Axon model package from the model_storage flash
	  partition at runtime instead (see doc/libraries/model_ota.rst). Disable this to restore
	  this sample's original pre-model-OTA behavior: the model is compiled directly into the
	  application image and inference runs once at boot, with no flash partition or periodic
	  reload involved.

endmenu
```

## sample.yaml
```
sample:
  description: Sample showing usage of Axon NPU driver API.
  name: nRF Edge AI Hello Axon sample
tests:
  sample.hello_axon:
    harness: console
    harness_config:
      type: multi_line
      ordered: true
      regex:
        - "Hello Axon sample"
        - "Initializing Axon NPU"
        # Twister builds and boots a fresh device with an unprovisioned model_storage
        # partition, so it only ever exercises the "no valid model" degraded path here.
        # See README.rst for how to provision model_storage and see real predictions.
        - "No valid model in model_storage"
    sysbuild: true
    platform_allow:
      - nrf54lm20dk/nrf54lm20b/cpuapp
    integration_platforms:
      - nrf54lm20dk/nrf54lm20b/cpuapp
```

## prj.conf
```kconfig
#
# Copyright (c) 2026 Nordic Semiconductor ASA
#
# SPDX-License-Identifier: LicenseRef-Nordic-5-Clause
#

CONFIG_NCS_SAMPLES_DEFAULTS=y

CONFIG_NRF_AXON=y

# set size of interlayer buffer to fit largest model
CONFIG_NRF_AXON_INTERLAYER_BUFFER_SIZE=17

# set size of psum buffer to fit largest model
CONFIG_NRF_AXON_PSUM_BUFFER_SIZE=0

# Allow floating point in printf
CONFIG_PICOLIBC_IO_FLOAT=y

# Model-only OTA update: by default (CONFIG_HELLO_AXON_MODEL_OTA=y, see Kconfig) this sample
# loads, validates, and runs inference against an Axon model package read from the
# model_storage flash partition at boot instead of shipping a compiled-in model - see main.c
# and README.rst. FLASH/FLASH_MAP/CRC/MODEL_OTA/MODEL_OTA_AXON are selected by that option.
```

## boards/nrf54lm20dk_nrf54lm20a_cpuapp.overlay
```dts
/*
 * Copyright (c) 2026 Nordic Semiconductor ASA
 *
 * SPDX-License-Identifier: LicenseRef-Nordic-5-Clause
 */

&global_peripherals {
	axon: axon@56000 {
		compatible = "nordic,axon";
		reg = <0x56000 0x1000>;
		interrupts = <86 NRF_DEFAULT_IRQ_PRIORITY>;
		status = "okay";
	};
};
```

## boards/nrf54lm20dk_nrf54lm20b_cpuapp.overlay
```dts
/*
 * Copyright (c) 2026 Nordic Semiconductor ASA
 *
 * SPDX-License-Identifier: LicenseRef-Nordic-5-Clause
 */

&axon {
	status = "okay";
};

/*
 * This sample does not use mcuboot, so the board's second application slot
 * (slot1_partition) is unused. Repurpose it as a dedicated "model_storage" partition, sized
 * to comfortably fit future (larger) models too, instead of the much smaller default
 * "storage" partition. Same partition layout as samples/model_ota/neuton.
 */
/delete-node/ &slot1_partition;

&cpuapp_rram {
	partitions {
		model_partition: partition@102000 {
			compatible = "zephyr,mapped-partition";
			label = "model_storage";
			reg = <0x102000 DT_SIZE_K(968)>;
		};
	};
};
```

## src/main.c
```c
/*
 * Copyright (c) 2026 Nordic Semiconductor ASA
 *
 * SPDX-License-Identifier: LicenseRef-Nordic-5-Clause
 */

#include <assert.h>
#include <math.h>

#include <zephyr/logging/log.h>

#include <axon/nrf_axon_platform.h>
#include <drivers/axon/nrf_axon_driver.h>
#include <drivers/axon/nrf_axon_nn_infer.h>

#include "generated/nrf_axon_model_hello_axon_.h"

LOG_MODULE_REGISTER(hello_axon);

/* Input size, matching the input layer dimensions in @ref model_hello_axon. */
#define INPUT_SIZE  (1)
/* Output size, matching the output dimensions in @ref model_hello_axon. */
#define OUTPUT_SIZE (1)

/* Random samples from 0 to 2π */
static const float sample_values[] = {3.07f, 2.14f, 5.76f, 4.62f, 0.00f, 1.60f, 4.55f, 4.13f,
				      0.35f, 3.53f, 6.17f, 5.29f, 0.21f, 6.13f, 3.10f, 1.75f};

/* Used to pass current sample value to inference_callback to compare prediction with ideal. */
static float current_async_sample_value;

/**
 * @brief Quantize and convert from HWC to CHW format.
 */
static void quantize_and_convert(const float *values, int8_t *target,
				 const nrf_axon_nn_compiled_model_input_s *input_params)
{
	const nrf_axon_nn_model_layer_dimensions_s *dims = &input_params->dimensions;

	if (IS_ENABLED(CONFIG_AVOID_INPUT_DOUBLE_COPY)) {
		__ASSERT(input_params->stride == dims->width,
			 "Stride differs from width, need to adapt fill_input");
	}

	const uint32_t q_mult = input_params->quant_mult;
	const uint8_t q_round = input_params->quant_round;
	const int8_t q_zp = input_params->quant_zp;
	const float scale = (float)q_mult / (float)(1 << q_round);

	for (size_t row = 0; row < input_params->dimensions.height; row++) {
		for (size_t col = 0; col < input_params->dimensions.width; col++) {
			for (size_t chan = 0; chan < input_params->dimensions.channel_cnt; chan++) {
				const size_t input_offset = row * dims->width * dims->channel_cnt +
							    col * dims->channel_cnt + chan;
				const size_t target_offset =
					chan * dims->height * dims->width + row * dims->width + col;

				const int32_t quantized =
					(int32_t)(values[input_offset] * scale) + q_zp;

				target[target_offset] = (int8_t)__ssat(quantized, 8);
			}
		}
	}
}

static void dequantize(const int8_t *values, const size_t length, float *target,
		       const nrf_axon_nn_compiled_model_s *model)
{
	const uint32_t deq_mult = model->outputs[0].dequant_mult;
	const uint8_t deq_round = model->outputs[0].dequant_round;
	const int8_t deq_zp = model->outputs[0].dequant_zp;
	const float scale = (float)deq_mult / (float)(1 << deq_round);

	for (size_t i = 0; i < length; i++) {
		target[i] = (float)(values[i] - deq_zp) * scale;
	}
}

static void sync_flow(void)
{
	nrf_axon_result_e result;

	result = nrf_axon_nn_model_validate(&model_hello_axon);
	if (result != NRF_AXON_RESULT_SUCCESS) {
		LOG_ERR("Model validation failed, err %d", result);
		return;
	}

	LOG_INF("Running synchronous inference");

#if IS_ENABLED(CONFIG_AVOID_INPUT_DOUBLE_COPY)
	/* This path requires to know that no other model is running or will be running as we access
	 * internal buffer. Set input to NULL to indicate that data is already placed in buffer.
	 */
	int8_t *input_buffer = model_hello_axon.inputs[0].ptr;
	int8_t *input = NULL;
#else
	/* Input buffer of size 1, matching the input layer dimensions in @ref model_hello_axon. */
	int8_t input_buffer[INPUT_SIZE];
	int8_t *input = input_buffer;
#endif /* IS_ENABLED(CONFIG_AVOID_INPUT_DOUBLE_COPY) */

	/* Output buffer of size 1, matching the output dimensions in @ref model_hello_axon. */
	int8_t output[OUTPUT_SIZE];

	for (size_t i = 0; i < ARRAY_SIZE(sample_values); i++) {
		/* Simulate wait for new data from sensor. */
		k_msleep(50);
		const float sample_value = sample_values[i];

		quantize_and_convert(&sample_value, input_buffer,
				     &model_hello_axon.inputs[0]);

		result = nrf_axon_nn_model_infer_sync(&model_hello_axon, input, output);
		if (result != NRF_AXON_RESULT_SUCCESS) {
			LOG_ERR("Synchronous inference failed, err %d", result);
			return;
		}

		float prediction;

		/* Output in CHW format. */
		dequantize(output, OUTPUT_SIZE, &prediction, &model_hello_axon);
		LOG_INF("prediction: %6.3f, ideal %6.3f", (double)prediction,
			(double)sinf(sample_value));
	}
}

static void inference_callback(nrf_axon_result_e result, void *callback_context)
{
	if (result != NRF_AXON_RESULT_SUCCESS) {
		LOG_ERR("Inference failed, err %d", result);
		return;
	}

	const uint8_t *output = (const uint8_t *)callback_context;
	float prediction;

	/* Output in CHW format. */
	dequantize(output, OUTPUT_SIZE, &prediction, &model_hello_axon);
	LOG_INF("prediction: %6.3f, ideal %6.3f", (double)prediction,
		(double)sinf(current_async_sample_value));

	nrf_axon_platform_generate_user_event();
}

static void async_flow(void)
{
	nrf_axon_nn_model_async_inference_wrapper_s async_wrapper;
	nrf_axon_result_e result;

	result = nrf_axon_nn_model_async_init(&async_wrapper, &model_hello_axon);
	if (result != NRF_AXON_RESULT_SUCCESS) {
		LOG_ERR("Asynchronous model initialization failed, err %d", result);
		return;
	}

	LOG_INF("Running asynchronous inference");

	/* Input buffer of size 1, matching the input layer dimensions in @ref model_hello_axon. */
	int8_t input[INPUT_SIZE];
	/* Output buffer of size 1, matching the output dimensions in @ref model_hello_axon. */
	int8_t output[OUTPUT_SIZE];

	for (size_t i = 0; i < ARRAY_SIZE(sample_values); i++) {
		/* Simulate wait for new data from sensor. */
		k_msleep(50);
		const float sample_value = sample_values[i];
		void *cb_context = output;

		quantize_and_convert(&sample_value, input,
				     &model_hello_axon.inputs[0]);

		current_async_sample_value = sample_values[i];
		result = nrf_axon_nn_model_infer_async(&async_wrapper, input, output,
						       inference_callback, cb_context);
		if (result != NRF_AXON_RESULT_SUCCESS) {
			LOG_ERR("Schedule asynchronous inference failed, err %d", result);
			return;
		}

		nrf_axon_platform_wait_for_user_event();
	}
}

int main(void)
{
	nrf_axon_result_e result;
	int err;

	LOG_INF("Hello Axon sample");
	LOG_INF("Initializing Axon NPU");

	__ASSERT(model_hello_axon.inputs[0]. dimensions.byte_width == 1,
		 "Model input data type different than expected");
	__ASSERT(model_hello_axon.outputs[0].dimensions.byte_width == 1,
		 "Model output data type different than expected");

	result = nrf_axon_platform_init();
	if (result != NRF_AXON_RESULT_SUCCESS) {
		LOG_ERR("Axon NPU platform initialization failed, err %d", result);
		return -1;
	}

	/* hello_axon_model does not use persistent vars, but initialize them anyway. */
	err = nrf_axon_nn_model_init_vars(&model_hello_axon);
	if (err) {
		LOG_ERR("Model persistent variables initialization failed, err %d", err);
		return -1;
	}

	if (IS_ENABLED(CONFIG_ASYNC_INFERENCE)) {
		async_flow();
	} else {
		sync_flow();
	}

	return 0;
}
```

## src/model_reference_anchor.c
```c
/*
 * Copyright (c) 2026 Nordic Semiconductor ASA
 *
 * SPDX-License-Identifier: LicenseRef-Nordic-5-Clause
 */

/*
 * Reference-build-only translation unit (see CONFIG_HELLO_AXON_REFERENCE_BUILD in Kconfig):
 * never compiled into the deployed app, which no longer links in the generated model header -
 * it loads its model from the model_storage flash partition at runtime instead. Packaging a
 * model update still needs a real link address for the model's constants blob (see
 * package_base in model_pkg_axon_header), which only exists in a build that actually
 * references that header.
 *
 * Including the header here is enough to make the compiler emit model_hello_axon,
 * cmd_buffer_hello_axon and axon_model_const_hello_axon; CMakeLists.txt's
 * toolchain_ld_force_undefined_symbols(model_hello_axon) then keeps model_hello_axon's section
 * (and, transitively via its own relocations to the other two, theirs as well) alive through
 * the linker's --gc-sections, since nothing else in this reference-only image references any of
 * them. This build does nothing else and is never flashed as the application - see README.rst.
 */
#include <assert.h>
#include <stddef.h>
#include <stdint.h>

#include <axon/nrf_axon_platform.h>
#include <drivers/axon/nrf_axon_driver.h>
#include <drivers/axon/nrf_axon_nn_infer.h>

#include "generated/nrf_axon_model_hello_axon_.h"
```
