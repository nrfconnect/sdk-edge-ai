## CMakeLists.txt
```
#
# Copyright (c) 2026 Nordic Semiconductor ASA
#
# SPDX-License-Identifier: LicenseRef-Nordic-5-Clause
#

cmake_minimum_required(VERSION 3.20.0)

find_package(Zephyr REQUIRED HINTS $ENV{ZEPHYR_BASE})
project(model_observability)

target_include_directories(app PRIVATE
  ${CMAKE_CURRENT_SOURCE_DIR}/src
)

target_sources(app PRIVATE
  ${CMAKE_CURRENT_SOURCE_DIR}/src/main.c
  ${CMAKE_CURRENT_SOURCE_DIR}/src/scenarios.c
  ${CMAKE_CURRENT_SOURCE_DIR}/src/model_obsv.c
  ${CMAKE_CURRENT_SOURCE_DIR}/src/ux_state_manager.c
  ${CMAKE_CURRENT_SOURCE_DIR}/src/ble_mds.c
)
```

## Kconfig
```
#
# Copyright (c) 2026 Nordic Semiconductor ASA
#
# SPDX-License-Identifier: LicenseRef-Nordic-5-Clause
#

menu "Model Observability sample"

config APP_FEED_INTERVAL_MS
	int "Interval between probability vectors (ms)"
	default 500
	range 1 2000
	help
	  Delay after each predefined probability vector fed to the
	  observability metrics, standing in for the inference period of a
	  real model. A whole scenario must be fed within one
	  CONFIG_NRF_EDGEAI_OBSV_MEMFAULT_AUTO_COLLECT_INTERVAL_SEC interval,
	  which is checked at build time.

endmenu

source "Kconfig.zephyr"
```

## prj.conf
```kconfig
#
# Copyright (c) 2026 Nordic Semiconductor
#
# SPDX-License-Identifier: LicenseRef-Nordic-5-Clause
#

# Status LED and floating point for the probability vectors
CONFIG_GPIO=y
CONFIG_FPU=y

# Enable logging and assert
CONFIG_LOG=y
CONFIG_CONSOLE=y
CONFIG_USE_SEGGER_RTT=y
CONFIG_ASSERT=y

# Enable observability
CONFIG_NRF_EDGEAI_OBSV=y
CONFIG_NRF_EDGEAI_OBSV_ENCODE=y

# Resource sizing: the probability vectors have 4 classes. The workqueue stack holds the
# CDR encode buffer used by auto collect.
CONFIG_NRF_EDGEAI_OBSV_MAX_CLASSES=4
CONFIG_NRF_EDGEAI_OBSV_MEMFAULT_MAX_CONTEXTS=1
CONFIG_SYSTEM_WORKQUEUE_STACK_SIZE=4096

# Output metrics
CONFIG_NRF_EDGEAI_OBSV_METRIC_CLASS_PRED_DIST=y
CONFIG_NRF_EDGEAI_OBSV_CLASS_PRED_DIST_BIN_NUM=10
CONFIG_NRF_EDGEAI_OBSV_CLASS_PRED_DIST_STREAK_TOP_BIN=10
CONFIG_NRF_EDGEAI_OBSV_CLASS_PRED_DIST_STREAK_TOL=1
CONFIG_NRF_EDGEAI_OBSV_METRIC_TRANSITION_MATRIX=y
CONFIG_NRF_EDGEAI_OBSV_METRIC_MODEL_CERTAINTY_DESC=y
CONFIG_NRF_EDGEAI_OBSV_MODEL_CERTAINTY_DESC_BIN_NUM=10

# Enable Memfault observability and auto collect. Each scenario is staged as
# one CDR, so a short interval sends the three scenarios in a few minutes.
CONFIG_NRF_EDGEAI_OBSV_MEMFAULT=y
CONFIG_NRF_EDGEAI_OBSV_MEMFAULT_AUTO_COLLECT=y
CONFIG_NRF_EDGEAI_OBSV_MEMFAULT_AUTO_COLLECT_INTERVAL_SEC=120
CONFIG_ZCBOR=y

# Memfault settings
CONFIG_MEMFAULT=y
CONFIG_MEMFAULT_USER_CONFIG_ENABLE=n
CONFIG_MEMFAULT_PROJECT_KEY=""
CONFIG_MEMFAULT_NCS_DEVICE_ID_STATIC=y
CONFIG_MEMFAULT_NCS_DEVICE_ID="sample-edgeai-obsv"

# Bluetooth LE with the Memfault Diagnostic Service (MDS)
CONFIG_BT=y
CONFIG_BT_PERIPHERAL=y
CONFIG_BT_DEVICE_NAME="nRF Edge AI Obsv Sample"
CONFIG_BT_MDS=y
CONFIG_BT_MDS_MAX_URI_LENGTH=80
CONFIG_BT_SMP=y
CONFIG_BT_PRIVACY=y

# Bluetooth buffers for MDS chunk transfer
CONFIG_BT_BUF_ACL_RX_SIZE=251
CONFIG_BT_L2CAP_TX_MTU=247
CONFIG_BT_BUF_ACL_TX_SIZE=251
CONFIG_BT_CTLR_DATA_LENGTH_MAX=251

# Enable bonding
CONFIG_SETTINGS=y
CONFIG_ZMS=y
CONFIG_BT_SETTINGS=y
CONFIG_FLASH=y
CONFIG_FLASH_PAGE_LAYOUT=y
CONFIG_FLASH_MAP=y
```

## src/main.c
```c
/*
 * Copyright (c) 2026 Nordic Semiconductor ASA
 *
 * SPDX-License-Identifier: LicenseRef-Nordic-5-Clause
 */
#include <zephyr/kernel.h>
#include <zephyr/logging/log.h>
#include <zephyr/sys/util.h>

#include "ble_mds.h"
#include "model_obsv.h"
#include "scenarios.h"
#include "ux_state_manager.h"

LOG_MODULE_REGISTER(main);

/* There is no real model: the identifier and version are application-defined */
#define SAMPLE_MODEL_ID      (777U)
#define SAMPLE_MODEL_VERSION (1U)

/* How often the sample checks whether auto collect has staged the fed scenario */
#define COLLECT_POLL_MS (1000U)

/*
 * Auto collect is rescheduled one interval after every collect, and the next
 * scenario starts within COLLECT_POLL_MS of it. Feeding a whole scenario must
 * end before the next collect, so that a CDR never splits a scenario.
 */
BUILD_ASSERT((SCENARIO_MAX_VECTORS * CONFIG_APP_FEED_INTERVAL_MS + COLLECT_POLL_MS) <
		     (CONFIG_NRF_EDGEAI_OBSV_MEMFAULT_AUTO_COLLECT_INTERVAL_SEC * 1000ULL),
	     "A scenario must be fed within one auto collect interval");

static uint16_t predicted_class(const float *probs)
{
	uint16_t top = 0;

	for (uint16_t i = 1; i < ACTIVITY_CLASS_COUNT; i++) {
		if (probs[i] > probs[top]) {
			top = i;
		}
	}
	return top;
}

static void scenario_probs_vectors_feed(uint32_t num, const struct scenario *scenario)
{
	uint32_t class_count[ACTIVITY_CLASS_COUNT] = {0};

	LOG_INF("Scenario %u: feeding %u probability vectors", num,
		(unsigned int)scenario->num_vectors);

	for (size_t i = 0; i < scenario->num_vectors; i++) {
		const float *probs = scenario->vectors[i];

		(void)model_obsv_update_probs(probs);

		class_count[predicted_class(probs)]++;

		k_sleep(K_MSEC(CONFIG_APP_FEED_INTERVAL_MS));
	}

	LOG_INF("Scenario %u fed: %s %u, %s %u, %s %u, %s %u", num,
		activity_class_name[ACTIVITY_CLASS_WALKING], class_count[ACTIVITY_CLASS_WALKING],
		activity_class_name[ACTIVITY_CLASS_SITTING], class_count[ACTIVITY_CLASS_SITTING],
		activity_class_name[ACTIVITY_CLASS_RUNNING], class_count[ACTIVITY_CLASS_RUNNING],
		activity_class_name[ACTIVITY_CLASS_LAYING], class_count[ACTIVITY_CLASS_LAYING]);
}

/*
 * The collect that stages a CDR resets the observability context, so the fed
 * vector count drops to 0. A collect is refused while the previous CDR is not
 * read by the gateway yet, so this also waits until the previous scenario is sent.
 */
static void scenario_wait_collected(uint32_t num)
{
	LOG_INF("Scenario %u: waiting for auto collect", num);

	while (model_obsv_num_inferences() != 0U) {
		k_sleep(K_MSEC(COLLECT_POLL_MS));
	}

	LOG_INF("Scenario %u staged as CDR", num);
}

int main(void)
{
	int err;
	const nrf_edgeai_obsv_model_info_t model_info = {
		.model_id = SAMPLE_MODEL_ID,
		.num_classes = ACTIVITY_CLASS_COUNT,
		/* No FEATURES-source metrics: the feature stream is unused */
		.num_features = 0,
		.version = SAMPLE_MODEL_VERSION,
	};

	LOG_INF("nRF Edge AI Model Observability Sample");

	err = uxsm_init();
	__ASSERT(err == 0, "Failed to initialize UX state manager");

	err = model_obsv_init(&model_info);
	__ASSERT(err == 0, "Failed to initialize model observability (err %d)", err);

	err = ble_mds_init(uxsm_set_ble_connected);
	__ASSERT(err == 0, "Failed to initialize BLE MDS service (err %d)", err);

	/* Repeat the scenarios, each one in its own CDR */
	for (;;) {
		for (uint32_t i = 0; i < SCENARIO_NUM; i++) {
			scenario_probs_vectors_feed(i + 1U, &scenarios[i]);
			scenario_wait_collected(i + 1U);
		}
	}

	return 0;
}
```

## src/ble_mds.h
```c
/*
 * Copyright (c) 2026 Nordic Semiconductor ASA
 *
 * SPDX-License-Identifier: LicenseRef-Nordic-5-Clause
 */

/**
 * @file ble_mds.h
 * @defgroup sample_mo_ble_mds Bluetooth MDS interface
 * @{
 * @ingroup sample_mo
 *
 * Memfault Diagnostic Service interface. A bonded phone (nRF Memfault app)
 * drains the staged observability CDR and forwards it to the Memfault cloud.
 */

#ifndef __BLE_MDS_H__
#define __BLE_MDS_H__

#include <stdbool.h>

#ifdef __cplusplus
extern "C" {
#endif

/**
 * @brief BLE connection state change callback
 *
 * @param connected true if a peer is connected, false otherwise
 */
typedef void (*ble_mds_conn_cb_t)(bool connected);

/**
 * @brief Initialize BLE, load bonds and start MDS advertising
 *
 * @param conn_cb Callback called on connection state change, can be NULL
 *
 * @return 0 on success, negative errno on failure
 */
int ble_mds_init(ble_mds_conn_cb_t conn_cb);

#ifdef __cplusplus
}
#endif

#endif /* __BLE_MDS_H__ */

/**
 * @}
 */
```

## src/model_obsv.c
```c
/*
 * Copyright (c) 2026 Nordic Semiconductor ASA
 *
 * SPDX-License-Identifier: LicenseRef-Nordic-5-Clause
 */

#include "model_obsv.h"

#include <errno.h>

#include <zephyr/kernel.h>
#include <zephyr/logging/log.h>
#include <zephyr/sys/util.h>

#include <nrf_edgeai_obsv/nrf_edgeai_obsv.h>
#include <nrf_edgeai_obsv/nrf_edgeai_obsv_memfault.h>
#include <nrf_edgeai_obsv/nrf_edgeai_obsv_metrics.h>

LOG_MODULE_REGISTER(model_obsv, LOG_LEVEL_INF);

#define OBSV_MAX_CLASSES CONFIG_NRF_EDGEAI_OBSV_MAX_CLASSES

#define OBSV_WORDS(bytes) DIV_ROUND_UP(bytes, sizeof(uint32_t))

static nrf_edgeai_obsv_ctx_t ctx;

static nrf_edgeai_obsv_metric_t cpd;
static uint32_t cpd_buf[OBSV_WORDS(NRF_EDGEAI_OBSV_CPD_STORAGE_BYTES(OBSV_MAX_CLASSES))];
static nrf_edgeai_obsv_metric_t tm;
static uint32_t tm_buf[OBSV_WORDS(NRF_EDGEAI_OBSV_TM_STORAGE_BYTES(OBSV_MAX_CLASSES))];
static nrf_edgeai_obsv_metric_t mcd;
static uint32_t mcd_buf[OBSV_WORDS(NRF_EDGEAI_OBSV_MCD_STORAGE_BYTES(OBSV_MAX_CLASSES))];

int model_obsv_init(const nrf_edgeai_obsv_model_info_t *info)
{
	int err;

	__ASSERT_NO_MSG(info != NULL);

	if ((info->num_classes == 0) || (info->num_classes > OBSV_MAX_CLASSES)) {
		LOG_ERR("Model has %u classes, CONFIG_NRF_EDGEAI_OBSV_MAX_CLASSES is %u",
			info->num_classes, OBSV_MAX_CLASSES);
		return -EINVAL;
	}

	err = nrf_edgeai_obsv_init(&ctx, info);
	if (err) {
		LOG_ERR("Observability init failed (err %d)", err);
		return err;
	}

	/* The dump and CDR payload follow the registration order */
	nrf_edgeai_obsv_metric_cpd_create(&cpd, cpd_buf, info->num_classes);
	err = nrf_edgeai_obsv_register(&ctx, &cpd, NULL);
	if (err) {
		LOG_ERR("Failed to register cpd metric (err %d)", err);
		return err;
	}

	nrf_edgeai_obsv_metric_tm_create(&tm, tm_buf, info->num_classes);
	err = nrf_edgeai_obsv_register(&ctx, &tm, NULL);
	if (err) {
		LOG_ERR("Failed to register tm metric (err %d)", err);
		return err;
	}

	nrf_edgeai_obsv_metric_mcd_create(&mcd, mcd_buf, info->num_classes);
	err = nrf_edgeai_obsv_register(&ctx, &mcd, NULL);
	if (err) {
		LOG_ERR("Failed to register mcd metric (err %d)", err);
		return err;
	}

	err = nrf_edgeai_obsv_memfault_init(&ctx);
	if (err) {
		LOG_ERR("Memfault transport init failed (err %d)", err);
		return err;
	}

	LOG_INF("Observability initialized: model id %u, %u classes", (unsigned int)info->model_id,
		info->num_classes);

	return 0;
}

int model_obsv_update_probs(const float *probs)
{
	int err = nrf_edgeai_obsv_update_probs(&ctx, probs);

	if (err) {
		LOG_ERR("Failed to update probs (err %d)", err);
	}
	return err;
}

uint32_t model_obsv_num_inferences(void)
{
	uint32_t num;

	/* Same lock as update and collect, so the count is not read mid-reset */
	k_mutex_lock(&ctx.lock, K_FOREVER);
	num = ctx.state.num_inferences;
	k_mutex_unlock(&ctx.lock);

	return num;
}
```

## src/model_obsv.h
```c
/*
 * Copyright (c) 2026 Nordic Semiconductor ASA
 *
 * SPDX-License-Identifier: LicenseRef-Nordic-5-Clause
 */

/**
 * @file model_obsv.h
 * @defgroup sample_mo_model_obsv Model observability
 * @{
 * @ingroup sample_mo
 *
 * nRF Edge AI observability for the sample: output metrics
 * (class predictions distribution, transition matrix, model certainty
 * descriptor) published as a Memfault CDR.
 */

#ifndef __MODEL_OBSV_H__
#define __MODEL_OBSV_H__

#include <stdint.h>

#include <nrf_edgeai_obsv/nrf_edgeai_obsv_core.h>

#ifdef __cplusplus
extern "C" {
#endif

/**
 * @brief Create the observability context and metrics, bind the Memfault transport
 *
 * @param info Model metadata embedded in every CDR
 *
 * @return 0 on success, negative errno on failure
 */
int model_obsv_init(const nrf_edgeai_obsv_model_info_t *info);

/**
 * @brief Feed one class-probability vector to the observability metrics
 *
 * @param probs Probability per class, in @ref activity_class order
 *
 * @return 0 on success, negative errno on failure
 */
int model_obsv_update_probs(const float *probs);

/**
 * @brief Get the number of probability vectors fed since the last collect
 *
 * The collect that stages a CDR resets the context, so the count drops to 0
 * once the fed vectors are encoded into a CDR.
 *
 * @return Number of vectors fed since the last reset
 */
uint32_t model_obsv_num_inferences(void);

#ifdef __cplusplus
}
#endif

#endif /* __MODEL_OBSV_H__ */

/**
 * @}
 */
```

## src/scenarios.c
```c
/*
 * Copyright (c) 2026 Nordic Semiconductor ASA
 *
 * SPDX-License-Identifier: LicenseRef-Nordic-5-Clause
 */

#include "scenarios.h"

#include <zephyr/sys/util.h>

/*
 * Column order: walking, sitting, running, laying. Each row sums to 1.
 * The comment names the dominant (predicted) class of the row.
 */

const char *const activity_class_name[ACTIVITY_CLASS_COUNT] = {
	[ACTIVITY_CLASS_WALKING] = "walking",
	[ACTIVITY_CLASS_SITTING] = "sitting",
	[ACTIVITY_CLASS_RUNNING] = "running",
	[ACTIVITY_CLASS_LAYING] = "laying",
};

/* Scenario 1: walking 7 (35%), sitting 3 (15%), running 1 (5%), laying 9 (45%) */
static const float scenario_1[][ACTIVITY_CLASS_COUNT] = {
	{0.82f, 0.06f, 0.08f, 0.04f}, /* walking */
	{0.88f, 0.04f, 0.06f, 0.02f}, /* walking */
	{0.91f, 0.03f, 0.05f, 0.01f}, /* walking */
	{0.76f, 0.05f, 0.16f, 0.03f}, /* walking */
	{0.38f, 0.03f, 0.57f, 0.02f}, /* running */
	{0.71f, 0.05f, 0.21f, 0.03f}, /* walking */
	{0.86f, 0.06f, 0.06f, 0.02f}, /* walking */
	{0.64f, 0.27f, 0.04f, 0.05f}, /* walking */
	{0.18f, 0.69f, 0.02f, 0.11f}, /* sitting */
	{0.06f, 0.85f, 0.01f, 0.08f}, /* sitting */
	{0.03f, 0.72f, 0.01f, 0.24f}, /* sitting */
	{0.02f, 0.31f, 0.01f, 0.66f}, /* laying */
	{0.01f, 0.12f, 0.01f, 0.86f}, /* laying */
	{0.01f, 0.06f, 0.00f, 0.93f}, /* laying */
	{0.01f, 0.04f, 0.00f, 0.95f}, /* laying */
	{0.00f, 0.03f, 0.00f, 0.97f}, /* laying */
	{0.00f, 0.02f, 0.00f, 0.98f}, /* laying */
	{0.01f, 0.03f, 0.00f, 0.96f}, /* laying */
	{0.00f, 0.04f, 0.00f, 0.96f}, /* laying */
	{0.01f, 0.05f, 0.00f, 0.94f}, /* laying */
};

/* Scenario 2: walking 3 (15%), sitting 3 (15%), running 1 (5%), laying 13 (65%) */
static const float scenario_2[][ACTIVITY_CLASS_COUNT] = {
	{0.01f, 0.04f, 0.00f, 0.95f}, /* laying */
	{0.00f, 0.03f, 0.00f, 0.97f}, /* laying */
	{0.00f, 0.02f, 0.00f, 0.98f}, /* laying */
	{0.01f, 0.05f, 0.00f, 0.94f}, /* laying */
	{0.01f, 0.09f, 0.00f, 0.90f}, /* laying */
	{0.02f, 0.36f, 0.01f, 0.61f}, /* laying */
	{0.02f, 0.55f, 0.01f, 0.42f}, /* sitting */
	{0.01f, 0.30f, 0.00f, 0.69f}, /* laying */
	{0.01f, 0.11f, 0.00f, 0.88f}, /* laying */
	{0.00f, 0.05f, 0.00f, 0.95f}, /* laying */
	{0.00f, 0.03f, 0.00f, 0.97f}, /* laying */
	{0.00f, 0.02f, 0.00f, 0.98f}, /* laying */
	{0.01f, 0.04f, 0.00f, 0.95f}, /* laying */
	{0.01f, 0.21f, 0.00f, 0.78f}, /* laying */
	{0.04f, 0.68f, 0.01f, 0.27f}, /* sitting */
	{0.09f, 0.83f, 0.02f, 0.06f}, /* sitting */
	{0.58f, 0.35f, 0.04f, 0.03f}, /* walking */
	{0.84f, 0.07f, 0.07f, 0.02f}, /* walking */
	{0.79f, 0.03f, 0.17f, 0.01f}, /* walking */
	{0.29f, 0.02f, 0.68f, 0.01f}, /* running */
};

/* Scenario 3: walking 5 (25%), sitting 7 (35%), running 3 (15%), laying 5 (25%) */
static const float scenario_3[][ACTIVITY_CLASS_COUNT] = {
	{0.05f, 0.87f, 0.01f, 0.07f}, /* sitting */
	{0.04f, 0.91f, 0.01f, 0.04f}, /* sitting */
	{0.07f, 0.84f, 0.02f, 0.07f}, /* sitting */
	{0.22f, 0.71f, 0.03f, 0.04f}, /* sitting */
	{0.69f, 0.24f, 0.05f, 0.02f}, /* walking */
	{0.87f, 0.05f, 0.07f, 0.01f}, /* walking */
	{0.72f, 0.02f, 0.25f, 0.01f}, /* walking */
	{0.31f, 0.01f, 0.67f, 0.01f}, /* running */
	{0.12f, 0.01f, 0.86f, 0.01f}, /* running */
	{0.08f, 0.00f, 0.92f, 0.00f}, /* running */
	{0.55f, 0.02f, 0.42f, 0.01f}, /* walking */
	{0.81f, 0.09f, 0.08f, 0.02f}, /* walking */
	{0.26f, 0.66f, 0.02f, 0.06f}, /* sitting */
	{0.05f, 0.88f, 0.01f, 0.06f}, /* sitting */
	{0.03f, 0.62f, 0.00f, 0.35f}, /* sitting */
	{0.01f, 0.27f, 0.00f, 0.72f}, /* laying */
	{0.01f, 0.09f, 0.00f, 0.90f}, /* laying */
	{0.00f, 0.04f, 0.00f, 0.96f}, /* laying */
	{0.00f, 0.02f, 0.00f, 0.98f}, /* laying */
	{0.01f, 0.03f, 0.00f, 0.96f}, /* laying */
};

BUILD_ASSERT(ARRAY_SIZE(scenario_1) <= SCENARIO_MAX_VECTORS);
BUILD_ASSERT(ARRAY_SIZE(scenario_2) <= SCENARIO_MAX_VECTORS);
BUILD_ASSERT(ARRAY_SIZE(scenario_3) <= SCENARIO_MAX_VECTORS);

const struct scenario scenarios[SCENARIO_NUM] = {
	{.vectors = scenario_1, .num_vectors = ARRAY_SIZE(scenario_1)},
	{.vectors = scenario_2, .num_vectors = ARRAY_SIZE(scenario_2)},
	{.vectors = scenario_3, .num_vectors = ARRAY_SIZE(scenario_3)},
};
```

## src/scenarios.h
```c
/*
 * Copyright (c) 2026 Nordic Semiconductor ASA
 *
 * SPDX-License-Identifier: LicenseRef-Nordic-5-Clause
 */

/**
 * @file scenarios.h
 * @defgroup sample_mo_scenarios Activity recognition scenarios
 * @{
 * @ingroup sample_mo
 *
 * Predefined class-probability vectors that stand in for the output of an
 * activity recognition model. Each scenario is fed to the observability
 * metrics as one Memfault CDR.
 */

#ifndef __SCENARIOS_H__
#define __SCENARIOS_H__

#include <stddef.h>

#ifdef __cplusplus
extern "C" {
#endif

/** Activity classes, in probability vector order */
enum activity_class {
	ACTIVITY_CLASS_WALKING,
	ACTIVITY_CLASS_SITTING,
	ACTIVITY_CLASS_RUNNING,
	ACTIVITY_CLASS_LAYING,
	ACTIVITY_CLASS_COUNT,
};

/** Largest number of probability vectors in one scenario */
#define SCENARIO_MAX_VECTORS (20U)

/** Number of predefined scenarios */
#define SCENARIO_NUM (3U)

/** One scenario: a sequence of class-probability vectors */
struct scenario {
	/** Probability per class, one row per inference */
	const float (*vectors)[ACTIVITY_CLASS_COUNT];
	/** Number of rows in @ref vectors */
	size_t num_vectors;
};

/** Class names, indexed by @ref activity_class */
extern const char *const activity_class_name[ACTIVITY_CLASS_COUNT];

/** Predefined scenarios, fed in this order */
extern const struct scenario scenarios[SCENARIO_NUM];

#ifdef __cplusplus
}
#endif

#endif /* __SCENARIOS_H__ */

/**
 * @}
 */
```

## src/ux_state_manager.c
```c
/*
 * Copyright (c) 2026 Nordic Semiconductor ASA
 *
 * SPDX-License-Identifier: LicenseRef-Nordic-5-Clause
 */

#include "ux_state_manager.h"

#include <errno.h>
#include <zephyr/drivers/gpio.h>
#include <zephyr/kernel.h>
#include <zephyr/logging/log.h>
#include <zephyr/sys/atomic.h>
#include <zephyr/sys/util.h>

LOG_MODULE_REGISTER(uxsm, CONFIG_LOG_DEFAULT_LEVEL);

/** Blink period per state: 3 Hz before BLE connection, 1 Hz after */
static const uint32_t BLINK_PERIOD_MS[] = {
	[UX_STATE_ADVERTISING] = 1000U / 3U,
	[UX_STATE_CONNECTED] = 1000U,
};

BUILD_ASSERT(UX_LED_ON_MS < (1000U / 3U), "LED ON time must be shorter than the blink period");

/* led0 is the blue channel of the RGB LED */
static const struct gpio_dt_spec blue_led = GPIO_DT_SPEC_GET(DT_ALIAS(led0), gpios);

/* Written from BT stack callbacks, read from the system workqueue */
static atomic_t ux_state = ATOMIC_INIT(UX_STATE_ADVERTISING);

static struct k_work_delayable led_blink_work;

static void led_blink_work_handler(struct k_work *work)
{
	static bool led_on;
	ux_state_t state = (ux_state_t)atomic_get(&ux_state);

	ARG_UNUSED(work);
	__ASSERT_NO_MSG(state < ARRAY_SIZE(BLINK_PERIOD_MS));

	led_on = !led_on;
	(void)gpio_pin_set_dt(&blue_led, led_on);

	k_work_schedule(&led_blink_work,
			K_MSEC(led_on ? UX_LED_ON_MS : (BLINK_PERIOD_MS[state] - UX_LED_ON_MS)));
}

int uxsm_init(void)
{
	int err;

	if (!gpio_is_ready_dt(&blue_led)) {
		LOG_ERR("Status LED GPIO is not ready");
		return -ENODEV;
	}

	err = gpio_pin_configure_dt(&blue_led, GPIO_OUTPUT_INACTIVE);
	if (err != 0) {
		LOG_ERR("Failed to configure status LED (err %d)", err);
		return err;
	}

	atomic_set(&ux_state, (atomic_val_t)UX_STATE_ADVERTISING);

	k_work_init_delayable(&led_blink_work, led_blink_work_handler);
	k_work_schedule(&led_blink_work, K_NO_WAIT);

	return 0;
}

void uxsm_set_ble_connected(bool connected)
{
	ux_state_t new_state = connected ? UX_STATE_CONNECTED : UX_STATE_ADVERTISING;
	ux_state_t old = (ux_state_t)atomic_set(&ux_state, (atomic_val_t)new_state);

	if (old == new_state) {
		return;
	}

	LOG_INF("State transition -> %s",
		(new_state == UX_STATE_CONNECTED) ? "CONNECTED" : "ADVERTISING");

	/* Apply the new blink rate right away instead of after the current phase */
	k_work_reschedule(&led_blink_work, K_NO_WAIT);
}

ux_state_t uxsm_get_state(void)
{
	return (ux_state_t)atomic_get(&ux_state);
}
```

## src/ux_state_manager.h
```c
/*
 * Copyright (c) 2026 Nordic Semiconductor ASA
 *
 * SPDX-License-Identifier: LicenseRef-Nordic-5-Clause
 */

/**
 * @defgroup sample_mo Model Observability Sample
 *
 * @defgroup sample_mo_uxsm UX State Machine
 * @{
 * @ingroup sample_mo
 *
 * uxsm means ux_state_machine.
 *
 * @brief Tracks the BLE connection state of the sample and drives
 *        the blue status LED accordingly.
 *
 * LED indication (LED ON time is @ref UX_LED_ON_MS in both states):
 *
 *   - @ref UX_STATE_ADVERTISING : blink at 3 Hz (waiting for BLE connection)
 *   - @ref UX_STATE_CONNECTED   : blink at 1 Hz (BLE peer connected)
 */
#ifndef __UXSM_H__
#define __UXSM_H__

#include <stdbool.h>

#ifdef __cplusplus
extern "C" {
#endif /* __cplusplus */

/** Status LED ON time per blink, in milliseconds */
#define UX_LED_ON_MS (100U)

/**
 * @brief Sample UX state.
 */
typedef enum {
	UX_STATE_ADVERTISING = 0,
	UX_STATE_CONNECTED,
} ux_state_t;

/**
 * @brief Initialize the UX state manager.
 *
 * Initializes the status LED and starts blinking in @ref UX_STATE_ADVERTISING.
 *
 * @return 0 on success, negative error code otherwise.
 */
int uxsm_init(void);

/**
 * @brief Update the state from the BLE connection state.
 *
 * Safe to call from BLE stack callbacks. Matches @ref ble_mds_conn_cb_t.
 *
 * @param connected true if a peer is connected, false otherwise.
 */
void uxsm_set_ble_connected(bool connected);

/**
 * @brief Get the current UX state.
 */
ux_state_t uxsm_get_state(void);

#ifdef __cplusplus
}
#endif /* __cplusplus */

#endif /* __UXSM_H__ */

/**
 * @}
 */
```
