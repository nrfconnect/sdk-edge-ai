## CMakeLists.txt
```
#
# Copyright (c) 2026 Nordic Semiconductor ASA
#
# SPDX-License-Identifier: LicenseRef-Nordic-5-Clause
#

cmake_minimum_required(VERSION 3.20.0)

find_package(Zephyr REQUIRED HINTS $ENV{ZEPHYR_BASE})
project(hello_ei)

# Add application source files
target_sources(app PRIVATE
  src/main.c
)

# Add application include directories
target_include_directories(app PRIVATE
  src/include
)

# Enable C linkage for Edge Impulse module (allows calling from C code)
zephyr_compile_definitions(
  EI_C_LINKAGE=1
  EIDSP_SIGNAL_C_FN_POINTER=1
)

# Suppress warnings generated by Edge Impulse SDK
zephyr_compile_options(
  -Wno-double-promotion
  -Wno-unused
  -Wno-sign-compare
  -Wno-maybe-uninitialized
)

# Expand any ${VARIABLES} in the path
string(CONFIGURE ${CONFIG_EDGE_IMPULSE_MODEL_PATH} CONFIG_EDGE_IMPULSE_MODEL_PATH)

# Convert relative paths to absolute paths
if(NOT IS_ABSOLUTE ${CONFIG_EDGE_IMPULSE_MODEL_PATH})
  # Using application source directory as base directory for relative path
  set(CONFIG_EDGE_IMPULSE_MODEL_PATH ${APPLICATION_SOURCE_DIR}/${CONFIG_EDGE_IMPULSE_MODEL_PATH})
endif()

set(FETCH_CONTENT_NAME edge_impulse)

include(FetchContent)

FetchContent_Declare(
    ${FETCH_CONTENT_NAME}
    URL ${CONFIG_EDGE_IMPULSE_MODEL_PATH}
)

FetchContent_MakeAvailable(${FETCH_CONTENT_NAME})

if(${CONFIG_NRF_AXON})
  zephyr_compile_definitions(
    NRF_AXON_MODEL_NAME=${CONFIG_NRF_AXON_MODEL_NAME}
  )

  zephyr_include_directories(${edge_impulse_SOURCE_DIR})
  zephyr_include_directories(${edge_impulse_SOURCE_DIR}/nordic-axon-model)
endif()
```

## Kconfig
```
#
# Copyright (c) 2026 Nordic Semiconductor ASA
#
# SPDX-License-Identifier: LicenseRef-Nordic-5-Clause
#

mainmenu "Hello Edge Impulse sample application"

config EDGE_IMPULSE_MODEL_PATH
	string "Edge Impulse model deployment path"
	default 'ei_model_nrf_accel_sim_cpu_v63.zip'
	help
	  Specifies local file path of an archive containing Edge Impulse model deployment.
	  It can be either C++ Library, Zephyr library or Axon Library deployment.

config HELLO_EI_DEBUG_MODE
	bool "Run Edge Impulse classifier in debug mode"
	help
	  Enables additional log information from the Edge Impulse classifier.

config HELLO_EI_DATA_BUF_SIZE
	int "Size of input data buffer"
	default 512
	help
	  The buffer is used to store input data for the Edge Impulse library.
	  Size of the buffer is expressed as number of floats.

# This must be at the end to include Zephyr's Kconfig tree
source "Kconfig.zephyr"
```

## sample.yaml
```
sample:
  description: Sample showing basic Edge Impulse usage
  name: Hello Edge Impulse sample
tests:
  sample.edge_impulse.hello_ei:
    sysbuild: true
    build_only: false
    harness: console
    harness_config:
      ordered: true
      regex:
        - "=== Inference result ==="
        - "idle => 0\\.0\\d+"
        - "sine => (1\\.0\\d+)|(0\\.9\\d+)"
        - "triangle => 0\\.0\\d+"
        - "anomaly: (-\\d+\\.\\d+)|(0\\.0\\d+)"
        - "=== Inference time profiling ==="
        - "Full inference completed in \\d+ us"
        - "Classification completed in \\d+ us"
        - "DSP operations completed in \\d+ us"
        - "Anomaly detection completed in \\d+ us"
        - "=== Inference result ==="
        - "idle => 0\\.0\\d+"
        - "sine => (1\\.0\\d+)|(0\\.9\\d+)"
        - "triangle => 0\\.0\\d+"
        - "anomaly: (-\\d+\\.\\d+)|(0\\.0\\d+)"
        - "=== Inference time profiling ==="
        - "Full inference completed in \\d+ us"
        - "Classification completed in \\d+ us"
        - "DSP operations completed in \\d+ us"
        - "Anomaly detection completed in \\d+ us"
        - "=== Inference result ==="
        - "idle => 0\\.0\\d+"
        - "sine => (1\\.0\\d+)|(0\\.9\\d+)"
        - "triangle => 0\\.0\\d+"
        - "anomaly: (-\\d+\\.\\d+)|(0\\.0\\d+)"
        - "=== Inference time profiling ==="
        - "Full inference completed in \\d+ us"
        - "Classification completed in \\d+ us"
        - "DSP operations completed in \\d+ us"
        - "Anomaly detection completed in \\d+ us"
        - "=== Inference result ==="
        - "idle => 0\\.0\\d+"
        - "sine => 0\\.0\\d+"
        - "triangle => (1\\.0\\d+)|(0\\.9\\d+)"
        - "anomaly: (-\\d+\\.\\d+)|(0\\.0\\d+)"
        - "=== Inference time profiling ==="
        - "Full inference completed in \\d+ us"
        - "Classification completed in \\d+ us"
        - "DSP operations completed in \\d+ us"
        - "Anomaly detection completed in \\d+ us"
        - "=== Inference result ==="
        - "idle => 0\\.0\\d+"
        - "sine => 0\\.0\\d+"
        - "triangle => (1\\.0\\d+)|(0\\.9\\d+)"
        - "anomaly: (-\\d+\\.\\d+)|(0\\.0\\d+)"
        - "=== Inference time profiling ==="
        - "Full inference completed in \\d+ us"
        - "Classification completed in \\d+ us"
        - "DSP operations completed in \\d+ us"
        - "Anomaly detection completed in \\d+ us"
        - "=== Inference result ==="
        - "idle => 0\\.0\\d+"
        - "sine => 0\\.0\\d+"
        - "triangle => (1\\.0\\d+)|(0\\.9\\d+)"
        - "anomaly: (-\\d+\\.\\d+)|(0\\.0\\d+)"
        - "=== Inference time profiling ==="
        - "Full inference completed in \\d+ us"
        - "Classification completed in \\d+ us"
        - "DSP operations completed in \\d+ us"
        - "Anomaly detection completed in \\d+ us"
      type: multi_line
    platform_allow:
      - nrf54l15dk/nrf54l15/cpuapp
      - nrf54lm20dk/nrf54lm20a/cpuapp
      - nrf54lm20dk/nrf54lm20b/cpuapp
    integration_platforms:
      - nrf54l15dk/nrf54l15/cpuapp
      - nrf54lm20dk/nrf54lm20a/cpuapp
      - nrf54lm20dk/nrf54lm20b/cpuapp
    timeout: 10
    tags:
      - ci_build
      - sysbuild
      - ci_samples_edge_impulse
```

## prj.conf
```kconfig
#
# Copyright (c) 2026 Nordic Semiconductor ASA
#
# SPDX-License-Identifier: LicenseRef-Nordic-5-Clause
#

CONFIG_NCS_SAMPLES_DEFAULTS=y

# Increase main stack size
CONFIG_MAIN_STACK_SIZE=2048

# Enable Edge Impulse dependencies
CONFIG_CPP=y
CONFIG_STD_CPP11=y
CONFIG_FP16=n
CONFIG_REQUIRES_FULL_LIBCPP=y
CONFIG_CBPRINTF_FP_SUPPORT=y
CONFIG_FPU=y

# Enable Edge Impulse SDK
CONFIG_EDGE_IMPULSE_SDK=y
CONFIG_HEAP_MEM_POOL_SIZE=3072
```

## prj_ei_module.conf
```kconfig
#
# Copyright (c) 2026 Nordic Semiconductor ASA
#
# SPDX-License-Identifier: LicenseRef-Nordic-5-Clause
#

CONFIG_NCS_SAMPLES_DEFAULTS=y

# Using console with UART
CONFIG_CONSOLE=y
CONFIG_UART_CONSOLE=y

# Enable Edge Impulse dependencies
CONFIG_CPP=y
CONFIG_STD_CPP11=y
CONFIG_FP16=n
CONFIG_REQUIRES_FULL_LIBCPP=y
CONFIG_CBPRINTF_FP_SUPPORT=y
CONFIG_FPU=y

# Increase main stack size
CONFIG_MAIN_STACK_SIZE=2048

# Use URL to fetch Edge Impulse library from the Internet or local path
CONFIG_EDGE_IMPULSE_URI="edge_impulse/nrf_accel_sim_clone-zephyr-module-v39.zip"
CONFIG_EDGE_IMPULSE_SDK=y

CONFIG_EDGE_IMPULSE_COMPILE_IN_TREE=y
```

## prj_ei_standalone.conf
```kconfig
#
# Copyright (c) 2026 Nordic Semiconductor ASA
#
# SPDX-License-Identifier: LicenseRef-Nordic-5-Clause
#

CONFIG_NCS_SAMPLES_DEFAULTS=y

# Using console with UART
CONFIG_CONSOLE=y
CONFIG_UART_CONSOLE=y

# Enable Edge Impulse dependencies
CONFIG_CPP=y
CONFIG_STD_CPP11=y
CONFIG_FP16=n
CONFIG_REQUIRES_FULL_LIBCPP=y
CONFIG_CBPRINTF_FP_SUPPORT=y
CONFIG_FPU=y

# Increase main stack size
CONFIG_MAIN_STACK_SIZE=2048

# Use URL to fetch Edge Impulse library from the Internet or local path
CONFIG_EDGE_IMPULSE_URI="edge_impulse/nrf_accel_sim-cpp-mcu-v43.zip"

CONFIG_EDGE_IMPULSE_COMPILE_IN_TREE=n
```

## boards/nrf54lm20dk_nrf54lm20b_cpuapp.conf
```kconfig
#
# Copyright (c) 2026 Nordic Semiconductor ASA
#
# SPDX-License-Identifier: LicenseRef-Nordic-5-Clause
#

CONFIG_NRF_AXON=y
CONFIG_NRF_AXON_INTERLAYER_BUFFER_SIZE=36

# Use model that is dedicated for Axon NPU
CONFIG_NRF_AXON_MODEL_NAME="ei_model_nrf_accel_sim_62"
CONFIG_EDGE_IMPULSE_MODEL_PATH="ei_model_nrf_accel_sim_axon_v62.zip"
```

## boards/nrf54lm20dk_nrf54lm20b_cpuapp_model_cpu.conf
```kconfig
#
# Copyright (c) 2026 Nordic Semiconductor ASA
#
# SPDX-License-Identifier: LicenseRef-Nordic-5-Clause
#

# Disable Axon to use a model executed on the CPU instead of the NPU
CONFIG_NRF_AXON=n
```

## src/main.c
```c
/*
 * Copyright (c) 2026 Nordic Semiconductor ASA
 *
 * SPDX-License-Identifier: LicenseRef-Nordic-5-Clause
 */

#include <zephyr/kernel.h>
#include <zephyr/logging/log.h>

#include <edge-impulse-sdk/dsp/numpy_types.h>
#include <edge-impulse-sdk/classifier/ei_classifier_types.h>

#include "input_data.h"

#define LOG_MODULE_NAME hello_ei
LOG_MODULE_REGISTER(LOG_MODULE_NAME);

#define LOG_SEPARATOR() LOG_INF("#########################")

BUILD_ASSERT(EI_CLASSIFIER_DSP_INPUT_FRAME_SIZE <= CONFIG_HELLO_EI_DATA_BUF_SIZE,
	"Size of data buffer is smaller than input window size");

static struct {
	float data[CONFIG_HELLO_EI_DATA_BUF_SIZE];
	size_t current_index;
} sample_buffer;

static size_t inference_cnt;

/* External function declaration needed because the function is declared in
 * edge-impulse-sdk/classifier/ei_run_classifier.h which includes some
 * C++ source code files thus cannot be included in this C file.
 */
extern EI_IMPULSE_ERROR run_classifier(signal_t *signal, ei_impulse_result_t *result, bool debug);

static void print_inference_result(const ei_impulse_result_t *result, uint32_t duration_us)
{
	LOG_INF("=== Inference result ===");

	for (size_t i = 0; i < EI_CLASSIFIER_LABEL_COUNT; i++) {
		LOG_INF("%s => %.5f", result->classification[i].label,
			(double)result->classification[i].value);
	}

#if EI_CLASSIFIER_HAS_ANOMALY
	LOG_INF("anomaly: %.5f", (double)result->anomaly);
#endif

	LOG_INF("=== Inference time profiling ===");
	LOG_INF("Full inference completed in %u us", duration_us);
	LOG_INF("Classification completed in %lld us", result->timing.classification_us);
	LOG_INF("DSP operations completed in %lld us", result->timing.dsp_us);

#if EI_CLASSIFIER_HAS_ANOMALY
	LOG_INF("Anomaly detection completed in %lld us", result->timing.anomaly_us);
#endif

	LOG_SEPARATOR();
}

static void print_model_info(void)
{
	LOG_INF("=== Model info ===");
	LOG_INF("Input frame size: %d", EI_CLASSIFIER_RAW_SAMPLES_PER_FRAME);
	LOG_INF("Input window size: %d", EI_CLASSIFIER_DSP_INPUT_FRAME_SIZE);
	LOG_INF("Input frequency: %d", EI_CLASSIFIER_FREQUENCY);
	LOG_INF("Label count: %d", EI_CLASSIFIER_LABEL_COUNT);
	LOG_INF("Has anomaly: %s", EI_CLASSIFIER_HAS_ANOMALY ? "yes" : "no");
	LOG_SEPARATOR();
}

static void clear_sample_buffer(void)
{
	memset(sample_buffer.data, 0, sizeof(sample_buffer.data));
	sample_buffer.current_index = 0;
}

static void collect_sample(float val)
{
	sample_buffer.data[sample_buffer.current_index] = val;

	/* Move to the next index in circular buffer. */
	if (sample_buffer.current_index < (CONFIG_HELLO_EI_DATA_BUF_SIZE - 1)) {
		sample_buffer.current_index++;
	} else {
		sample_buffer.current_index = 0;
	}
}

static int get_samples_from_buffer(size_t offset, size_t length, float *out_ptr)
{
	__ASSERT_NO_MSG(length <= CONFIG_HELLO_EI_DATA_BUF_SIZE);
	__ASSERT_NO_MSG(out_ptr != NULL);

	/* Calculate start and end indices in the circular buffer. */
	const size_t buffer_size = ARRAY_SIZE(sample_buffer.data);
	const size_t start_index = (inference_cnt + offset) % buffer_size;
	const size_t end_index = start_index + length;

	if (end_index <= buffer_size) {
		/* Data fits without wrapping. */
		memcpy(out_ptr, sample_buffer.data + start_index,
			length * sizeof(float));
	} else {
		/* Data wraps around to the beginning of the buffer. */
		const size_t first_part_len = buffer_size - start_index;
		const size_t second_part_len = length - first_part_len;

		memcpy(out_ptr, sample_buffer.data + start_index,
		       first_part_len * sizeof(float));
		memcpy(out_ptr + first_part_len, sample_buffer.data,
		       second_part_len * sizeof(float));
	}

	return 0;
}

static EI_IMPULSE_ERROR run_ei_classification(ei_impulse_result_t *ei_result, size_t window_size)
{
	signal_t features_signal = {
		.get_data = get_samples_from_buffer,
		.total_length = window_size
	};

	return run_classifier(&features_signal, ei_result,
			      IS_ENABLED(CONFIG_HELLO_EI_DEBUG_MODE));
}

static int run_model(const float *input_data, size_t input_data_size)
{
	__ASSERT_NO_MSG(input_data != NULL);
	__ASSERT_NO_MSG(input_data_size >= EI_CLASSIFIER_DSP_INPUT_FRAME_SIZE);

	size_t sample_cnt = 0;
	uint32_t start_cycles, delta_us;
	ei_impulse_result_t inference_result;
	EI_IMPULSE_ERROR err;

	clear_sample_buffer();
	inference_cnt = 0;

	while (sample_cnt < input_data_size) {
		/* Collect new sample (in this case: from compiled input data). */
		collect_sample(input_data[sample_cnt]);
		sample_cnt++;

		/* When there is enough data in the buffer, start running inference
		 * in a sliding window fashion.
		 */
		if (sample_cnt >= EI_CLASSIFIER_DSP_INPUT_FRAME_SIZE) {
			start_cycles = k_cycle_get_32();
			err = run_ei_classification(&inference_result, EI_CLASSIFIER_DSP_INPUT_FRAME_SIZE);
			delta_us = k_cyc_to_us_floor32(k_cycle_get_32() - start_cycles);

			if (err != EI_IMPULSE_OK) {
				LOG_ERR("Classification failed with error code: %d", err);
				return -1;
			}

			print_inference_result(&inference_result, delta_us);

			/* Keep track of how many inferences have been performed
			 * to know the offset in the buffered data.
			 */
			inference_cnt++;
		}
	}

	LOG_INF("End of input data reached");
	return 0;
}

int main(void)
{
	print_model_info();

	LOG_INF("Running inference on sine wave input data");
	LOG_SEPARATOR();

	run_model(input_data_sine, ARRAY_SIZE(input_data_sine));

	LOG_SEPARATOR();
	LOG_INF("Running inference on triangle wave input data");
	LOG_SEPARATOR();

	run_model(input_data_triangle, ARRAY_SIZE(input_data_triangle));

	return 0;
}
```

## src/ei_wrapper.cpp
```c
/*
 * Copyright (c) 2026 Nordic Semiconductor ASA
 *
 * SPDX-License-Identifier: LicenseRef-Nordic-5-Clause
 */

#include "ei_run_classifier.h"

#if !CONFIG_ZTEST
/* Fixes warnings about redefinition of Zephyr ROUND_UP macro. */
#ifdef ROUND_UP
#undef ROUND_UP
#endif
#endif /* !CONFIG_ZTEST */

#include "ei_wrapper.h"

#define DEBUG_MODE		IS_ENABLED(CONFIG_EI_WRAPPER_DEBUG_MODE)

get_data_callback_t get_data_cbk = nullptr;

int ei_wrapper_init(get_data_callback_t cbk)
{
	get_data_cbk = cbk;
	return 0;
}

int ei_wrapper_run_inference(ei_impulse_result_t *ei_result, size_t window_size)
{
	signal_t features_signal;

	__ASSERT(ei_result != nullptr, "ei_result pointer is null");

	features_signal.get_data = get_data_cbk;
	features_signal.total_length = window_size;

	EI_IMPULSE_ERROR err = run_classifier(&features_signal, ei_result, DEBUG_MODE);

	return err;
}
```
