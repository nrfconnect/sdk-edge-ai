/*
 * Copyright (c) 2026 Nordic Semiconductor ASA
 *
 * SPDX-License-Identifier: LicenseRef-Nordic-5-Clause
 *
 * Default nRF54LM20 DK MCUboot + model_storage layout (single-slot model profile).
 *
 * Image 0: dual-slot firmware (swap-using-move, 684 kB slots).
 * Image 1: single-slot model (340 kB model_storage; slot2 and slot3 label the same region).
 *
 * For dual-slot model (separate slot2/slot3 with swap/revert), build with
 * SB_CONFIG_NRF_EDGEAI_REGRESSION_MODEL_SLOT_DUAL=y (see README.rst).
 *
 * Use in the application overlay and sysbuild/mcuboot/boards/ overlay.
 */

#include "nrf54lm20dk_mcuboot_partitions_single.dtsi"
#include "nrf54lm20dk_mcuboot_bootchain.dtsi"
