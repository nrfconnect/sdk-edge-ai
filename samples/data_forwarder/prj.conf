## CMakeLists.txt
```
cmake_minimum_required(VERSION 3.20.0)

find_package(Zephyr REQUIRED HINTS $ENV{ZEPHYR_BASE})
project(data_forwarder)

find_program(ZCBOR zcbor REQUIRED)

set(CDDL_FILE ${CMAKE_CURRENT_LIST_DIR}/cddl/data_forwarder.cddl)
set(GEN_SRC_DIR ${PROJECT_BINARY_DIR}/src)
set(GEN_INC_DIR ${PROJECT_BINARY_DIR}/include)
set(GEN_ENCODE_C ${GEN_SRC_DIR}/data_forwarder_encode.c)
set(GEN_ENCODE_H ${GEN_INC_DIR}/data_forwarder_encode.h)

file(MAKE_DIRECTORY ${GEN_SRC_DIR})
file(MAKE_DIRECTORY ${GEN_INC_DIR})

add_custom_command(
  OUTPUT ${GEN_ENCODE_C} ${GEN_ENCODE_H}
  COMMAND ${ZCBOR} code
          -c ${CDDL_FILE}
          --output-c ${GEN_ENCODE_C}
          --output-h ${GEN_ENCODE_H}
          --default-max-qty ${CONFIG_DATA_FWD_PROTO_MAX_CHANNELS}
          -t envelope
          -e
  DEPENDS ${CDDL_FILE}
  COMMENT "Generating CBOR encoder from ${CDDL_FILE}"
)

target_include_directories(app PRIVATE
  ${GEN_INC_DIR}
)

target_sources(app PRIVATE
  src/main.c
  src/protocol/protocol.c
  ${GEN_ENCODE_C}
)

if(CONFIG_DATA_FWD_SENSOR_BMI270)
  target_sources(app PRIVATE src/sensor/bmi270.c)
elseif(CONFIG_DATA_FWD_SENSOR_ADXL367)
  target_sources(app PRIVATE src/sensor/adxl367.c)
elseif(CONFIG_DATA_FWD_SENSOR_BME688)
  target_sources(app PRIVATE src/sensor/bme688.c)
endif()

if(CONFIG_DATA_FWD_TRANSPORT_BLE_NUS)
  target_sources(app PRIVATE src/transport/ble_nus.c)
elseif(CONFIG_DATA_FWD_TRANSPORT_UART)
  target_sources(app PRIVATE src/transport/uart.c)
endif()
```

## Kconfig
```
#
# Copyright (c) 2026 Nordic Semiconductor ASA
#
# SPDX-License-Identifier: LicenseRef-Nordic-5-Clause
#

menu "Data Forwarder sample"

menuconfig DATA_FWD_PROTO
	bool "Data Forwarder protocol"
	select ENTROPY_GENERATOR if ENTROPY_NODE_ENABLED

if DATA_FWD_PROTO

if !DATA_FWD_PROTO_ASCII_MODE

config DATA_FWD_PROTO
	depends on ZCBOR
	depends on COBS

endif

config DATA_FWD_PROTO_RING_BUF_SIZE
	int "Ring buffer size in bytes"
	default 4096
	help
	  Size of protocol producer queue in bytes.

config DATA_FWD_PROTO_ASCII_MODE
	bool "ASCII output mode"
	help
	  Replaces CBOR binary framing with CSV output limited to just sensor values.

config DATA_FWD_PROTO_CRC
	bool "Append CRC-16 to every frame"
	depends on !DATA_FWD_PROTO_ASCII_MODE
	depends on CRC
	help
	  Enabled for integrity checking on host side.

config DATA_FWD_PROTO_META_RESEND_S
	int "Session info resend period (s)"
	range 1 600
	default 5
	help
	  Periodic resend of session-info for late joining hosts.

config DATA_FWD_PROTO_MAX_CHANNELS
	int "Max number of sensor channels"
	range 1 255
	help
	  Derived maximum count for zcbor generated arrays.

config DATA_FWD_PROTO_INT32_VALUES
	bool "32-bit integers for channel values"
	help
	  Use 32-bit integers instead of floats in the protocol.

endif

choice DATA_FWD_TRANSPORT
	prompt "Transport"
	default DATA_FWD_TRANSPORT_BLE_NUS

config DATA_FWD_TRANSPORT_BLE_NUS
	bool "Bluetooth LE NUS"
	depends on BT
	depends on BT_PERIPHERAL
	depends on BT_NUS

config DATA_FWD_TRANSPORT_UART
	bool "UART"
	depends on SERIAL
	depends on UART_ASYNC_API

endchoice

choice DATA_FWD_SENSOR
	prompt "Main sensor used in Data Forwarder"

config DATA_FWD_SENSOR_BMI270
	bool "BMI270 (6-axis IMU)"
	depends on SENSOR
	depends on BMI270

config DATA_FWD_SENSOR_ADXL367
	bool "ADXL367 (3-axis accelerometer)"
	depends on SENSOR
	depends on ADXL367

config DATA_FWD_SENSOR_BME688
	bool "BME688 (environmental)"
	depends on SENSOR
	depends on BME680

endchoice

config DATA_FWD_EXTRA_SENSOR_BME688
	bool "Append BME688 (duplication as upsampling)"
	depends on DATA_FWD_SENSOR_BMI270 || DATA_FWD_SENSOR_ADXL367
	depends on SENSOR
	depends on BME680
	help
	  Extend streamed samples with temperature, humidity, and pressure from BME688 at its native
	  rate by upsampling (repeating the latest reading between fetches).

config DATA_FWD_START_RETRY_MS
	int "Sensor/session start retry interval (ms)"
	range 10 10000
	default 100
	help
	  Delay between retries when sensor or protocol session start fails while
	  a transport link is up.

config DATA_FWD_PROTO_MAX_CHANNELS
	default 9 if DATA_FWD_SENSOR_BMI270 && DATA_FWD_EXTRA_SENSOR_BME688
	default 6 if DATA_FWD_SENSOR_BMI270
	default 6 if DATA_FWD_SENSOR_ADXL367 && DATA_FWD_EXTRA_SENSOR_BME688
	default 3 if DATA_FWD_SENSOR_ADXL367
	default 3 if DATA_FWD_SENSOR_BME688

endmenu

source "Kconfig.zephyr"
```

## sample.yaml
```
sample:
  description: Stream sensor data with CBOR framing
  name: Edge AI Data Forwarder

common:
  build_only: true
  platform_allow:
    - nrf54l15tag/nrf54l15/cpuapp
  integration_platforms:
    - nrf54l15tag/nrf54l15/cpuapp
  harness: console
  harness_config:
    type: multi_line
    regex:
      - "transport: Bluetooth LE NUS transport ready"
      - "data_forwarder: Data forwarder started"
      - "transport: Bluetooth LE connected"

tests:
  sample.data_forwarder.bmi270.zdebug:
    build_only: false

  sample.data_forwarder.adxl367.zdebug:
    extra_args:
      - CONFIG_DATA_FWD_SENSOR_ADXL367=y

  sample.data_forwarder.bme688.zdebug:
    extra_args:
      - CONFIG_DATA_FWD_SENSOR_BME688=y
      - CONFIG_DATA_FWD_EXTRA_SENSOR_BME688=n
```

## prj.conf
```kconfig
#
# Copyright (c) 2026 Nordic Semiconductor
#
# SPDX-License-Identifier: LicenseRef-Nordic-5-Clause
#

# Data forwarder
CONFIG_DATA_FWD_PROTO=y
CONFIG_DATA_FWD_PROTO_CRC=y
CONFIG_DATA_FWD_TRANSPORT_BLE_NUS=y
CONFIG_DATA_FWD_SENSOR_BMI270=y
CONFIG_DATA_FWD_EXTRA_SENSOR_BME688=y

# Select int32 for use with Edge AI Lab
CONFIG_DATA_FWD_PROTO_INT32_VALUES=y

# Data forwarder dependencies
CONFIG_ZCBOR=y
CONFIG_COBS=y
CONFIG_CRC=y

# Sensor dependencies
CONFIG_SENSOR=y
CONFIG_BMI270=y
CONFIG_BME680=y

# Logging and assert
CONFIG_LOG=y
CONFIG_LOG_BACKEND_RTT=y
CONFIG_USE_SEGGER_RTT=y
CONFIG_SEGGER_RTT_BUFFER_SIZE_UP=4096
CONFIG_ASSERT=y

# Bluetooth LE NUS transport dependencies
CONFIG_BT=y
CONFIG_BT_PERIPHERAL=y
CONFIG_BT_DEVICE_NAME="nRF DataFwd"
CONFIG_BT_MAX_CONN=1
CONFIG_BT_NUS=y
CONFIG_BT_L2CAP_TX_MTU=247
CONFIG_BT_BUF_ACL_RX_SIZE=251
```

## boards/nrf54l15tag_nrf54l15_cpuapp.overlay
```dts
/*
 * Copyright (c) 2026 Nordic Semiconductor ASA
 *
 * SPDX-License-Identifier: LicenseRef-Nordic-5-Clause
 */

&adxl367 {
	odr = <2>;
};
```

## src/main.c
```c
/*
 * Copyright (c) 2026 Nordic Semiconductor ASA
 *
 * SPDX-License-Identifier: LicenseRef-Nordic-5-Clause
 */

#include <zephyr/kernel.h>
#include <zephyr/logging/log.h>

#include "protocol/protocol.h"
#include "sensor/data_fwd_sensor.h"
#include "transport/transport.h"

LOG_MODULE_REGISTER(data_forwarder);

/**
 * @brief Stop sensor sampling and log a warning if stop fails.
 */
static void sensor_stop(void)
{
	int err = data_fwd_sensor_stop();

	if (err) {
		LOG_WRN("Sensor stop failed (err %d)", err);
	}
}

/**
 * @brief Start sensors and a protocol session, retrying on failure.
 *
 * Retries while the transport link remains up. Returns when both starts
 * succeed or the link drops.
 *
 * @param session Session configuration passed to @ref proto_start_session().
 */
static void session_start_retry(const struct proto_session_config *session)
{
	int err;

	while (transport_is_ready()) {
		err = data_fwd_sensor_start();
		if (err) {
			LOG_WRN("Sensor start failed (err %d), retrying in %d ms", err,
				CONFIG_DATA_FWD_START_RETRY_MS);
			k_sleep(K_MSEC(CONFIG_DATA_FWD_START_RETRY_MS));
			continue;
		}

		err = proto_start_session(session);
		if (err) {
			LOG_WRN("Failed to start session (err %d), retrying in %d ms", err,
				CONFIG_DATA_FWD_START_RETRY_MS);
			sensor_stop();
			k_sleep(K_MSEC(CONFIG_DATA_FWD_START_RETRY_MS));
			continue;
		}

		LOG_INF("Sampling session started (sid %u)", proto_get_session_id());
		break;
	}
}

/**
 * @brief Fetch sensor samples and send them until the transport disconnects.
 */
static void stream_samples(void)
{
	int err;

	while (transport_is_ready()) {
		proto_value_t values[CONFIG_DATA_FWD_PROTO_MAX_CHANNELS];
		size_t count;

		err = data_fwd_sensor_fetch(values, ARRAY_SIZE(values), &count);
		if (err) {
			LOG_WRN("Sample fetch failed (err %d)", err);
			continue;
		}

		err = proto_send_samples(values, count);
		if (err) {
			LOG_WRN("Sample send failed (err %d)", err);
		}
	}
}

/**
 * @brief Stop the protocol session and sensor sampling after a connection ends.
 */
static void session_stop(void)
{
	proto_stop_session();
	sensor_stop();
	LOG_INF("Transport link lost");
}

int main(void)
{
	int err;

	struct proto_transport transport;
	const struct proto_session_config session = {
		.rate_hz = data_fwd_sensor_frequency(),
		.channels = data_fwd_sensor_channel_count(),
		.sensor_type = data_fwd_sensor_type_id(),
		.channel_names = data_fwd_sensor_channel_names(),
#if defined(CONFIG_BT_DEVICE_NAME)
		.device_name = CONFIG_BT_DEVICE_NAME,
#else
		.device_name = "nRF DataFwd",
#endif
	};

	err = transport_init(&transport);
	if (err) {
		LOG_ERR("Transport init failed (err %d)", err);
		return err;
	}

	err = proto_init(&transport);
	if (err) {
		LOG_ERR("Protocol init failed (err %d)", err);
		return err;
	}

	err = data_fwd_sensor_init();
	if (err) {
		LOG_ERR("Sensor init failed (err %d)", err);
		return err;
	}

	LOG_INF("Data forwarder started");

	while (1) {
		transport_wait_ready();
		session_start_retry(&session);
		stream_samples();
		session_stop();
	}

	return 0;
}
```
