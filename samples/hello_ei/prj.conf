## CMakeLists.txt
```
#
# Copyright (c) 2026 Nordic Semiconductor ASA
#
# SPDX-License-Identifier: LicenseRef-Nordic-5-Clause
#

cmake_minimum_required(VERSION 3.20.0)

find_package(Zephyr REQUIRED HINTS $ENV{ZEPHYR_BASE})
project(hello_ei)

# Add application source files
target_sources(app PRIVATE
  src/main.c
)

# Add application include directories
target_include_directories(app PRIVATE
  src/include
)

# Validate that Edge Impulse URI is specified
if(CONFIG_EDGE_IMPULSE_URI STREQUAL "")
  message(FATAL_ERROR "CONFIG_EDGE_IMPULSE_URI must be specified")
endif()

include(${CMAKE_CURRENT_LIST_DIR}/edge_impulse/ei_sdk_utils.cmake)

# Process URI list from configuration (supports URLs and local paths)
process_edge_impulse_uri("${CONFIG_EDGE_IMPULSE_URI}" EI_URI_LIST)

# Get Edge Impulse API key header if specified
get_edge_impulse_api_key(EI_API_KEY_HEADER)

# Include Edge Impulse library integration
if(CONFIG_EDGE_IMPULSE_COMPILE_INTO_APP)
  message(STATUS "Compiling Edge Impulse library into application binary")
  include(${CMAKE_CURRENT_LIST_DIR}/edge_impulse/ei_compile_in_app.cmake)
else()
  message(STATUS "Building Edge Impulse library as separate static library")
  include(${CMAKE_CURRENT_LIST_DIR}/edge_impulse/ei_standalone_lib.cmake)
endif()
```

## Kconfig
```
#
# Copyright (c) 2025 Nordic Semiconductor ASA
#
# SPDX-License-Identifier: LicenseRef-Nordic-5-Clause
#

mainmenu "Hello Edge Impulse sample application"

config EDGE_IMPULSE_URI
	string "Edge Impulse library URI"
	default ''
	help
	  Specify URI used to access archive with Edge Impulse library.
	  The library will be downloaded into the build directory. You can specify
	  more than one URI separated by a semicolon.
	  Make sure to specify the HTTP API key header as EI_API_KEY_HEADER
	  variable during build if the HTTP server uses it.
	  You can also specify the absolute file path of a local file. In that
	  case, only one URI has to be defined.

config EDGE_IMPULSE_DEBUG_MODE
	bool "Run Edge Impulse library in debug mode"
    default n
	imply NEWLIB_LIBC_FLOAT_PRINTF
	help
	  Enables additional log information from Edge Impulse library.

config HELLO_EI_DATA_BUF_SIZE
	int "Size of input data buffer"
	default 512
	help
	  The buffer is used to store input data for the Edge Impulse library.
	  Size of the buffer is expressed as number of floats.

# This must be at the end to include Zephyr's Kconfig tree
source "Kconfig.zephyr"
```

## sample.yaml
```
sample:
  description: Sample showing basic Edge Impulse usage
  name: Hello Edge Impulse sample
common:
  harness: console
  harness_config:
    ordered: true
    regex:
      - "=== Inference result ==="
      - "idle => 0[.]0[0-9]+"
      - "sine => (1[.]0[0-9]+)|(0[.]9[0-9]+)"
      - "triangle => 0[.]0[0-9]+"
      - "anomaly: (-[0-9]+[.][0-9]+)|(0[.]0[0-9]+)"
    type: multi_line
  platform_allow:
    - nrf5340dk/nrf5340/cpuapp
    - nrf5340dk/nrf5340/cpuapp/ns
    - nrf54l15dk/nrf54l05/cpuapp
    - nrf54l15dk/nrf54l10/cpuapp
    - nrf54l15dk/nrf54l15/cpuapp
    - nrf54h20dk/nrf54h20/cpuapp
    - nrf9160dk/nrf9160/ns
    - qemu_cortex_m3
    - thingy91x/nrf9151/ns
  integration_platforms:
    - nrf5340dk/nrf5340/cpuapp
    - nrf5340dk/nrf5340/cpuapp/ns
    - nrf54l15dk/nrf54l05/cpuapp
    - nrf54l15dk/nrf54l10/cpuapp
    - nrf54l15dk/nrf54l15/cpuapp
    - nrf54h20dk/nrf54h20/cpuapp
    - nrf9160dk/nrf9160/ns
    - qemu_cortex_m3
  platform_exclude:
    - native_sim
    - qemu_x86
tests:
  sample.hello_ei:
    sysbuild: true
    build_only: false
    tags:
      - sysbuild
      - ci_samples_edge_impulse
```

## prj.conf
```kconfig
#
# Copyright (c) 2021 Nordic Semiconductor ASA
#
# SPDX-License-Identifier: LicenseRef-Nordic-5-Clause
#

CONFIG_NCS_SAMPLES_DEFAULTS=y

# Using console with UART
CONFIG_CONSOLE=y
CONFIG_UART_CONSOLE=y
CONFIG_RTT_CONSOLE=n

# Enable Edge Impulse dependencies
CONFIG_CPP=y
CONFIG_STD_CPP11=y
CONFIG_FP16=n
CONFIG_REQUIRES_FULL_LIBCPP=y
CONFIG_CBPRINTF_FP_SUPPORT=y
CONFIG_FPU=y

# Increase main stack size
CONFIG_MAIN_STACK_SIZE=2048

# Use URL to fetch Edge Impulse library from the Internet or local path
CONFIG_EDGE_IMPULSE_URI="edge_impulse/nrf_accel_sim-v35.zip"
```

## src/main.c
```c
/*
 * Copyright (c) 2026 Nordic Semiconductor ASA
 *
 * SPDX-License-Identifier: LicenseRef-Nordic-5-Clause
 */

#include <zephyr/kernel.h>
#include <zephyr/logging/log.h>

#include "edge-impulse-sdk/dsp/numpy_types.h"
#include "edge-impulse-sdk/porting/ei_classifier_porting.h"
#include "edge-impulse-sdk/classifier/ei_classifier_types.h"

#include "input_data.h"

LOG_MODULE_REGISTER(hello_ei);

#define INPUT_WINDOW_SIZE    EI_CLASSIFIER_DSP_INPUT_FRAME_SIZE

BUILD_ASSERT(INPUT_WINDOW_SIZE <= CONFIG_HELLO_EI_DATA_BUF_SIZE,
	"Size of data buffer is smaller than input window size");

static struct {
	float data[CONFIG_HELLO_EI_DATA_BUF_SIZE];
	size_t current_index;
} sample_buffer;

static size_t inference_cnt = 0;

extern EI_IMPULSE_ERROR run_classifier(signal_t *signal, ei_impulse_result_t *result, bool debug);

static void print_inference_result(const ei_impulse_result_t *result, int64_t duration)
{
	LOG_INF("=== Inference result ===");

	for (size_t i = 0; i < EI_CLASSIFIER_LABEL_COUNT; i++) {
		LOG_INF("%s => %.5f", result->classification[i].label,
			(double)result->classification[i].value);
	}

#if EI_CLASSIFIER_HAS_ANOMALY
	LOG_INF("anomaly: %.5f", (double)result->anomaly);
#endif

	LOG_INF("=== Inference time profiling ===");
	LOG_INF("Full inference completed in %lld ms", duration);
	LOG_INF("Classification completed in %d ms", result->timing.classification);
	LOG_INF("DSP operations completed in %d ms", result->timing.dsp);

#if EI_CLASSIFIER_HAS_ANOMALY
	LOG_INF("Anomaly detection completed in %d ms", result->timing.anomaly);
#endif
}

static void print_model_info(void)
{
	LOG_INF("=== Model info ===");
	LOG_INF("Input frame size: %u", EI_CLASSIFIER_RAW_SAMPLES_PER_FRAME);
	LOG_INF("Input window size: %u", EI_CLASSIFIER_DSP_INPUT_FRAME_SIZE);
	LOG_INF("Input frequency: %u", EI_CLASSIFIER_FREQUENCY);
	LOG_INF("Label count: %u", EI_CLASSIFIER_LABEL_COUNT);
	LOG_INF("Has anomaly: %s", EI_CLASSIFIER_HAS_ANOMALY ? "yes" : "no");
}

static void clear_sample_buffer(void)
{
	memset(sample_buffer.data, 0, sizeof(sample_buffer.data));
	sample_buffer.current_index = 0;
}

static void collect_sample(float val)
{
	sample_buffer.data[sample_buffer.current_index] = val;

	/* Move to the next index in circular buffer. */
	if (sample_buffer.current_index < (CONFIG_HELLO_EI_DATA_BUF_SIZE - 1)) {
		sample_buffer.current_index++;
	} else {
		sample_buffer.current_index = 0;
	}
}

static int get_samples_from_buffer(size_t offset, size_t length, float *out_ptr)
{
	__ASSERT_NO_MSG(length <= CONFIG_HELLO_EI_DATA_BUF_SIZE);
	__ASSERT_NO_MSG(out_ptr != NULL);

	/* Calculate start and end indices in the circular buffer. */
	size_t buffer_size = ARRAY_SIZE(sample_buffer.data);
	size_t start_index = (inference_cnt + offset) % buffer_size;
	size_t end_index = start_index + length;

	if (end_index <= buffer_size) {
		/* Data fits without wrapping. */
		memcpy(out_ptr, sample_buffer.data + start_index,
		       length * sizeof(float));
	} else {
		/* Data wraps around to the beginning of the buffer. */
		size_t first_part_len = buffer_size - start_index;
		size_t second_part_len = length - first_part_len;

		memcpy(out_ptr, sample_buffer.data + start_index,
		       first_part_len * sizeof(float));
		memcpy(out_ptr + first_part_len, sample_buffer.data,
		       second_part_len * sizeof(float));
	}

	return 0;
}

static int run_ei_classification(ei_impulse_result_t *ei_result, size_t window_size)
{
	signal_t features_signal;

	features_signal.get_data = get_samples_from_buffer;
	features_signal.total_length = window_size;

	EI_IMPULSE_ERROR err = run_classifier(&features_signal, ei_result,
		IS_ENABLED(CONFIG_EI_WRAPPER_DEBUG_MODE));

	return err;
}

static int run_model(const float *input_data, size_t input_data_size)
{
	__ASSERT_NO_MSG(input_data != NULL);
	__ASSERT_NO_MSG(input_data_size >= INPUT_WINDOW_SIZE);

	size_t sample_cnt = 0;
	int64_t start_time, delta;
	ei_impulse_result_t inference_result;
	int err;

	clear_sample_buffer();
	inference_cnt = 0;

	while (sample_cnt < input_data_size) {
		/* Collect new sample (in this case: from compiled input data). */
		collect_sample(input_data[sample_cnt]);
		sample_cnt++;

		/* When there is enough data in the buffer, start running inference
		   in a sliding window fashion. */
		if (sample_cnt >= INPUT_WINDOW_SIZE) {
			start_time = k_uptime_get();
			err = run_ei_classification(&inference_result, INPUT_WINDOW_SIZE);
			delta = k_uptime_delta(&start_time);

			if (err != 0) {
				LOG_ERR("Classification failed with error code: %d", err);
				return -1;
			}

			print_inference_result(&inference_result, delta);

			/* Keep track of how many inferences have been performed
			   to know the offset in the buffered data. */
			inference_cnt++;
		}
	}

	LOG_INF("End of input data reached");
	return 0;
}

int main(void)
{
	print_model_info();

	LOG_INF("=== Running inference on sine wave input data ===");
	run_model(input_data_sine, ARRAY_SIZE(input_data_sine));

	LOG_INF("=== Running inference on triangle wave input data ===");
	run_model(input_data_triangle, ARRAY_SIZE(input_data_triangle));

	return 0;
}
```

## src/ei_wrapper.cpp
```c
/*
 * Copyright (c) 2026 Nordic Semiconductor ASA
 *
 * SPDX-License-Identifier: LicenseRef-Nordic-5-Clause
 */

#include "ei_run_classifier.h"

#if !CONFIG_ZTEST
/* Fixes warnings about redefinition of Zephyr ROUND_UP macro. */
#ifdef ROUND_UP
#undef ROUND_UP
#endif
#endif /* !CONFIG_ZTEST */

#include "ei_wrapper.h"

#define DEBUG_MODE    IS_ENABLED(CONFIG_EI_WRAPPER_DEBUG_MODE)

static get_data_callback_t get_data_cbk = nullptr;

int ei_wrapper_init(get_data_callback_t cbk)
{
	get_data_cbk = cbk;
	return 0;
}

int ei_wrapper_run_inference(ei_impulse_result_t *ei_result, size_t window_size)
{
	signal_t features_signal;

	__ASSERT_NO_MSG(ei_result != nullptr);

	features_signal.get_data = get_data_cbk;
	features_signal.total_length = window_size;

	EI_IMPULSE_ERROR err = run_classifier(&features_signal, ei_result, DEBUG_MODE);

	return err;
}
```
